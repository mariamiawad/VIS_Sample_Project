AUTOSAR XML (schema 4-0-3)
package /VttVfbTraceFunctions
  module config Rte
    RteGeneration: RteVttVfbTraceFunction=Rte_Vtt_Task_Dispatch, RteVttVfbTraceFunction=Rte_Vtt_Task_WaitEventRet
