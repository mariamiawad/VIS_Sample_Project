AUTOSAR XML (schema 4-0-3)
package /DaVinci_Project
  module config Com
    ComConfig
      CalibVersion_98325e63 (ComSignal): ComSignalType=UINT8
      InverterCoolgFlowRate_451170b4 (ComSignal): ComSignalType=UINT8
  module config Rte
    21 x RteBswModuleInstance:
      BswM
        BswM_MainFunctionTimingEvent0 (RteBswEventToTaskMapping): RteBswUsedOsEventRef=Rte_Ev_Cyclic2_BSW_Task_0_10ms, RteBswUsedOsAlarmRef=Os/Rte_Al_TE2_BSW_Task_0_10ms
      Can
        3 x RteBswEventToTaskMapping, all with RteBswUsedOsEventRef=Rte_Ev_Cyclic2_BSW_Task_0_10ms, RteBswUsedOsAlarmRef=Os/Rte_Al_TE2_BSW_Task_0_10ms:
          Can_MainFunction_BusOffTimingEvent0
          Can_MainFunction_ModeTimingEvent0
          Can_MainFunction_WakeupTimingEvent0
      CanIf
      CanNm
        CanNm_MainFunctionTimingEvent0 (RteBswEventToTaskMapping): RteBswUsedOsEventRef=Rte_Ev_Cyclic2_BSW_Task_0_5ms, RteBswUsedOsAlarmRef=Os/Rte_Al_TE2_BSW_Task_0_5ms
      CanSM
        CanSM_MainFunctionTimingEvent0 (RteBswEventToTaskMapping): RteBswUsedOsEventRef=Rte_Ev_Cyclic2_BSW_Task_0_10ms, RteBswUsedOsAlarmRef=Os/Rte_Al_TE2_BSW_Task_0_10ms
      CanTp
        CanTp_MainFunctionTimingEvent0 (RteBswEventToTaskMapping): RteBswUsedOsEventRef=Rte_Ev_Cyclic2_BSW_Task_0_5ms, RteBswUsedOsAlarmRef=Os/Rte_Al_TE2_BSW_Task_0_5ms
      Com
        Com_MainFunctionRxTimingEvent0 (RteBswEventToTaskMapping): RteBswUsedOsEventRef=Rte_Ev_Cyclic2_BSW_Task_0_10ms, RteBswUsedOsAlarmRef=Os/Rte_Al_TE2_BSW_Task_0_10ms
        Com_MainFunctionTxTimingEvent0 (RteBswEventToTaskMapping): RteBswUsedOsEventRef=Rte_Ev_Cyclic2_BSW_Task_0_10ms, RteBswUsedOsAlarmRef=Os/Rte_Al_TE2_BSW_Task_0_10ms
      ComM
        ComM_MainFunction_0TimingEvent0 (RteBswEventToTaskMapping): RteBswUsedOsEventRef=Rte_Ev_Cyclic2_BSW_Task_0_20ms, RteBswUsedOsAlarmRef=Os/Rte_Al_TE2_BSW_Task_0_20ms
      ComXf
      Dcm
        Dcm_MainFunctionTimingEvent0 (RteBswEventToTaskMapping): RteBswUsedOsEventRef=Rte_Ev_Cyclic2_BSW_Task_0_10ms, RteBswUsedOsAlarmRef=Os/Rte_Al_TE2_BSW_Task_0_10ms
      Dem
        Dem_MasterMainFunctionTimingEvent0 (RteBswEventToTaskMapping): RteBswUsedOsEventRef=Rte_Ev_Cyclic2_BSW_Task_0_5ms, RteBswUsedOsAlarmRef=Os/Rte_Al_TE2_BSW_Task_0_5ms
        Dem_SatelliteMainFunctionTimingEvent0 (RteBswEventToTaskMapping): RteBswUsedOsEventRef=Rte_Ev_Cyclic2_BSW_Task_0_5ms, RteBswUsedOsAlarmRef=Os/Rte_Al_TE2_BSW_Task_0_5ms
      Det
      E2EXf
      EcuM
        EcuM_MainFunctionTimingEvent0 (RteBswEventToTaskMapping): RteBswUsedOsEventRef=Rte_Ev_Cyclic2_BSW_Task_0_10ms, RteBswUsedOsAlarmRef=Os/Rte_Al_TE2_BSW_Task_0_10ms
      Fee
        Fee_MainFunctionTimingEvent0 (RteBswEventToTaskMapping): RteBswUsedOsEventRef=Rte_Ev_Cyclic2_BSW_Task_0_5ms, RteBswUsedOsAlarmRef=Os/Rte_Al_TE2_BSW_Task_0_5ms
      Fls
        Fls_MainFunctionTimingEvent0 (RteBswEventToTaskMapping): RteBswUsedOsEventRef=Rte_Ev_Cyclic2_BSW_Task_0_5ms, RteBswUsedOsAlarmRef=Os/Rte_Al_TE2_BSW_Task_0_5ms
      Nm
      NvM
        NvM_MainFunctionTimingEvent0 (RteBswEventToTaskMapping): RteBswUsedOsEventRef=Rte_Ev_Cyclic2_BSW_Task_0_10ms, RteBswUsedOsAlarmRef=Os/Rte_Al_TE2_BSW_Task_0_10ms
      PduR
      SomeIpXf
      Spi
        Spi_MainFunction_HandlingTimingEvent0 (RteBswEventToTaskMapping): RteBswUsedOsEventRef=Rte_Ev_Cyclic2_BSW_Task_0_10ms, RteBswUsedOsAlarmRef=Os/Rte_Al_TE2_BSW_Task_0_10ms
    9 x RteSwComponentInstance:
      BswM_EcuSwComposition
        4 x RteEventToTaskMapping:
          Timer_BswM_MainFunction: RteUsedOsEventRef=Rte_Ev_Cyclic2_BSW_Task_0_10ms, RteUsedOsAlarmRef=Os/Rte_Al_TE2_BSW_Task_0_10ms
          MST_BswM_Notification_Dcm_DiagSessionControl_RP_Notification_Dcm_DiagSessionControl_RP_ON_ENTRY_DEFAULT_SESSION: RteUsedOsEventRef=Rte_Ev_Run_BswM_BswM_Notification_Dcm_DiagSessionControl_RP
          MST_BswM_Notification_Dcm_DiagSessionControl_RP_Notification_Dcm_DiagSessionControl_RP_ON_ENTRY_EXTENDED_SESSION: RteUsedOsEventRef=Rte_Ev_Run_BswM_BswM_Notification_Dcm_DiagSessionControl_RP
          MST_BswM_Notification_Dcm_DiagSessionControl_RP_Notification_Dcm_DiagSessionControl_RP_ON_ENTRY_PROGRAMMING_SESSION: RteUsedOsEventRef=Rte_Ev_Run_BswM_BswM_Notification_Dcm_DiagSessionControl_RP
      ComM_EcuSwComposition
        Timer_ComM_MainFunction_0 (RteEventToTaskMapping): RteUsedOsEventRef=Rte_Ev_Cyclic2_BSW_Task_0_20ms, RteUsedOsAlarmRef=Os/Rte_Al_TE2_BSW_Task_0_20ms
      Dcm_EcuSwComposition
        Timer_Dcm_MainFunction (RteEventToTaskMapping): RteUsedOsEventRef=Rte_Ev_Cyclic2_BSW_Task_0_10ms, RteUsedOsAlarmRef=Os/Rte_Al_TE2_BSW_Task_0_10ms
      DemMaster_0_EcuSwComposition
        Timer_Dem_MasterMainFunction (RteEventToTaskMapping): RteUsedOsEventRef=Rte_Ev_Cyclic2_BSW_Task_0_5ms, RteUsedOsAlarmRef=Os/Rte_Al_TE2_BSW_Task_0_5ms
      DemSatellite_0_EcuSwComposition
        Timer_Dem_SatelliteMainFunction (RteEventToTaskMapping): RteUsedOsEventRef=Rte_Ev_Cyclic2_BSW_Task_0_5ms, RteUsedOsAlarmRef=Os/Rte_Al_TE2_BSW_Task_0_5ms
      Det_EcuSwComposition
      EcuM_EcuSwComposition
        Timer_EcuM_MainFunction (RteEventToTaskMapping): RteUsedOsEventRef=Rte_Ev_Cyclic2_BSW_Task_0_10ms, RteUsedOsAlarmRef=Os/Rte_Al_TE2_BSW_Task_0_10ms
      NvM_EcuSwComposition
        Timer_NvM_MainFunction (RteEventToTaskMapping): RteUsedOsEventRef=Rte_Ev_Cyclic2_BSW_Task_0_10ms, RteUsedOsAlarmRef=Os/Rte_Al_TE2_BSW_Task_0_10ms
      Test_Component_EcuSwComposition
        3 x RteEventToTaskMapping:
          TMT_ABS_MainFunction: RteUsedOsEventRef=Rte_Ev_Run_Test_Component_ABS_MainFunction, RteUsedOsAlarmRef=Os/Rte_Al_TE_Test_Component_ABS_MainFunction
          TMT_ABS_StatusUpdate: RteUsedOsEventRef=Rte_Ev_Run_Test_Component_ABS_StatusUpdate, RteUsedOsAlarmRef=Os/Rte_Al_TE_Test_Component_ABS_StatusUpdate
          TMT_Test_Runnable: RteUsedOsEventRef=Rte_Ev_Run_Test_Component_Test_Runnable, RteUsedOsAlarmRef=Os/Rte_Al_TE_Test_Component_Test_Runnable
    RteOsInteraction
      6 x RteUsedOsActivation, all with RteExpectedActivationOffset=0:
        Rte_Al_TE2_BSW_Task_0_10ms: RteActivationOsAlarmRef=Os/Rte_Al_TE2_BSW_Task_0_10ms, RteActivationOsTaskRef=BSW_Task
        Rte_Al_TE2_BSW_Task_0_20ms: RteActivationOsAlarmRef=Os/Rte_Al_TE2_BSW_Task_0_20ms, RteActivationOsTaskRef=BSW_Task
        Rte_Al_TE2_BSW_Task_0_5ms: RteActivationOsAlarmRef=Os/Rte_Al_TE2_BSW_Task_0_5ms, RteActivationOsTaskRef=BSW_Task
        Rte_Al_TE_Test_Component_ABS_MainFunction: RteActivationOsAlarmRef=Os/Rte_Al_TE_Test_Component_ABS_MainFunction, RteActivationOsTaskRef=OsTask_App
        Rte_Al_TE_Test_Component_ABS_StatusUpdate: RteActivationOsAlarmRef=Os/Rte_Al_TE_Test_Component_ABS_StatusUpdate, RteActivationOsTaskRef=OsTask_App
        Rte_Al_TE_Test_Component_Test_Runnable: RteActivationOsAlarmRef=Os/Rte_Al_TE_Test_Component_Test_Runnable, RteActivationOsTaskRef=OsTask_App
  module config NvM
  module config Os
    BSW_Task (OsTask):
      OsTaskActivation = 1
      OsTaskPriority = 8
      OsTaskSchedule = FULL
      OsTaskEventRef = Rte_Ev_Cyclic2_BSW_Task_0_10ms
      OsTaskEventRef = Rte_Ev_Cyclic2_BSW_Task_0_20ms
      OsTaskEventRef = Rte_Ev_Cyclic2_BSW_Task_0_5ms
    3 x OsAlarm, all with OsAlarmCounterRef=SystemTimer:
      Rte_Al_TE2_BSW_Task_0_10ms
        OsAlarmAction
          OsAlarmSetEvent: OsAlarmSetEventRef=Rte_Ev_Cyclic2_BSW_Task_0_10ms, OsAlarmSetEventTaskRef=BSW_Task
      Rte_Al_TE2_BSW_Task_0_20ms
        OsAlarmAction
          OsAlarmSetEvent: OsAlarmSetEventRef=Rte_Ev_Cyclic2_BSW_Task_0_20ms, OsAlarmSetEventTaskRef=BSW_Task
      Rte_Al_TE2_BSW_Task_0_5ms
        OsAlarmAction
          OsAlarmSetEvent: OsAlarmSetEventRef=Rte_Ev_Cyclic2_BSW_Task_0_5ms, OsAlarmSetEventTaskRef=BSW_Task
    OsTask_App (OsTask):
      OsTaskActivation = 1
      OsTaskPriority = 3
      OsTaskSchedule = FULL
      OsTaskEventRef = Rte_Ev_Run_BswM_BswM_Notification_Dcm_DiagSessionControl_RP
      OsTaskEventRef = Rte_Ev_Run_Test_Component_ABS_MainFunction
      OsTaskEventRef = Rte_Ev_Run_Test_Component_ABS_StatusUpdate
      OsTaskEventRef = Rte_Ev_Run_Test_Component_Test_Runnable
    3 x OsAlarm, all with OsAlarmCounterRef=SystemTimer:
      Rte_Al_TE_Test_Component_ABS_MainFunction
        OsAlarmAction
          OsAlarmSetEvent: OsAlarmSetEventRef=Rte_Ev_Run_Test_Component_ABS_MainFunction, OsAlarmSetEventTaskRef=OsTask_App
      Rte_Al_TE_Test_Component_ABS_StatusUpdate
        OsAlarmAction
          OsAlarmSetEvent: OsAlarmSetEventRef=Rte_Ev_Run_Test_Component_ABS_StatusUpdate, OsAlarmSetEventTaskRef=OsTask_App
      Rte_Al_TE_Test_Component_Test_Runnable
        OsAlarmAction
          OsAlarmSetEvent: OsAlarmSetEventRef=Rte_Ev_Run_Test_Component_Test_Runnable, OsAlarmSetEventTaskRef=OsTask_App
    7 x OsEvent:
      Rte_Ev_Cyclic2_BSW_Task_0_10ms
      Rte_Ev_Cyclic2_BSW_Task_0_20ms
      Rte_Ev_Cyclic2_BSW_Task_0_5ms
      Rte_Ev_Run_BswM_BswM_Notification_Dcm_DiagSessionControl_RP
      Rte_Ev_Run_Test_Component_ABS_MainFunction
      Rte_Ev_Run_Test_Component_ABS_StatusUpdate
      Rte_Ev_Run_Test_Component_Test_Runnable
  ecuc value collection DaVinci_Project: ecuc-values=[Com, Rte, Os, NvM]
