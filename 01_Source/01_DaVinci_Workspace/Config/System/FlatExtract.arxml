AUTOSAR XML (schema 4-3-0)
package /COM/VECTOR/CFG/WORKFLOW/SYSDESC/SYNC
  system SYSTEM: category=ECU_EXTRACT
    system mapping MAPPINGS
    root-software-compositions:
      root sw composition prototype COMPOSITIONTYPE: flat-map=FLATMAP, software-composition=COMPOSITIONTYPE
  composition sw component type COMPOSITIONTYPE  # UB:Derived from original system description
    9 x component:
      BswM: type=BswM
      DemMaster_0: type=DemMaster_0
      DemSatellite_0: type=DemSatellite_0
      EcuM: type=EcuM
      Os_OsCore0_swc: type=Os_OsCore0_swc
      ComM: type=ComM
      Dcm: type=Dcm
      Det: type=Det
      NvM: type=NvM
  end to end protection set E2EPROTECTIONSET
  port interface mapping set PORTINTERFACEMAPPINGSET
