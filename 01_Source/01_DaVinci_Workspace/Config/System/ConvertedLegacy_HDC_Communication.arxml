AUTOSAR XML (schema 4-2-1)
package /VehicleProject
  system System
package /TP
  can tp config CAN00_CAN: communication-cluster=CAN00, can-tp-ecu{cycle-time-main-function=0.005, ecu-instance=SCU}
    can tp node TN_SCU: connector=CN_CAN00
package /Cluster
  can cluster CAN00: protocol-name=CAN  # CAN_DBC_PUBLIC_VECTOR
    can physical channel CHNL: comm-connectors=CN_CAN00
      frame TXDiagValeo_Tp2CanResp_D_1860T_oCAN00: id 0x744, from SCU, frame-length=8, can-addressing-mode=STANDARD
        n pdu TXDiagValeo_Tp2CanResp_D_1860T_Tp_oCAN00: length=8
      pdu triggering PT_TXDiagValeo_Tp2CanResp_D_1860T: pdu=TXDiagValeo_Tp2CanResp_D_1860T_oCAN00, from SCU
package /ECU
  ecu instance SCU
    can communication controller CT_CAN00
    can communication connector CN_CAN00: comm-controller=CT_CAN00
package /PDU
  dcm i pdu TXDiagValeo_Tp2CanResp_D_1860T_oCAN00: length=8, diag-pdu-type=DIAG-RESPONSE
