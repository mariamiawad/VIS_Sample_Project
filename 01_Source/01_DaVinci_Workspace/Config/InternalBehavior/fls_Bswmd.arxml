AUTOSAR XML (schema 4-0-3)
package /AUTOSAR_Fls/BswModuleDescriptions
  bsw module description Fls: module-id=92
    provided-entrys:
      Fls_BlankCheck
      Fls_Cancel
      Fls_Compare
      Fls_Erase
      Fls_GetJobResult
      Fls_GetStatus
      Fls_GetVersionInfo
      Fls_Init
      Fls_MainFunction
      Fls_Read
      Fls_SetMode
      Fls_Write
    bsw internal behavior InternalBehavior_0
      6 x exclusive area:
        FLS_EXCLUSIVE_AREA_00
        FLS_EXCLUSIVE_AREA_{10..14}
      8 x bsw called entity:
        Fls_BlankCheck: implemented-entry=Fls_BlankCheck
        Fls_Cancel: implemented-entry=Fls_Cancel
        Fls_Compare: implemented-entry=Fls_Compare
        Fls_Erase: implemented-entry=Fls_Erase
        Fls_GetJobResult: implemented-entry=Fls_GetJobResult
        Fls_GetStatus: implemented-entry=Fls_GetStatus
        Fls_GetVersionInfo: implemented-entry=Fls_GetVersionInfo
        Fls_Init: can-enter-exclusive-area=[FLS_EXCLUSIVE_AREA_00, FLS_EXCLUSIVE_AREA_10, FLS_EXCLUSIVE_AREA_11, FLS_EXCLUSIVE_AREA_12, FLS_EXCLUSIVE_AREA_13, FLS_EXCLUSIVE_AREA_14], implemented-entry=Fls_Init
      bsw schedulable entity Fls_MainFunction: implemented-entry=Fls_MainFunction
      bsw called entity Fls_Read: implemented-entry=Fls_Read
      bsw called entity Fls_SetMode: implemented-entry=Fls_SetMode
      bsw called entity Fls_Write: implemented-entry=Fls_Write
      bsw timing event FlsTimingEvent_MainFunction: starts-on-event=Fls_MainFunction, period=0.005
package /AUTOSAR_Fls/BswModuleEntrys
  12 x bsw module entry, all with sw-service-impl-policy=STANDARD:
    Fls_BlankCheck: service-id=0, is-reentrant=false, is-synchronous=true, call-type=REGULAR, execution-context=UNSPECIFIED
    Fls_Cancel: service-id=0x03, is-reentrant=false, is-synchronous=true, call-type=REGULAR, execution-context=UNSPECIFIED
    Fls_Compare: service-id=0x08, is-reentrant=false, is-synchronous=false, call-type=REGULAR, execution-context=UNSPECIFIED
    Fls_Erase: service-id=0x01, is-reentrant=false, is-synchronous=false, call-type=REGULAR, execution-context=UNSPECIFIED
    Fls_GetJobResult: service-id=0x05, is-reentrant=true, is-synchronous=true, call-type=REGULAR, execution-context=UNSPECIFIED
    Fls_GetStatus: service-id=0x04, is-reentrant=true, is-synchronous=true, call-type=REGULAR, execution-context=UNSPECIFIED
    Fls_GetVersionInfo: service-id=0x10, is-reentrant=true, is-synchronous=true, call-type=REGULAR, execution-context=UNSPECIFIED
    Fls_Init: service-id=0x00, is-reentrant=false, is-synchronous=true, call-type=REGULAR, execution-context=UNSPECIFIED
    Fls_MainFunction: service-id=0x06, is-reentrant=false, is-synchronous=true, call-type=SCHEDULED, execution-context=TASK
    Fls_Read: service-id=0x07, is-reentrant=false, is-synchronous=false, call-type=REGULAR, execution-context=UNSPECIFIED
    Fls_SetMode: service-id=0x09, is-reentrant=false, is-synchronous=true, call-type=REGULAR, execution-context=UNSPECIFIED
    Fls_Write: service-id=0x02, is-reentrant=false, is-synchronous=false, call-type=REGULAR, execution-context=UNSPECIFIED
package /Fls_T40D2M10I0R0/Implementations
  bsw implementation BswImplementation_0: programming-language=C, sw-version=4.2.2, vendor-id=43, ar-release-version=4.2.2, behavior=InternalBehavior_0, vendor-specific-module-def=Fls
    code-descriptors:
      code Files
        artifact-descriptors:
          short-label=config::Fls.xdm, category=SWCFG
          short-label=doc::AUTOSAR_MCAL_FLS_IM.pdf, category=SWDOC
          short-label=doc::AUTOSAR_MCAL_FLS_UM.pdf, category=SWDOC
          short-label=include::Fls.h, category=SWHDR
          short-label=include::Fls_Api.h, category=SWHDR
          short-label=include::Fls_Flash.h, category=SWHDR
          short-label=include::Fls_Flash_Types.h, category=SWHDR
          short-label=include::Fls_IPW.h, category=SWHDR
          short-label=include::Fls_Qspi.h, category=SWHDR
          short-label=include::Fls_Qspi_Types.h, category=SWHDR
          short-label=include::Fls_Types.h, category=SWHDR
          short-label=include::Fls_Version.h, category=SWHDR
          short-label=include::Reg_eSys_FLASHC.h, category=SWHDR
          short-label=include::Reg_eSys_QSPI.h, category=SWHDR
          short-label=src::Fls.c, category=SWSRC
          short-label=src::Fls_Ac.c, category=SWSRC
          short-label=src::Fls_Flash.c, category=SWSRC
          short-label=src::Fls_Flash_Const.c, category=SWSRC
          short-label=src::Fls_IPW.c, category=SWSRC
          short-label=src::Fls_Qspi.c, category=SWSRC
          short-label=src::Fls_Qspi_Irq.c, category=SWSRC
    compiler GHS_Compiler:
      name=Green Hills
      options=-cpu=cortexm4 -ansi -Osize -dual_debug -G --no_exceptions -Wundef -Wimplicit-int -Wshadow -Wtrigraphs -Wall --prototype_errors --incorrect_pragma_warnings -noslashcomment -preprocess_assembly_files -nostartfile --short_enum -c --no_commons -keeptempfiles -list -DAUTOSAR_OS_NOT_USED -DDISABLE_MCAL_INTERMODULE_ASR_CHECK -DGHS
      vendor=Green Hills
      version=Green Hills Multi 7.1.4 / Compiler 2017.1.4
    compiler LINARO_Compiler: name=Linaro Compiler, options=-c -O1 -ggdb3 -mcpu=cortex-m4 -mthumb -mlittle-endian -fomit-frame-pointer -mhard-float -fno-common -Wall -Wextra -Wstrict-prototypes -Wno-sign-compare -DAUTOSAR_OS_NOT_USED -DLINARO -fstack-usage -fdump-ipa-all -Werror=implicit-function-declaration, vendor=Linaro, version=GCC ARM Embedded 6.3.1 20170620
    compiler IAR_Compiler: name=IAR Compiler, options=--cpu=Cortex-M4 --cpu_mode=thumb --endian=little -Ohz -c --no_clustering --no_mem_idioms --no_explicit_zero_opt --debug --diag_suppress=Pa050 -DAUTOSAR_OS_NOT_USED -DIAR --require_prototypes --no_wrap_diagnostics --no_system_include -e, vendor=IAR Systems, version=IAR: V8.11.1
    generated-artifacts:
      dependency on artifact Fls_PBcfg_c: artifact-descriptor={short-label=generate_PB::src::Fls_PBcfg.c, category=SWSRC}, usages=COMPILE
      dependency on artifact Fls_Cfg_h: artifact-descriptor={short-label=generate_PC::include::Fls_Cfg.h, category=SWHDR}, usages=COMPILE
      dependency on artifact Fls_Cfg_c: artifact-descriptor={short-label=generate_PC::src::Fls_Cfg.c, category=SWSRC}, usages=COMPILE
    linker GHS_Linker: name=Green Hills, options=-Mn -delete -v -ignore_debug_references -map -keepmap -lstartup -lsys -larch -lansi -L(/lib/thumb2) -lutf8_s32, vendor=Green Hills, version=Green Hills Multi 7.1.4 / Compiler 2017.1.4
    linker LINARO_Linker: name=Linaro Compiler, options=-Map=filename -T scriptfile, vendor=Linaro, version=GCC ARM Embedded 6.3.1 20170620
    linker IAR_Linker: name=IAR Compiler, options=--cpu=Cortex-M4 --map filename --no_library_search --entry _start --enable_stack_usage --skip_dynamic_initialization --no_wrap_diagnostics --config, vendor=IAR Systems, version=IAR: V8.11.1
    resource consumption ResourceConsumption
      12 x memory section:
        FLS_CODE: alignment=UNSPECIFIED, sw-addrmethod=CODE, symbol=CODE
        FLS_CODE_AC: alignment=AC, sw-addrmethod=CODE_AC, symbol=CODE_AC
        FLS_CONFIG_DATA_UNSPECIFIED: alignment=UNSPECIFIED, sw-addrmethod=CONFIG_DATA_UNSPECIFIED, symbol=CONFIG_DATA_UNSPECIFIED
        FLS_CONST_32: alignment=32, sw-addrmethod=CONST_32, symbol=CONST_32
        FLS_CONST_UNSPECIFIED: alignment=UNSPECIFIED, sw-addrmethod=CONST_UNSPECIFIED, symbol=CONST_UNSPECIFIED
        FLS_RAMCODE: alignment=UNSPECIFIED, sw-addrmethod=RAMCODE, symbol=RAMCODE
        FLS_VAR_INIT_32: alignment=32, sw-addrmethod=VAR_INIT_32, symbol=VAR_INIT_32
        FLS_VAR_INIT_8: alignment=8, sw-addrmethod=VAR_INIT_8, symbol=VAR_INIT_8
        FLS_VAR_INIT_BOOLEAN: alignment=BOOLEAN, sw-addrmethod=VAR_INIT_BOOLEAN, symbol=VAR_INIT_BOOLEAN
        FLS_VAR_INIT_UNSPECIFIED: alignment=UNSPECIFIED, sw-addrmethod=VAR_INIT_UNSPECIFIED, symbol=VAR_INIT_UNSPECIFIED
        FLS_VAR_NO_INIT_8: alignment=8, sw-addrmethod=VAR_NO_INIT_8, symbol=VAR_NO_INIT_8
        FLS_VAR_NO_INIT_UNSPECIFIED: alignment=UNSPECIFIED, sw-addrmethod=VAR_NO_INIT_UNSPECIFIED, symbol=VAR_NO_INIT_UNSPECIFIED
