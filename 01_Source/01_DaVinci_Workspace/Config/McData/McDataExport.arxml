AUTOSAR XML (schema 4-2-1)
package /MICROSAR
  10 x bsw implementation, all with programming-language=C, vendor-id=30:
    BswM_Impl: sw-version=14.00.00, used-code-generator=DaVinci Configurator, ar-release-version=4.00.03, behavior=BswMBehavior
    CanIf_Impl: sw-version=6.25.00, used-code-generator=cMSR, ar-release-version=4.00.03, behavior=CanIf_Behavior
    CanSM_Impl: sw-version=3.00.01, used-code-generator=DaVinci Configurator, ar-release-version=4.00.03, behavior=CanSMBehavior
    CanTp_Impl: sw-version=4.00.00, used-code-generator=DaVinci Configurator, ar-release-version=4.00.03, behavior=CanTpBehavior
    Com_Impl: sw-version=19.00.00, used-code-generator=DaVinci Configurator, ar-release-version=4.00.03, behavior=ComBehavior
    ComM_Impl: sw-version=13.00.01, used-code-generator=DaVinci Configurator, ar-release-version=4.00.03, behavior=ComMBehavior
    EcuM_Impl: sw-version=10.00.02, used-code-generator=DaVinci Configurator, ar-release-version=4.00.03, behavior=EcuMBehavior
    Fee_Impl: sw-version=8.06.00, used-code-generator=DaVinci Configurator, ar-release-version=4.00.03, behavior=FeeBehavior
    NvM_Impl: sw-version=7.01.02, used-code-generator=DaVinci Configurator, ar-release-version=4.00.03, behavior=NvMBehavior
    PduR_Impl: sw-version=15.04.01, used-code-generator=DaVinci Configurator, ar-release-version=4.01.02, behavior=PduRBehavior
package /MICROSAR/BswM_ib_bswmd/BswModuleDescriptions
  bsw module description BswM
    bsw internal behavior BswMBehavior
      exclusive area BSWM_EXCLUSIVE_AREA_0
      bsw schedulable entity BswM_MainFunction: implemented-entry=BswM_MainFunction
      bsw timing event BswM_MainFunctionTimingEvent0: starts-on-event=BswM_MainFunction, period=0.01
  bsw module entry BswM_MainFunction: call-type=SCHEDULED, execution-context=TASK
package /MICROSAR/CanIf_ib_bswmd/BswModuleDescriptions
  bsw module description CanIf
    bsw internal behavior CanIf_Behavior
      8 x exclusive area:
        CANIF_EXCLUSIVE_AREA_{0..7}
package /MICROSAR/CanSM_ib_bswmd/BswModuleDescriptions
  bsw module description CanSM
    bsw internal behavior CanSMBehavior
      6 x exclusive area:
        CANSM_EXCLUSIVE_AREA_{1..6}
      bsw schedulable entity CanSM_MainFunction: implemented-entry=CanSM_MainFunction
      bsw timing event CanSM_MainFunctionTimingEvent0: starts-on-event=CanSM_MainFunction, period=0.01
  bsw module entry CanSM_MainFunction: call-type=SCHEDULED, execution-context=TASK
package /MICROSAR/CanTp_ib_bswmd/BswModuleDescriptions
  bsw module description CanTp
    bsw internal behavior CanTpBehavior
      exclusive area CANTP_EXCLUSIVE_AREA_0
      bsw schedulable entity CanTp_MainFunction: implemented-entry=CanTp_MainFunction
      bsw timing event CanTp_MainFunctionTimingEvent0: starts-on-event=CanTp_MainFunction, period=0.005
  bsw module entry CanTp_MainFunction: call-type=SCHEDULED, execution-context=TASK
package /MICROSAR/ComM_ib_bswmd/BswModuleDescriptions
  bsw module description ComM
    bsw internal behavior ComMBehavior
      exclusive area COMM_EXCLUSIVE_AREA_0
      exclusive area COMM_EXCLUSIVE_AREA_1
      bsw schedulable entity ComM_MainFunction_0: implemented-entry=ComM_MainFunction_0
      bsw timing event ComM_MainFunction_0TimingEvent0: starts-on-event=ComM_MainFunction_0, period=0.02
  bsw module entry ComM_MainFunction_0: call-type=SCHEDULED, execution-context=TASK
package /MICROSAR/Com_ib_bswmd/BswModuleDescriptions
  bsw module description Com
    bsw internal behavior ComBehavior
      exclusive area COM_EXCLUSIVE_AREA_TX  # This critical section protects Tx ressources that can be accessed from various contexts. Therefore the critical section enclosed with COM_EXCLUSIVE_AREA_TX should never be interrupted by any Com API which accesses Tx ressources. For more details, see DocTechRef.
      exclusive area COM_EXCLUSIVE_AREA_RX  # This critical section protects Rx ressources that can be accessed from various contexts.Therefore the critical section enclosed with COM_EXCLUSIVE_AREA_RX should never be interrupted by any Com API which accesses Rx ressources. For more details, see DocTechRef.
      exclusive area COM_EXCLUSIVE_AREA_BOTH  # This critical section protects Rx and Tx ressources that are being accessed in context of Com_MainFunctionRouteSignals for signal gateway routings or description routings with configured deferred description source. For more details, see DocTechRef.
      bsw schedulable entity Com_MainFunctionTx: implemented-entry=Com_MainFunctionTx
      bsw schedulable entity Com_MainFunctionRx: implemented-entry=Com_MainFunctionRx
      bsw timing event Com_MainFunctionTxTimingEvent0: starts-on-event=Com_MainFunctionTx, period=0.01
      bsw timing event Com_MainFunctionRxTimingEvent0: starts-on-event=Com_MainFunctionRx, period=0.01
  bsw module entry Com_MainFunctionTx: call-type=SCHEDULED, execution-context=TASK
  bsw module entry Com_MainFunctionRx: call-type=SCHEDULED, execution-context=TASK
package /MICROSAR/EcuM_ib_bswmd/BswModuleDescriptions
  bsw module description EcuM
    bsw internal behavior EcuMBehavior
      4 x exclusive area:
        ECUM_EXCLUSIVE_AREA_0  # This exclusive area shall disable all wake up interrupts to prevent overwriting of some global variables.
        ECUM_EXCLUSIVE_AREA_1  # This exclusive area is only used in case of multi core and if the the EcuM is configured to handle also the slave cores. It must be configured as a spinlock to allow access to some variables simultaneously from multiple cores.
        ECUM_EXCLUSIVE_AREA_2  # This exclusive area is used for accessing the clock variable. It shall disable GPT interrupts and task changes. Only necessary if 32 Bit access is not atomic and Alarm Clock is present.
        ECUM_EXCLUSIVE_AREA_3  # This This exclusive area must be configured as a spin lock to protect access on global shutdown target variables.
      bsw schedulable entity EcuM_MainFunction: implemented-entry=EcuM_MainFunction
      bsw timing event EcuM_MainFunctionTimingEvent0: starts-on-event=EcuM_MainFunction, period=0.01
  bsw module entry EcuM_MainFunction: call-type=SCHEDULED, execution-context=TASK
package /MICROSAR/Fee_ib_bswmd/BswModuleDescriptions
  bsw module description Fee
    bsw internal behavior FeeBehavior
      exclusive area FEE_EXCLUSIVE_AREA_0
      bsw schedulable entity Fee_MainFunction: implemented-entry=Fee_MainFunction
      bsw timing event Fee_MainFunctionTimingEvent0: starts-on-event=Fee_MainFunction, period=0.005
  bsw module entry Fee_MainFunction: call-type=SCHEDULED, execution-context=TASK
package /MICROSAR/NvM_ib_bswmd/BswModuleDescriptions
  bsw module description NvM
    bsw internal behavior NvMBehavior
      exclusive area NVM_EXCLUSIVE_AREA_0
      bsw schedulable entity NvM_MainFunction: implemented-entry=NvM_MainFunction
      bsw timing event NvM_MainFunctionTimingEvent0: starts-on-event=NvM_MainFunction, period=0.01
  bsw module entry NvM_MainFunction: call-type=SCHEDULED, execution-context=TASK
package /MICROSAR/PduR_ib_bswmd/BswModuleDescriptions
  bsw module description PduR
    bsw internal behavior PduRBehavior
      exclusive area PDUR_EXCLUSIVE_AREA_0
