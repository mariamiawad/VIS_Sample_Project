AUTOSAR XML (schema 4-3-0)
standard types defined: boolean, sint8, uint16, uint32, uint8
package /Predefined_DEV/ImplementationDataTypes
  impl type NvM_RequestResultType: compu {0=NVM_REQ_OK, 1=NVM_REQ_NOT_OK, 2=NVM_REQ_PENDING, 3=NVM_REQ_INTEGRITY_FAILED, 4=NVM_REQ_BLOCK_SKIPPED, 5=NVM_REQ_NV_INVALIDATED, 6=NVM_REQ_CANCELED, 7=NVM_REQ_REDUNDANCY_FAILED, 8=NVM_REQ_RESTORED_FROM_ROM}, implementation-data-type=uint8
  impl type NvM_ServiceIdType: compu {6=NVM_READ_BLOCK, 7=NVM_WRITE_BLOCK, 8=NVM_RESTORE_BLOCK_DEFAULTS, 9=NVM_ERASE_BLOCK, 11=NVM_INVALIDATE_NV_BLOCK, 12=NVM_READ_ALL}, implementation-data-type=uint8
  impl type Dem_UdsStatusByteType: compu {mask 1: 1=DEM_UDS_STATUS_TF, mask 2: 2=DEM_UDS_STATUS_TFTOC, mask 4: 4=DEM_UDS_STATUS_PDTC, mask 8: 8=DEM_UDS_STATUS_CDTC, mask 16: 16=DEM_UDS_STATUS_TNCSLC, mask 32: 32=DEM_UDS_STATUS_TFSLC, mask 64: 64=DEM_UDS_STATUS_TNCTOC, mask 128: 128=DEM_UDS_STATUS_WIR}, range raw 0..255, implementation-data-type=uint8
package /DataType
  base type uint8_6_iso_8859_1: category=FIXED_LENGTH, base-type-size=48, base-type-encoding=ISO-8859-1
  base type uint8_7_iso_8859_1: category=FIXED_LENGTH, base-type-size=56, base-type-encoding=ISO-8859-1
  base type uint8_8_iso_8859_1: category=FIXED_LENGTH, base-type-size=64, base-type-encoding=ISO-8859-1
package /DataType/Semantics
  compu method CM_ACC_DWN_ET_HDC: 0..1=RANGE
  compu method CM_ACC_UP_ET_HDC: 0..1=RANGE
  compu method CM_ACT_DIAG: 0..1=RANGE
  compu method CM_ACTIVATION_DYN: 0..1=RANGE
  compu method CM_AES_PACKAGE_COUNTER: 0..15=RANGE
  compu method CM_APPEL_PH_ET_HDC: 0..1=RANGE
  compu method CM_AREA{1..3}_DETECTION_FAILURE: 0..1=RANGE
  compu method CM_AUTHENT_PROG_TRSP: 0..281474976710655=RANGE
  compu method CM_AUTOR_HSW: 0..1=RANGE
  compu method CM_BCK_PNL: 0..1=RANGE
  compu method CM_BIT_NERR: 0..1=RANGE
  compu method CM_BLOC_DIAG: 0..1152921504606846975=RANGE
  compu method CM_BLOC_UDS: 0..18446744073709551615=RANGE
  compu method CM_BRD_ET_HDC: 0..3=RANGE
  compu method CM_C_DEFAUT_BUSOFF: 0..255=RANGE
  compu method CM_C_DEFAUT_N_AS: 0..255=RANGE
  compu method CM_C_DEFAUT_NERR: 0..255=RANGE
  compu method CM_C_DEFAUT_PERTE_COM: 0..255=RANGE
  compu method CM_CDE_APC: 0..3=RANGE
  compu method CM_CDE_AVERT_ET_HDC: 0..1=RANGE
  compu method CM_CDE_CLG_ET_HDC: 0..3=RANGE
  compu method CM_CDE_ECL_CONNECT: 0..1=RANGE
  compu method CM_CDE_LECT_CID: 0..1=RANGE
  compu method CM_CDE_TEL_KML: 0..1=RANGE
  compu method CM_CHKSUM_TRME_DYN_01: 0..15=RANGE
  compu method CM_CMD_HF_CMD_TRSP: 0..1023=RANGE
  compu method CM_CMPT_MOL_ET_HDC: -128..127=RANGE
  compu method CM_CMPT_NAV_MENU_CMB: -128..127=RANGE
  compu method CM_CMPT_NAV_MENU_VMF: -128..127=RANGE
  compu method CM_CMPT_RHEOSTATAGE: -128..127=RANGE
  compu method CM_CMPT_VOL_VCI: -128..127=RANGE
  compu method CM_CODE_HF_ET_HF{1..8}: 0..255=RANGE
  compu method CM_CODE_IDENT_LECT_TRSP: 0..4294967295=RANGE
  compu method CM_CODE_IDENT_TRSP_HF: 0..3=RANGE
  compu method CM_COM_DIAG_INT_AUTOR: 0..1=RANGE
  compu method CM_COMPTEUR_RAZ_GCT: 0..253=RANGE
  compu method CM_CONF_STT_DRIVER_INHIB: 0..1=RANGE
  compu method CM_CONFIG: 0..255=RANGE
  compu method CM_CONTACT_FREIN1: 0..1=RANGE
  compu method CM_CONTACT_ON_AREA{1..3}: 0..7=RANGE
  compu method CM_CPT_PROCESS_4B_01: 0..15=RANGE
  compu method CM_CPT_TEMPOREL: phys=raw*0.1 for raw 0..4294967295
  compu method CM_CTX_JDD: 0..31=RANGE
  compu method CM_DEFAUT_HDC_ARC: 0..1=RANGE
  compu method CM_DEFAUT_HDC_IHM_RHEOST: 0..1=RANGE
  compu method CM_DEM_EFFAC_DEF: 0..1=RANGE
  compu method CM_DESACTIV_ET_HDC: 0..1=RANGE
  compu method CM_DIAG_MUX_ON: 0..1=RANGE
  compu method CM_DIGIT_1: 0..15=RANGE
  compu method CM_DIGIT_2: 0..15=RANGE
  compu method CM_DMD_BLACK_PANEL: 0..1=RANGE
  compu method CM_DMD_PLAF_VOLANT: 0..1=RANGE
  compu method CM_DMD_XVV_PROG: 0..1=RANGE
  compu method CM_E_AVERTISSEUR: 0..1=RANGE
  compu method CM_E_FEUX_POS: 0..1=RANGE
  compu method CM_E_HF: 0..1=RANGE
  compu method CM_E_PHARE: 0..1=RANGE
  compu method CM_E_RESERVE_{1..4}: 0..1=RANGE
  compu method CM_EM_SON_CMD_BRT: 0..15=RANGE
  compu method CM_ESCAPE_ET_CMB: 0..1=RANGE
  compu method CM_ESCAPE_ET_VMF: 0..1=RANGE
  compu method CM_ESS_AV_ET_HDC: 0..7=RANGE
  compu method CM_ESSUYAGE: 0..1=RANGE
  compu method CM_ETAT_ACTIVATION_AVR: 0..1=RANGE
  compu method CM_ETAT_CLIGNOTANTS: 0..3=RANGE
  compu method CM_ETAT_COFFRE: 0..1=RANGE
  compu method CM_ETAT_CPO_ARD: 0..1=RANGE
  compu method CM_ETAT_CPO_ARG: 0..1=RANGE
  compu method CM_ETAT_CPO_COND: 0..1=RANGE
  compu method CM_ETAT_CPO_COND_REPLI: 0..1=RANGE
  compu method CM_ETAT_CPO_LUNETTE: 0..1=RANGE
  compu method CM_ETAT_CPO_PASS: 0..1=RANGE
  compu method CM_ETAT_FCT_RHF: 0..1=RANGE
  compu method CM_ETAT_FCT_TRSP_BF: 0..1=RANGE
  compu method CM_ETAT_FONCT_LVV_RVV: 0..7=RANGE
  compu method CM_ETAT_GEN: 0..1=RANGE
  compu method CM_ETAT_GMP: 0..3=RANGE
  compu method CM_ETAT_GMP_HY: 0..7=RANGE
  compu method CM_ETAT_JN: 0..1=RANGE
  compu method CM_ETAT_MA: 0..1=RANGE
  compu method CM_ETAT_NM: 0..1=RANGE
  compu method CM_ETAT_PRINCIP_SEV: 0..3=RANGE
  compu method CM_ETAT_RESEAU_ELEC: 0..15=RANGE
  compu method CM_EXEC_AUTHENT: 0..1=RANGE
  compu method CM_EXEC_AUTHENT_AES: 0..1=RANGE
  compu method CM_EXEC_IDENT: 0..3=RANGE
  compu method CM_FAMILLE_SON: 0..3=RANGE
  compu method CM_HDC_CDE_VOCALE_ET_VMF: 0..1=RANGE
  compu method CM_HOD_LEARNING_PHASE: 0..3=RANGE
  compu method CM_IDENT_HF_CMD_TRSP: 0..1=RANGE
  compu method CM_IDENT_LOGIC: 0..65535=RANGE
  compu method CM_IDENT_REQ_CMD_TRSP: 0..1=RANGE
  compu method CM_IDENT_REQ_CMD_TRSP_AES: 0..1=RANGE
  compu method CM_IDENT1_HFX_RHF: 0..255=RANGE
  compu method CM_IDENT2_HFX_RHF: 0..255=RANGE
  compu method CM_INTERD_MEMO_DEF: 0..1=RANGE
  compu method CM_INV_CDPH_ET_HDC: 0..1=RANGE
  compu method CM_INVIOLABILITE_AUDIO: 0..1=RANGE
  compu method CM_ISK_PART_NUMBER: 0..15=RANGE
  compu method CM_KM_TOTAL: phys=raw*0.1 for raw 0..16777213
  compu method CM_KPCRYP_TRSP_AES_{1..6}: 0..255=RANGE
  compu method CM_KPCRYP_TRSP{1..4}: 0..255=RANGE
  compu method CM_LIST_ET_HDC: 0..1=RANGE
  compu method CM_LOUDSPEAKER_DEFAULT: 0..1=RANGE
  compu method CM_LPCRYPTE_CMD_TRSP: 0..4294967295=RANGE
  compu method CM_LPCRYPTE_CMD_TRSP_AES: 0..65535=RANGE
  compu method CM_LUMINOSITE: 0..15=RANGE
  compu method CM_LVV_RVV_HDC: 0..3=RANGE
  compu method CM_MARQUEUR_DEBUT: 0..252=RANGE
  compu method CM_MARQUEUR_FIN: 0..252=RANGE
  compu method CM_MDE_CFG: 0..3=RANGE
  compu method CM_MENU_ET_VMF: 0..1=RANGE
  compu method CM_MODE_CONFIG_VHL: 0..15=RANGE
  compu method CM_MODE_ECO: 0..1=RANGE
  compu method CM_MODE_ET_VMF: 0..1=RANGE
  compu method CM_MODE_HY: 0..7=RANGE
  compu method CM_MODE_TELEPH_ET_HDC: 0..1=RANGE
  compu method CM_MOT_PASS_PROG_TRSP: 0..16777215=RANGE
  compu method CM_NB_TRAME: 0..3=RANGE
  compu method CM_NIV_AMB_FMUX: 0..127=RANGE
  compu method CM_NIV_SON_CMD_BRT: 0..255=RANGE
  compu method CM_NUM_CLE_HF: 1..5=RANGE
  compu method CM_NUM_EDITION: 0..254=RANGE
  compu method CM_NUM_ESSAI_AUTH_TRSP: 0..3=RANGE
  compu method CM_NUM_ESSAI_TRSP: 0..3=RANGE
  compu method CM_NUM_ESSAI_TRSP_AES: 0..3=RANGE
  compu method CM_NUM_TRAME: 0..3=RANGE
  compu method CM_NUM_UCE: 0..254=RANGE
  compu method CM_ON_OFF_RAD: 0..1=RANGE
  compu method CM_ON_REFUSE: 0..1=RANGE
  compu method CM_OVF_NAV_INF_ET_CMB: 0..1=RANGE
  compu method CM_OVF_NAV_INF_ET_VMF: 0..1=RANGE
  compu method CM_OVF_NAV_SUP_ET_CMB: 0..1=RANGE
  compu method CM_OVF_NAV_SUP_ET_VMF: 0..1=RANGE
  compu method CM_OVF_RHEOST_INF: 0..1=RANGE
  compu method CM_OVF_RHEOST_SUP: 0..1=RANGE
  compu method CM_OVF_SCAN_DWN_ET_HDC: 0..1=RANGE
  compu method CM_OVF_SCAN_UP_ET_HDC: 0..1=RANGE
  compu method CM_OVF_VOL_INF_ET_VCI: 0..1=RANGE
  compu method CM_OVF_VOL_SUP_ET_VCI: 0..1=RANGE
  compu method CM_PARC_USINE: 0..1=RANGE
  compu method CM_PERTE_COM: 0..1=RANGE
  compu method CM_PHASE_VIE: 0..7=RANGE
  compu method CM_PLACE_DISPO: 0..1=RANGE
  compu method CM_POS_BAS_UN_CRAN: 0..1=RANGE
  compu method CM_POS_TIR_UN_CRAN: 0..1=RANGE
  compu method CM_PRES_MENU_PRECOND: 0..1=RANGE
  compu method CM_PRES_VAL_CONS_XVV_ACC: 0..1=RANGE
  compu method CM_PRESENCE_CRT: 0..1=RANGE
  compu method CM_PROG_ISK: 0..72057594037927896=RANGE
  compu method CM_PROG_RSK16: 0..72057594037927896=RANGE
  compu method CM_PSH_DT_ET_HDC: 0..1=RANGE
  compu method CM_PSH_GH_ET_HDC_ETAT: 0..1=RANGE
  compu method CM_PSH_GH_ET_HDC_VMF: 0..1=RANGE
  compu method CM_PSH_VOL: 0..15=RANGE
  compu method CM_PUSH_ARTIV: 0..1=RANGE
  compu method CM_PUSH_CYCLAGE_LVV_RVV: 0..1=RANGE
  compu method CM_PUSH_DESELECTION_LVV_RVV: 0..1=RANGE
  compu method CM_PUSH_SEL_LVV: 0..1=RANGE
  compu method CM_PUSH_SEL_RVV: 0..1=RANGE
  compu method CM_REC_SGCONF_ET_RHF: 0..1=RANGE
  compu method CM_REC_TC_HF_ET_RHF: 0..1=RANGE
  compu method CM_RECYCL_AIR_ET_VMF: 0..1=RANGE
  compu method CM_REP_KPCRYP_LECT_TRSP: 0..1=RANGE
  compu method CM_REP_KPCRYP_LECT_TRSP_AES: 0..1=RANGE
  compu method CM_REP_UCE: 0..255=RANGE
  compu method CM_RESYNC: 0..1=RANGE
  compu method CM_REV: 0..255=RANGE
  compu method CM_REVEIL_HDC: 0..1=RANGE
  compu method CM_RN_TRSP_CMD_TRSP: 0..4294967295=RANGE
  compu method CM_RN_TRSP_CMD_TRSP_AES: 0..18446744073709551615=RANGE
  compu method CM_ROT_1_CRAN_ESS: 0..1=RANGE
  compu method CM_ROT_2_CRAN_ESS: 0..1=RANGE
  compu method CM_RSK16_PACKAGE_COUNTER: 0..15=RANGE
  compu method CM_RSK16_PART_NUMBER: 0..15=RANGE
  compu method CM_SECU_ETAT_SEV: 0..15=RANGE
  compu method CM_SEEK_DWN_ET_HDC: 0..1=RANGE
  compu method CM_SEEK_UP_ET_HDC: 0..1=RANGE
  compu method CM_SENSI_ESS_HDC: 0..7=RANGE
  compu method CM_SESS_DIAG: 0..1=RANGE
  compu method CM_SOURCE_HDC: 0..1=RANGE
  compu method CM_SPEED_DWN_ET_HDC: 0..1=RANGE
  compu method CM_SPEED_UP_ET_HDC: 0..1=RANGE
  compu method CM_STAT_APP_CLE: 0..3=RANGE
  compu method CM_STEERWHL_PUSH_1: 0..1=RANGE
  compu method CM_STEERWHL_PUSH_{10..16}: 0..1=RANGE
  compu method CM_STEERWHL_PUSH_{2..9}: 0..1=RANGE
  compu method CM_SYNC_ON_OFF_RAD: 0..1=RANGE
  compu method CM_T_EXT: phys=raw*0.5-40 for raw 0..250
  compu method CM_T_EXT_FILT: phys=raw*0.5-40 for raw 0..250
  compu method CM_TEAU: phys=raw-40 for raw 0..254
  compu method CM_TEST_VOY_CMB: 0..1=RANGE
  compu method CM_TOUCHE_CONFIG: 0..1=RANGE
  compu method CM_TYPE_DIR: 0..3=RANGE
  compu method CM_TYPE_RHEOS: 0..1=RANGE
  compu method CM_UB_ETAT_GMP_HY: 0..1=RANGE
  compu method CM_UB_MODE_HY: 0..1=RANGE
  compu method CM_UCE_ABS_HDC: 0..63=RANGE
  compu method CM_VALID_CAFR: 0..1=RANGE
  compu method CM_VALID_CDE_RADIO: 0..1=RANGE
  compu method CM_VALID_ET_CMB: 0..1=RANGE
  compu method CM_VALID_ET_VMF: 0..1=RANGE
  compu method CM_VER_LOG_ANNEE: phys=raw+2000 for raw 0..200
  compu method CM_VER_LOG_JOUR: 1..31=RANGE
  compu method CM_VER_LOG_MOIS: 1..12=RANGE
  compu method CM_VILL_ROUTE_ET_4POS: 0..15=RANGE
  compu method CM_VILLE_ROUTE_ET_HDC: 0..7=RANGE
  compu method CM_VMF_CDE_VOCALE_ET_VMF: 0..1=RANGE
  compu method CM_VOLUME_DWN_ET_HDC: 0..1=RANGE
  compu method CM_VOLUME_UP_ET_HDC: 0..1=RANGE
