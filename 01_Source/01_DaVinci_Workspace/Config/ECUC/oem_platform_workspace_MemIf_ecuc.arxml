AUTOSAR XML (schema 4-2-1)
package /ActiveEcuC
  module config MemIf: implementation-config-variant=VARIANT-PRE-COMPILE, module-description=MemIf_Impl
    MemIfGeneral: MemIfDevErrorDetect=false, MemIfVersionInfoApi=false, MemIfSafeBswChecks=false, MemIfNumberOfDevices=1
    MemIfMemHwA: MemIfMemHwAId=0, MemIfMemHwARef=FeeGeneral
