AUTOSAR XML (schema 4-2-1)
package /ActiveEcuC
  module config VTTFls: implementation-config-variant=VARIANT-PRE-COMPILE, module-description=VTTFls_Impl
    FlsGeneral:
      FlsBaseAddress = 0
      FlsCancelApi = true
      FlsCompareApi = true
      FlsDevErrorDetect = false
      FlsDriverIndex = 0
      FlsGetJobResultApi = true
      FlsGetStatusApi = true
      FlsSetModeApi = true
      FlsTotalSize = 0
      FlsVersionInfoApi = true
      FlsSafeBswChecks = false
      FlsAcLoadOnJobStart = false
      FlsUseInterrupts = false
    FlsPublishedInformation:
      FlsErasedValue = 255
      FlsAcLocationWrite = 0
      FlsSpecifiedEraseCycles = 100000
      FlsExpectedHwId = 0
      FlsAcSizeErase = 0
      FlsAcSizeWrite = 0
      FlsEraseTime = 5
      FlsWriteTime = 0.0005
      FlsAcLocationErase = 0
    FlsConfigSet:
      FlsDefaultMode = MEMIF_MODE_SLOW
      FlsMaxReadFastMode = 1048576
      FlsMaxReadNormalMode = 1024
      FlsMaxWriteFastMode = 256
      FlsMaxWriteNormalMode = 32
      FlsProtection = 0
      FlsJobEndNotification = Fee_JobEndNotification
      FlsAcWrite = 1073751296
      FlsJobErrorNotification = Fee_JobErrorNotification
      FlsAcErase = 1073751296
      FlsCallCycle = 0.005
      FlsSectorList
        3 x FlsSector, all with FlsNumberOfSectors=1, FlsPageSize=8, FlsSectorSize=2048:
          FlsSector_1: FlsSectorStartaddress=2048
          FlsSector_0: FlsSectorStartaddress=0
          FlsSector: FlsSectorStartaddress=0
      FlsDemEventParameterRefs:
        FLS_E_COMPARE_FAILED = DemEventParameter_MCAL
        FLS_E_ERASE_FAILED = DemEventParameter_MCAL
        FLS_E_READ_FAILED = DemEventParameter_MCAL
        FLS_E_UNEXPECTED_FLASH_ID = DemEventParameter_MCAL
        FLS_E_WRITE_FAILED = DemEventParameter_MCAL
