AUTOSAR XML (schema 4-2-1)
package /ActiveEcuC
  module config EcuM: implementation-config-variant=VARIANT-PRE-COMPILE, module-description=EcuM_Impl
    EcuMFlexGeneral: EcuMAlarmClockPresent=false, EcuMResetLoopDetection=false, EcuMEnableDefBehaviour=false
    EcuMGeneral:
      EcuMDevErrorDetect = true
      EcuMIncludeDem = true
      EcuMIncludeDet = true
      EcuMMainFunctionPeriod = 0.01
      EcuMVersionInfoApi = false
      EcuMDeferredBswMNotification = false
      EcuMSlaveCoreHandling = true
      EcuMEnableFixBehavior = false
      EcuMNonChannelWakeupInRun = false
      EcuMGeneration: EcuMOutOfBoundsWriteSanitizer=false, EcuMOutOfBoundsReadSanitizer=false, EcuMInterfacesForDeactivatedData=false
    EcuMConfiguration
      EcuMCommonConfiguration: EcuMConfigConsistencyHash=7801293361795245850, EcuMDefaultAppMode=OSDEFAULTAPPMODE, EcuMOSResource=OsResource
        5 x EcuMWakeupSource, all with EcuMValidationTimeout=0, EcuMCheckWakeupTimeout=0, EcuMWakeupSourcePolling=false:
          ECUM_WKSOURCE_POWER: EcuMWakeupSourceId=0
          ECUM_WKSOURCE_RESET: EcuMWakeupSourceId=1
          ECUM_WKSOURCE_INTERNAL_RESET: EcuMWakeupSourceId=2
          ECUM_WKSOURCE_INTERNAL_WDG: EcuMWakeupSourceId=3
          ECUM_WKSOURCE_EXTERNAL_WDG: EcuMWakeupSourceId=4
        EcuMDefaultShutdownTarget: EcuMDefaultState=EcuMStateOff
        CAN00_f26020e5 (EcuMWakeupSource): EcuMWakeupSourceId=5, EcuMWakeupSourcePolling=false, EcuMComMChannelRef=CAN00_f26020e5  # CN_CAN00
        EcuMDriverInitListZero
          4 x EcuMDriverInitItem:
            Det_InitMemory: index=0, EcuMModuleID=Det, EcuMModuleService=Det_InitMemory, EcuMModuleHeader=Det.h
            Det_Init: index=10, EcuMModuleID=Det, EcuMModuleService=Det_Init, EcuMModuleHeader=Det.h
            Dem_InitMemory: EcuMModuleID=Dem, EcuMModuleService=Dem_InitMemory, EcuMModuleHeader=Dem.h
            Dem_PreInit: index=11, EcuMModuleID=Dem, EcuMModuleService=Dem_PreInit, EcuMModuleHeader=Dem.h
        EcuMDriverInitListOne
          6 x EcuMDriverInitItem:
            Mcu_Init: index=0, EcuMModuleID=Mcu, EcuMModuleService=Mcu_Init, EcuMModuleHeader=Mcu.h
            Mcu_GetPllStatus: index=3, EcuMModuleID=Code, EcuMAdditionalInitCode=while (MCU_PLL_LOCKED != Mcu_GetPllStatus());
            Mcu_DistributePllClock: index=4, EcuMModuleID=Code, EcuMAdditionalInitCode=Mcu_DistributePllClock();
            Fls_Init: index=14, EcuMModuleID=Fls, EcuMModuleService=Fls_Init, EcuMModuleHeader=Fls.h
            Fee_Init: index=15, EcuMModuleID=Fee, EcuMModuleService=Fee_Init, EcuMModuleHeader=Fee.h
            NvM_Init: index=16, EcuMModuleID=NvM, EcuMModuleService=NvM_Init, EcuMModuleHeader=NvM.h, EcuMAdditionalInitCode=
        EcuMDriverRestartList
      EcuMFixedConfiguration: EcuMNvramWriteallTimeout=60, EcuMRunMinimumDuration=5, EcuMNormalMcuModeRef=McuModeSettingConf_0
        EcuMFixedUserConfig: EcuMFixedUser=0
      EcuMFlexConfiguration: EcuMFlexModuleConfigurationRef=CanConfigSet, EcuMNormalMcuModeRef=McuModeSettingConf_0
        3 x EcuMResetMode:
          ECUM_RESET_MCU: EcuMResetModeId=0
          ECUM_RESET_WDG: EcuMResetModeId=1
          ECUM_RESET_IO: EcuMResetModeId=2
        4 x EcuMShutdownCause:
          ECUM_CAUSE_UNKNOWN: EcuMShutdownCauseId=0
          ECUM_CAUSE_ECU_STATE: EcuMShutdownCauseId=1
          ECUM_CAUSE_WDGM: EcuMShutdownCauseId=2
          ECUM_CAUSE_DCM: EcuMShutdownCauseId=3
        ECUM_RESET_WAKEUP (EcuMResetMode): EcuMResetModeId=3
        CanFD3RequestNoCom (EcuMShutdownTarget): EcuMShutdownTargetId=0
    EcuMFixedGeneral: EcuMIncludeComM=true, EcuMIncludeNvramMgr=true, EcuMIncludeRte=true, EcuMGenModeSwitchPort=true, EcuMModeSwitchRteAck=true, EcuMIncludeDem=true
