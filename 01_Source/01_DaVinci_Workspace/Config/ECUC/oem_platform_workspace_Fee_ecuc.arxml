AUTOSAR XML (schema 4-2-1)
package /ActiveEcuC
  module config Fee: implementation-config-variant=VARIANT-PRE-COMPILE, module-description=Fee_Impl
    FeeGeneral:
      FeeDevErrorDetect = false
      FeeVersionInfoApi = false
      FeePollingMode = false
      FeeSetModeSupported = true
      FeeIndex = 0
      FeeNvmJobEndNotification = NvM_JobEndNotification
      FeeNvmJobErrorNotification = NvM_JobErrorNotification
      FeeInternalBufferSize = 64
      FeeMainFunctionPeriod = 0.005
      FeeMainFunctionTriggering = FixedCycleTime
      FeeSafeBswChecks = false
      FeeDevErrorChecks: FeeDetErrorhook=Det_ReportError, FeeDetIncludeFile=Det.h
      FeeFlsApi:
        FeeFlsIncludeFile = Fls.h
        FeeFlsSetMode = Fls_SetMode
        FeeFlsRead = Fls_Read
        FeeFlsWrite = Fls_Write
        FeeFlsCancel = Fls_Cancel
        FeeFlsGetStatus = Fls_GetStatus
        FeeFlsGetJobResult = Fls_GetJobResult
        FeeFlsErase = Fls_Erase
        FeeFlsCompare = Fls_Compare
        FeeFlsDeviceIndex = FlsGeneral
    FeeSpecificFeatures:
      FeeApplErrorCallbackFunction = Appl_FeeCriticalErrorCallback
      FeeApplErrorCallbackIncludeFile = ApplMain.h
      FeeGetEraseCycleApi = false
      FeeGetWriteCycleApi = false
      FeeUseApplErrorCallback = false
      FeeUseJobCache = false
      FeeForceSectorSwitchApi = false
      FeeDataConversionApi = false
      FeeFblConfig = false
      FeeMaxLinkTableSize = 4095
      FeeFssControlApi = false
      FeeExtendedSectorHeaderCheck = false
    FeeBlockConfiguration:
      FeeBlockIdFixed = false
      FeeBlockIsCritical = false
      FeeImmediateData = false
      FeeNumberOfChunkInstances = 1
      FeeBlockNumber = 112
      FeeBlockSize = 4
      FeeNumberOfWriteCycles = 10000
      FeeNumberOfDatasets = 2
      FeeBlockId = 0
      FeePartition = FeePartitionConfiguration
      FeeDeviceIndex = FlsGeneral
    FeePublishedInformation: FeeBlockOverhead=2, FeeMaximumBlockingTime=1, FeePageOverhead=0, FeeChunkHeader=16, FeeChunkLink=8, FeeSectorHeader=8
    FeePartitionConfiguration:
      FeeFssThresholdReserved = 0
      FeeLowerSectorAddress = 0
      FeeLowerSectorSize = 2048
      FeeUpperSectorAddress = 2048
      FeeUpperSectorSize = 2048
      FeeAddressAlignment = 8
      FeeWriteAlignment = 8
      FeeBssThresholdReserved = 536
      FeePartitionDevice = FlsConfigSet
    6 x FeeBlockConfiguration, all with FeeBlockIdFixed=false, FeeBlockIsCritical=false, FeeNumberOfChunkInstances=1, FeeNumberOfWriteCycles=10000, FeePartition=FeePartitionConfiguration, FeeDeviceIndex=FlsGeneral:
      FeeBlockConfiguration_Dem_Admin: FeeImmediateData=false, FeeBlockNumber=96, FeeBlockSize=16, FeeNumberOfDatasets=1, FeeBlockId=1
      FeeBlockConfiguration_Dem_Status: FeeImmediateData=false, FeeBlockNumber=80, FeeBlockSize=22, FeeNumberOfDatasets=1, FeeBlockId=2
      FeeBlockConfiguration_Dem_Primary: FeeImmediateData=false, FeeBlockNumber=64, FeeBlockSize=22, FeeNumberOfDatasets=1, FeeBlockId=3
      FeeBlockConfiguration_NvmBlock_Version_EEPROM: FeeImmediateData=false, FeeBlockNumber=48, FeeBlockSize=6, FeeNumberOfDatasets=1, FeeBlockId=4
      FeeBlockConfiguration_Product_Life_Data: FeeImmediateData=true, FeeBlockNumber=32, FeeBlockSize=34, FeeNumberOfDatasets=2, FeeBlockId=5
      FeeBlockConfiguration_StatusOfDTCMemory: FeeImmediateData=false, FeeBlockNumber=16, FeeBlockSize=28, FeeNumberOfDatasets=2, FeeBlockId=6
