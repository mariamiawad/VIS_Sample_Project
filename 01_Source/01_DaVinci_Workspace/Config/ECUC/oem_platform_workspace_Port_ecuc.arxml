AUTOSAR XML (schema 4-2-1)
package /ActiveEcuC
  module config Port: implementation-config-variant=VARIANT-POST-BUILD, module-description=BswImplementation_0
    CommonPublishedInformation:
      ArReleaseMajorVersion = 4
      ArReleaseMinorVersion = 2
      ArReleaseRevisionVersion = 2
      ModuleId = 124
      SwMajorVersion = 1
      SwMinorVersion = 0
      SwPatchVersion = 0
      VendorId = 43
    PortConfigSet
      NotUsedPortPin: PortPinDSE=Low_Drive_Strength, PortPinDirection=PORT_PIN_OUT, PortPinLevelValue=PORT_PIN_LEVEL_LOW, PortPinPE=PullDisabled, PortPinPS=PullDown
      PortContainer_0 (PortContainer): PortNumberOfPortPins=2
        PortPin_Can_Rx (PortPin):
          PortPinDSE = Low_drive_strength
          PortPinDirection = PORT_PIN_IN
          PortPinDirectionChangeable = false
          PortPinId = 42
          PortPinInitialMode = PORT_GPIO_MODE
          PortPinLevelValue = PORT_PIN_LEVEL_LOW
          PortPinMode = CAN0_RX
          PortPinModeChangeable = false
          PortPinPE = PullDisabled
          PortPinPFE = false
          PortPinPS = PullDown
          PortPinPcr = 132
        PortPin_Can_Tx (PortPin):
          PortPinDSE = Low_drive_strength
          PortPinDirection = PORT_PIN_OUT
          PortPinDirectionChangeable = false
          PortPinId = 43
          PortPinInitialMode = PORT_GPIO_MODE
          PortPinLevelValue = PORT_PIN_LEVEL_LOW
          PortPinMode = CAN0_TX
          PortPinModeChangeable = false
          PortPinPE = PullDisabled
          PortPinPFE = false
          PortPinPS = PullDown
          PortPinPcr = 133
    PortGeneral:
      PortDevErrorDetect = false
      PortEnableUserModeSupport = false
      PortSetPinDirectionApi = true
      PortSetPinModeApi = true
      PortSetPinModeDoesNotTouchGpioLevel = false
      PortVersionInfoApi = true
