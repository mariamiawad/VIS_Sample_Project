AUTOSAR XML (schema 4-2-1)
package /ActiveEcuC
  module config Os: implementation-config-variant=VARIANT-PRE-COMPILE, module-description=Os_Impl
    SystemTimer (OsCounter):
      OsCounterMaxAllowedValue = 2147483647
      OsCounterMinCycle = 1
      OsCounterType = HARDWARE
      OsSecondsPerTick = 0.000125
      OsCounterTicksPerBase = 10000
      OsCounterAccessingApplication = SystemApplication_OsCore0
      OsDriver: OsDriverHighResolution=false, OsDriverHardwareTimerChannelRef=SysTick_Ch0, OsDriverIsrRef=CounterIsr_SystemTimer
    OsOS:
      OsGenerateMemMapForNearAddressing = false
      OsStackMonitoring = true
      OsStatus = STANDARD
      OsUseGetServiceId = false
      OsUseParameterAccess = false
      OsUseResScheduler = false
      OsForcibleTermination = false
      OsGenerateCalloutStubs = true
      OsGenerateMemMap = COMPLETE
      OsGenerateMemMapForThreads = false
      OsServiceProtection = false
      OsStackUsageMeasurement = false
      OsUseXSignalAsyncApiCalls = false
      OsFpuUsage = NONE
      OsNumberOfCores = 1
      OsScalabilityClass = SC1
      OsMasterCore = OsCore0
      OsSystemTimer = SystemTimer
      OsHardwareInitCore = OsCore0
      OsHooks: OsErrorHook=true, OsPostTaskHook=false, OsPreTaskHook=false, OsShutdownHook=false, OsStartupHook=false, OsProtectionHook=false, OsPanicHook=true
      OsDebug: OsAssertions=false
      OsStackSummary
        12 x OsStack, all with OsStackCore=OsCore0:
          OsCore0_Kernel: OsStackSize=1024, OsStackType=CORE_KERNEL_STACK, OsStackUser=OsCore0
          OsCore0_Init: OsStackSize=1024, OsStackType=CORE_INIT_STACK, OsStackUser=OsCore0
          OsCore0_Error: OsStackSize=1024, OsStackType=CORE_ERROR_STACK, OsStackUser=OsCore0
          OsCore0_Isr_Core: OsStackSize=1024, OsStackType=ISR_SHARED_CORE_STACK, OsStackUser=CounterIsr_SystemTimer, OsStackUser=CanIsr_0_BusOff, OsStackUser=CanIsr_0_MB00To15, OsStackUser=CanIsr_0_MB16To31, OsStackUser=LPIT_0_CH_2_ISR, OsStackUser=Lin_Channel_2_Transmit_and_Receive_Interrupt
          OsCore0_Task_Prio0: OsStackSize=512, OsStackType=TASK_SHARED_PRIORITY_STACK, OsStackUser=Background_Task
          OsCore0_Task_Prio110: OsStackSize=1024, OsStackType=TASK_SHARED_PRIORITY_STACK, OsStackUser=Task_1ms
          OsCore0_Task_Prio120: OsStackSize=512, OsStackType=TASK_SHARED_PRIORITY_STACK, OsStackUser=Task_500usec
          OsCore0_Task_Prio200: OsStackSize=3000, OsStackType=TASK_SHARED_PRIORITY_STACK, OsStackUser=Init_Task
          OsCore0_Task_Prio4294967295: OsStackSize=1024, OsStackType=TASK_SHARED_PRIORITY_STACK, OsStackUser=AutoStart_Task
          Task_10ms: OsStackSize=2048, OsStackType=TASK_EXTENDED_STACK, OsStackUser=Os/Task_10ms
          Task_20ms: OsStackSize=2048, OsStackType=TASK_EXTENDED_STACK, OsStackUser=Os/Task_20ms
          Task_5ms: OsStackSize=1024, OsStackType=TASK_EXTENDED_STACK, OsStackUser=Os/Task_5ms
    OsPublishedInformation: OsKernelVersion=7, OsPlatformName=Arm
      S32K14x (OsDerivativeInformation):
        OsMpuAlignment = 32
        OsStackAlignment = 32
        OsExceptionVectorTableAlignment = 0
        OsInterruptVectorTableAlignment = 128
        OsHardwareManuals = NXP/Freescale - S32K14x Series Reference Manual - Supports S32K142, S32K144, S32K146, and S32K148 Document Number: S32K14XRM - Rev. 3, 03/2017
        Core0 (OsPhysicalCore):
          OsPhysicalCoreId = 0
          OsPhysicalCoreExceptionSources = 8
          OsPhysicalCoreIsAutostart = true
          OsPhysicalCoreMasterStartAllowed = false
          OsPhysicalCorePrivelegedHwAccess = true
          OsPhysicalCoreType = Cortex-M
          OsPhysicalCoreDefaultEntrySymbol = _start
          OsPhysicalCoreStackProtectionUnit = SystemMPU0
        INTC (OsSystemIntCtrl):
          OsSystemIntCtrlMaxPrios = 224
          OsSystemIntCtrlMaxSources = 240
          OsSystemIntCtrlPrioOrder = DESC
          OsSystemIntCtrlBaseAddress = 3758153728
          OsSystemIntCtrlType = NVIC
        OsMemoryRegionDefaults_AppT (OsMemoryRegionDefaults): OsMemoryRegionDefType=APPLICATION_TRUSTED, OsMemoryRegionDefAccessRights=SUPERVISOR_RWX, OsMemoryRegionDefBusMasters=Core
        OsMemoryRegionDefaults_AppNT (OsMemoryRegionDefaults):
          OsMemoryRegionDefType = APPLICATION_NONTRUSTED
          OsMemoryRegionDefBusMasters = Core
          OsMemoryRegionDefAccessRights = USER_R
          OsMemoryRegionDefAccessRights = USER_W
        OsMemoryRegionSpecifics
          3 x OsMemoryRegionAccess:
            SUPERVISOR_RW: OsMemoryRegionAccessRights=RW, OsMemoryRegionAccessType=SUPERVISOR
            SUPERVISOR_RWX: OsMemoryRegionAccessRights=RWX, OsMemoryRegionAccessType=SUPERVISOR
            USER_W: OsMemoryRegionAccessRights=W, OsMemoryRegionAccessType=USER
          4 x OsMemoryRegionBusMaster:
            Core: OsMemoryRegionBusMasterId=0
            Debugger: OsMemoryRegionBusMasterId=1
            DMA: OsMemoryRegionBusMasterId=2
            ENET: OsMemoryRegionBusMasterId=3
          PID_ENABLE (OsMemoryRegionFlag)
          3 x OsMemoryRegionAccess:
            USER_R: OsMemoryRegionAccessRights=R, OsMemoryRegionAccessType=USER
            USER_X: OsMemoryRegionAccessRights=X, OsMemoryRegionAccessType=USER
            SUPERVISOR_RX: OsMemoryRegionAccessRights=RX, OsMemoryRegionAccessType=SUPERVISOR
        SysTick (OsHardwareTimer): OsHardwareTimerBaseAddress=3758153744, OsHardwareTimerId=0, OsHardwareTimerSize=24, OsHardwareTimerUnit=PIT, OsHardwareTimerType=SysTick
          SysTick_Ch0 (OsHardwareTimerChannel): OsHardwareTimerChannelId=0, OsHardwareTimerChannelIntSource=15, OsHardwareTimerChannelOffset=0
        SystemMPU0 (OsSystemMpu): OsSystemMpuBaseAddress=1073795072, OsSystemMpuId=0, OsSystemMpuMaxRegions=8, OsSystemMpuType=SYSTEM_MPU_NXP
      VTT (OsDerivativeInformation):
        OsExceptionVectorTableAlignment = 0
        OsInterruptVectorTableAlignment = 0
        OsHardwareManuals = N/A
        OsMpuEndAddressAccessible = false
        OsMpuAlignment = 32
        OsStackAlignment = 32
        OsSystemIntCtrl: OsSystemIntCtrlPrioOrder=ASC, OsSystemIntCtrlMaxPrios=200, OsSystemIntCtrlBaseAddress=0, OsSystemIntCtrlMaxSources=10000
        OsHardwareTimer: OsHardwareTimerId=0, OsHardwareTimerUnit=FRT, OsHardwareTimerSize=32, OsHardwareTimerBaseAddress=0
          OsHardwareTimerChannel: OsHardwareTimerChannelId=0, OsHardwareTimerChannelIntSource=0, OsHardwareTimerChannelOffset=0
        OsPhysicalCore:
          OsPhysicalCoreId = 0
          OsPhysicalCoreExceptionSources = 0
          OsPhysicalCoreIsAutostart = false
          OsPhysicalCoreMasterStartAllowed = false
          OsPhysicalCorePrivelegedHwAccess = false
    OSDEFAULTAPPMODE (OsAppMode)
    OS_APPMODE_ANY (OsAppMode)
    OsCore0 (OsCore):
      OsCoreIsAutostart = true
      OsCoreIsAutosar = true
      OsCoreEntrySymbol = _start1
      OsCorePhysicalCoreRef = Core0
      OsCoreSystemApplication = SystemApplication_OsCore0
      OsCoreEcucCoreRef = EcucCoreDefinition
      OsCoreIdleTask = AutoStart_Task
      OsCoreStacks:
        OsCoreKernelStackSize = 1024
        OsCoreStartupStackSize = 1024
        OsCoreShutdownStackSize = 1024
        OsCoreErrorStackSize = 1024
        OsCoreProtectionStackSize = 1024
        OsCoreInitStackSize = 1024
    SystemApplication_OsCore0 (OsApplication):
      OsTrusted = true
      OsTrustedApplicationDelayTimingViolationCall = false
      OsTrustedApplicationWithProtection = false
      OsApplicationIsPrivileged = true
      OsAppUseTrustedFunctionStubs = false
      OsAppCounterRef = SystemTimer
      OsApplicationCoreRef = EcucCoreDefinition
      OsAppIsrRef = CounterIsr_SystemTimer
      OsAppTaskRef = Init_Task
      OsAppTaskRef = AutoStart_Task
      OsAppTaskRef = Background_Task
      OsAppTaskRef = Task_500usec
      OsAppIsrRef = CanIsr_0_BusOff
      OsAppIsrRef = CanIsr_0_MB00To15
      OsAppIsrRef = CanIsr_0_MB16To31
      OsAppAlarmRef = Rte_Al_TE2_Task_10ms_0_5ms
      OsAppAlarmRef = Rte_Al_TE2_Task_5ms_0_10ms
      OsAppTaskRef = Task_1ms
      OsAppTaskRef = Os/Task_5ms
      OsAppTaskRef = Os/Task_10ms
      OsAppTaskRef = Os/Task_20ms
      OsAppAlarmRef = Rte_Al_TE2_Task_10ms_0_10ms
      OsAppAlarmRef = Rte_Al_TE2_Task_20ms_0_20ms
      OsAppAlarmRef = Rte_Al_TE2_Task_5ms_0_5ms
      OsApplicationHooks: OsAppErrorHook=false, OsAppShutdownHook=false, OsAppStartupHook=false
    CounterIsr_SystemTimer (OsIsr):
      OsIsrCategory = CATEGORY_2
      OsIsrInterruptType = EXTERNAL
      OsIsrInterruptSource = 15
      OsIsrInterruptPriority = 16
      OsIsrStackSize = 1024
      OsIsrEnableNesting = false
      OsIsrUsesFpu = false
      OsIsrSpecialFunctionName = Os_TimerPitIsr
    3 x OsTask, all with OsTaskActivation=1, OsTaskStackSharing=false, OsTaskUsesFpu=false, OsTaskAccessingApplication=SystemApplication_OsCore0:
      Init_Task: OsTaskPriority=200, OsTaskSchedule=NON, OsTaskStackSize=3000, OsTaskType=BASIC
        OsTaskAutostart: OsTaskAppModeRef=OS_APPMODE_ANY, OsTaskAppModeRef=OSDEFAULTAPPMODE
      AutoStart_Task: OsTaskPriority=4294967295, OsTaskSchedule=FULL, OsTaskStackSize=1024, OsTaskType=AUTO
        OsTaskAutostart: OsTaskAppModeRef=OS_APPMODE_ANY
      Background_Task: OsTaskPriority=0, OsTaskSchedule=FULL, OsTaskStackSize=512, OsTaskType=AUTO, OsTaskResourceRef=OsResource
    OsResource: OsResourceProperty=STANDARD, OsResourceAccessingApplication=SystemApplication_OsCore0
    Task_500usec (OsTask):
      OsTaskActivation = 1
      OsTaskPriority = 120
      OsTaskSchedule = FULL
      OsTaskStackSharing = false
      OsTaskStackSize = 512
      OsTaskType = AUTO
      OsTaskUsesFpu = false
      OsTaskAccessingApplication = SystemApplication_OsCore0
    3 x OsIsr, all with OsIsrCategory=CATEGORY_2, OsIsrInterruptType=EXTERNAL, OsIsrInterruptPriority=64, OsIsrStackSize=1024, OsIsrEnableNesting=false, OsIsrUsesFpu=false:
      CanIsr_0_BusOff: OsIsrInterruptSource=94, OsIsrSpecialFunctionName=CanBusOffIsr_0  # Os Interrupt Service Routine PLAIN_TEXT CAN BusOff Interrupt. This OsIsr container has been created automatically based on the driver configuration.
      CanIsr_0_MB16To31: OsIsrInterruptSource=98, OsIsrSpecialFunctionName=CanMailboxIsr_0  # Os Interrupt Service Routine PLAIN_TEXT CAN Tx and Rx Interrupt. This OsIsr container has been created automatically based on the driver configuration.
      CanIsr_0_MB00To15: OsIsrInterruptSource=97, OsIsrSpecialFunctionName=CanMailboxIsr_0  # Os Interrupt Service Routine PLAIN_TEXT CAN Tx and Rx Interrupt. This OsIsr container has been created automatically based on the driver configuration.
    4 x OsTask, all with OsTaskActivation=1, OsTaskSchedule=FULL, OsTaskStackSharing=false, OsTaskUsesFpu=false, OsTaskAccessingApplication=SystemApplication_OsCore0:
      Task_1ms: OsTaskPriority=110, OsTaskStackSize=1024, OsTaskType=AUTO
      Task_5ms: OsTaskPriority=100, OsTaskStackSize=1024, OsTaskType=AUTO, OsTaskEventRef=Rte_Ev_Cyclic2_Task_5ms_0_5ms, OsTaskEventRef=Rte_Ev_Cyclic2_Task_5ms_0_10ms
      Task_10ms: OsTaskPriority=90, OsTaskStackSize=2048, OsTaskType=AUTO, OsTaskEventRef=Rte_Ev_Cyclic2_Task_10ms_0_10ms, OsTaskEventRef=Rte_Ev_Cyclic2_Task_10ms_0_5ms, OsTaskEventRef=Rte_Ev_Run_BswM_BswM_Notification_Dcm_DiagSessionControl_RP
      Task_20ms: OsTaskPriority=80, OsTaskStackSize=2048, OsTaskType=EXTENDED, OsTaskEventRef=Rte_Ev_Cyclic2_Task_20ms_0_20ms
    3 x OsAlarm, all with OsAlarmCounterRef=SystemTimer, OsAlarmAccessingApplication=SystemApplication_OsCore0:
      Rte_Al_TE2_Task_10ms_0_10ms
        OsAlarmAction
          OsAlarmSetEvent: OsAlarmSetEventRef=Rte_Ev_Cyclic2_Task_10ms_0_10ms, OsAlarmSetEventTaskRef=Os/Task_10ms
      Rte_Al_TE2_Task_20ms_0_20ms
        OsAlarmAction
          OsAlarmSetEvent: OsAlarmSetEventRef=Rte_Ev_Cyclic2_Task_20ms_0_20ms, OsAlarmSetEventTaskRef=Os/Task_20ms
      Rte_Al_TE2_Task_5ms_0_5ms
        OsAlarmAction
          OsAlarmSetEvent: OsAlarmSetEventRef=Rte_Ev_Cyclic2_Task_5ms_0_5ms, OsAlarmSetEventTaskRef=Os/Task_5ms
    3 x OsEvent:
      Rte_Ev_Cyclic2_Task_10ms_0_10ms
      Rte_Ev_Cyclic2_Task_5ms_0_5ms
      Rte_Ev_Cyclic2_Task_20ms_0_20ms
    Rte_Al_TE2_Task_10ms_0_5ms (OsAlarm): OsAlarmCounterRef=SystemTimer, OsAlarmAccessingApplication=SystemApplication_OsCore0
      OsAlarmAction
        OsAlarmSetEvent: OsAlarmSetEventRef=Rte_Ev_Cyclic2_Task_10ms_0_5ms, OsAlarmSetEventTaskRef=Os/Task_10ms
    Rte_Al_TE2_Task_5ms_0_10ms (OsAlarm): OsAlarmCounterRef=SystemTimer, OsAlarmAccessingApplication=SystemApplication_OsCore0
      OsAlarmAction
        OsAlarmSetEvent: OsAlarmSetEventRef=Rte_Ev_Cyclic2_Task_5ms_0_10ms, OsAlarmSetEventTaskRef=Os/Task_5ms
    3 x OsEvent:
      Rte_Ev_Cyclic2_Task_10ms_0_5ms
      Rte_Ev_Cyclic2_Task_5ms_0_10ms
      Rte_Ev_Run_BswM_BswM_Notification_Dcm_DiagSessionControl_RP
