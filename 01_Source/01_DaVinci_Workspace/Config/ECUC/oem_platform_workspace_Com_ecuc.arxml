AUTOSAR XML (schema 4-2-1)
package /ActiveEcuC
  module config Com: implementation-config-variant=VARIANT-PRE-COMPILE, module-description=Com_Impl
    ComConfig: ComConfigurationId=0, ComRxDeferredNotificationCacheSize=0, ComRxImmediateNotificationCacheSize=0
      ComTimeBase: ComRxTimeBase=0.01, ComTxTimeBase=0.01, ComGwTimeBase=0.01
      SCU_oCAN00_Rx_fcef2243 (ComIPduGroup): ComIPduGroupHandleId=0
      SCU_oCAN00_Tx_fcef2243 (ComIPduGroup): ComIPduGroupHandleId=1
      SCU_DATA_TX (ComIPdu):
        ComIPduDirection = SEND
        ComIPduHandleId = 0
        ComIPduSignalProcessing = IMMEDIATE
        ComIPduType = NORMAL
        ComIPduCancellationSupport = false
        ComPduIdRef = SCU_DATA_TX
        ComIPduGroupRef = SCU_oCAN00_Tx_fcef2243
        ComIPduSignalRef = CarMode
        ComIPduSignalRef = CarModeHS
        ComIPduSignalRef = PowerMode
        ComIPduSignalRef = PowerMode2
        ComTxIPdu: ComMinimumDelayTime=0, ComTxIPduUnusedAreasDefault=0
          ComTxModeFalse
            ComTxMode: ComTxModeMode=NONE, ComTxModeTimePeriod=0.01
          ComTxModeTrue
            ComTxMode: ComTxModeMode=PERIODIC, ComTxModeTimePeriod=0.01
      8 x ComSignal, all with ComSignalInitValue=0, ComSignalAccess=ACCESS_NEEDED_BY_OTHER:
        CarModeHS: ComBitPosition=0, ComSignalEndianness=LITTLE_ENDIAN, ComSignalType=UINT8, ComHandleId=1, ComBitSize=4, ComTransferProperty=TRIGGERED
        CarMode: ComBitPosition=15, ComSignalEndianness=LITTLE_ENDIAN, ComSignalType=BOOLEAN, ComHandleId=0, ComBitSize=1, ComTransferProperty=TRIGGERED
        PowerMode: ComBitPosition=33, ComSignalEndianness=LITTLE_ENDIAN, ComSignalType=BOOLEAN, ComHandleId=2, ComBitSize=1, ComTransferProperty=TRIGGERED
        PowerMode2: ComBitPosition=40, ComSignalEndianness=LITTLE_ENDIAN, ComSignalType=UINT8, ComHandleId=3, ComBitSize=5, ComTransferProperty=TRIGGERED
        EMEndSpeedESA: ComBitPosition=16, ComSignalEndianness=LITTLE_ENDIAN, ComSignalType=UINT8, ComHandleId=1, ComBitSize=7
        EMDurationMaxESA: ComBitPosition=34, ComSignalEndianness=LITTLE_ENDIAN, ComSignalType=UINT8, ComHandleId=0, ComBitSize=5
        EMTorqueLimitESA: ComBitPosition=50, ComSignalEndianness=LITTLE_ENDIAN, ComSignalType=UINT8, ComHandleId=3, ComBitSize=6
        EMSpeedGradientESA: ComBitPosition=49, ComSignalEndianness=BIG_ENDIAN, ComSignalType=UINT16, ComHandleId=2, ComBitSize=10
      SCU_DATA_RX (ComIPdu):
        ComIPduDirection = RECEIVE
        ComIPduHandleId = 0
        ComIPduSignalProcessing = IMMEDIATE
        ComIPduType = NORMAL
        ComIPduCancellationSupport = false
        ComPduIdRef = SCU_DATA_RX
        ComIPduGroupRef = SCU_oCAN00_Rx_fcef2243
        ComIPduSignalRef = EMDurationMaxESA
        ComIPduSignalRef = EMEndSpeedESA
        ComIPduSignalRef = EMSpeedGradientESA
        ComIPduSignalRef = EMTorqueLimitESA
    ComGeneral:
      ComConfigurationUseDet = false
      ComEnableSignalGroupArrayApi = false
      ComRetryFailedTransmitRequests = true
      ComSupportedIPduGroups = 2
      ComVersionInfoApi = true
      ComAdvancedIPduCallouts = true
      ComOptimizedIPduGroupHandling = false
      ComMetaDataSupport = false
      ComReceiveSignalMacroAPI = false
      ComDeferredEventCacheSupport = false
      ComMainfunctionTimingDomainSupport = false
      ComDescriptionRoutingCodeGeneration = false
      ComSafeBswChecks = false
      ComDescriptionGateway = false
      ComSignalGateway = false
    ComGeneration:
      ComOutOfBoundsWriteProtectionStrategy = NONE
      ComOutOfBoundsWriteSanitizer = false
      ComOutOfBoundsReadSanitizer = false
      ComReduceConstantData2Define = false
      ComBoolDataInArrayOfStructStrategy = BOOLEAN
      ComDeduplicateIndirectedData = true
      ComDataDeduplicationStrategy = WITH_CAST
      ComReduceBoolDataByNegationThreshold = 2
      ComReduceBoolDataByNumericalComparisonThreshold = 2
      ComReduceBoolDataByNumericalRelationThreshold = 2
      ComReduceBoolDataByNumericalOperandStrategy = WITH_ANY_VALUE
      ComReduceNumericalDataByOffsetThreshold = 2
      ComReduceNumericalDataByArraySubtractionThreshold = 2
      ComReduceDataByStreaming = false
      ComShortSymbols = false
      ComInterfacesForDeactivatedData = false
      ComReferringKeysInComments = false
    ComOptimization:
      ComTxCyclicProcessingISRLockThreshold = 1
      ComTxDeadlineMonitoringISRLockThreshold = 1
      ComTxProcessingISRLockThreshold = 1
      ComRxDeadlineMonitoringISRLockThreshold = 1
      ComRxDeferredProcessingISRLockThreshold = 1
      ComGatewayProcessingISRLockThreshold = 1
      ComGatewayDescriptionProcessingISRLockThreshold = 1
      ComIPduGroupISRLockThreshold = 1
