AUTOSAR XML (schema 4-2-1)
package /ActiveEcuC
  module config Rte: implementation-config-variant=VARIANT-PRE-COMPILE, module-description=Rte_Impl
    RteInitializationBehavior: RteInitializationStrategy=RTE_INITIALIZATION_STRATEGY_AT_DATA_DECLARATION, RteSectionInitializationPolicy=INIT
    RteGeneration:
      RteGenerationMode = COMPATIBILITY_MODE
      RteIocInteractionReturnValue = RTE_IOC
      RteValueRangeCheckEnabled = false
      RteCalibrationSupport = NONE
      RteCodeVendorId = 30
      RteDevErrorDetect = false
      RteDevErrorDetectUninit = false
      RteMeasurementSupport = false
      RteOptimizationMode = MEMORY
      RteVfbTraceEnabled = false
      RteVttVfbTraceFunction = Rte_Vtt_Task_Dispatch
      RteVttVfbTraceFunction = Rte_Vtt_Task_WaitEventRet
    RteBswGeneral: RteSchMVersionInfoApi=false, RteUseComShadowSignalApi=false
    RteOsInteraction
      5 x RteUsedOsActivation, all with RteExpectedActivationOffset=0, RteExpectedTickDuration=0:
        Rte_Al_TE2_Task_10ms_0_10ms: RteActivationOsAlarmRef=Rte_Al_TE2_Task_10ms_0_10ms, RteActivationOsTaskRef=Task_10ms
        Rte_Al_TE2_Task_20ms_0_20ms: RteActivationOsAlarmRef=Rte_Al_TE2_Task_20ms_0_20ms, RteActivationOsTaskRef=Task_20ms
        Rte_Al_TE2_Task_5ms_0_5ms: RteActivationOsAlarmRef=Rte_Al_TE2_Task_5ms_0_5ms, RteActivationOsTaskRef=Task_5ms
        Rte_Al_TE2_Task_10ms_0_5ms: RteActivationOsAlarmRef=Rte_Al_TE2_Task_10ms_0_5ms, RteActivationOsTaskRef=Task_10ms
        Rte_Al_TE2_Task_5ms_0_10ms: RteActivationOsAlarmRef=Rte_Al_TE2_Task_5ms_0_10ms, RteActivationOsTaskRef=Task_5ms
    4 x RteBswModuleInstance:
      Com: RteBswImplementationRef=Com_Impl, RteBswModuleConfigurationRef=Com
        Com_MainFunctionTxTimingEvent0 (RteBswEventToTaskMapping):
          RteBswImmediateRestart = false
          RteBswPositionInTask = 5
          RteBswEventRef = Com_MainFunctionTxTimingEvent0
          RteBswMappedToTaskRef = Task_5ms
          RteBswUsedOsEventRef = Rte_Ev_Cyclic2_Task_5ms_0_10ms
          RteBswUsedOsAlarmRef = Rte_Al_TE2_Task_5ms_0_10ms
        Com_MainFunctionRxTimingEvent0 (RteBswEventToTaskMapping):
          RteBswImmediateRestart = false
          RteBswPositionInTask = 4
          RteBswEventRef = Com_MainFunctionRxTimingEvent0
          RteBswMappedToTaskRef = Task_5ms
          RteBswUsedOsEventRef = Rte_Ev_Cyclic2_Task_5ms_0_10ms
          RteBswUsedOsAlarmRef = Rte_Al_TE2_Task_5ms_0_10ms
        3 x RteBswExclusiveAreaImpl, all with RteExclusiveAreaImplMechanism=ALL_INTERRUPT_BLOCKING:
          COM_EXCLUSIVE_AREA_TX: RteBswExclusiveAreaRef=COM_EXCLUSIVE_AREA_TX
          COM_EXCLUSIVE_AREA_RX: RteBswExclusiveAreaRef=COM_EXCLUSIVE_AREA_RX
          COM_EXCLUSIVE_AREA_BOTH: RteBswExclusiveAreaRef=COM_EXCLUSIVE_AREA_BOTH
      ComM: RteBswImplementationRef=ComM_Impl, RteBswModuleConfigurationRef=ComM
        ComM_MainFunction_0TimingEvent0 (RteBswEventToTaskMapping):
          RteBswImmediateRestart = false
          RteBswPositionInTask = 0
          RteBswEventRef = ComM_MainFunction_0TimingEvent0
          RteBswMappedToTaskRef = Task_20ms
          RteBswUsedOsEventRef = Rte_Ev_Cyclic2_Task_20ms_0_20ms
          RteBswUsedOsAlarmRef = Rte_Al_TE2_Task_20ms_0_20ms
        COMM_EXCLUSIVE_AREA_0 (RteBswExclusiveAreaImpl): RteExclusiveAreaImplMechanism=ALL_INTERRUPT_BLOCKING, RteBswExclusiveAreaRef=COMM_EXCLUSIVE_AREA_0
        COMM_EXCLUSIVE_AREA_1 (RteBswExclusiveAreaImpl): RteExclusiveAreaImplMechanism=ALL_INTERRUPT_BLOCKING, RteBswExclusiveAreaRef=COMM_EXCLUSIVE_AREA_1
        ComM_MainFunction_1TimingEvent0 (RteBswEventToTaskMapping): RteBswImmediateRestart=false, RteBswEventRef=ComM_MainFunction_1TimingEvent0
      PduR: RteBswImplementationRef=PduR_Impl, RteBswModuleConfigurationRef=PduR
        PDUR_EXCLUSIVE_AREA_0 (RteBswExclusiveAreaImpl): RteExclusiveAreaImplMechanism=ALL_INTERRUPT_BLOCKING, RteBswExclusiveAreaRef=PDUR_EXCLUSIVE_AREA_0
      Rte: RteBswImplementationRef=Rte_Impl, RteBswModuleConfigurationRef=Rte
    4 x RteSwComponentInstance:
      Os_OsCore0_swc_EcuSwComposition: RteSoftwareComponentInstanceRef=Os_OsCore0_swc
        OpEventGetCounterValue_GetCounterValue_OsService_SystemTimer (RteEventToTaskMapping): RteImmediateRestart=false, RteEventRef=OpEventGetCounterValue_GetCounterValue_OsService_SystemTimer
        OpEventGetElapsedValue_GetElapsedValue_OsService_SystemTimer (RteEventToTaskMapping): RteImmediateRestart=false, RteEventRef=OpEventGetElapsedValue_GetElapsedValue_OsService_SystemTimer
      ComM_EcuSwComposition: RteSoftwareComponentInstanceRef=ComM
        13 x RteEventToTaskMapping, all with RteImmediateRestart=false:
          Timer_ComM_MainFunction_0: RtePositionInTask=0, RteEventRef=Timer_ComM_MainFunction_0, RteMappedToTaskRef=Task_20ms, RteUsedOsEventRef=Rte_Ev_Cyclic2_Task_20ms_0_20ms, RteUsedOsAlarmRef=Rte_Al_TE2_Task_20ms_0_20ms
          OpEventLimitECUToNoComMode_LimitECUToNoComMode_modeLimitation: RteEventRef=OpEventLimitECUToNoComMode_LimitECUToNoComMode_modeLimitation
          OpEventReadInhibitCounter_ReadInhibitCounter_modeLimitation: RteEventRef=OpEventReadInhibitCounter_ReadInhibitCounter_modeLimitation
          OpEventResetInhibitCounter_ResetInhibitCounter_modeLimitation: RteEventRef=OpEventResetInhibitCounter_ResetInhibitCounter_modeLimitation
          OpEventSetECUGroupClassification_SetECUGroupClassification_modeLimitation: RteEventRef=OpEventSetECUGroupClassification_SetECUGroupClassification_modeLimitation
          OpEventGetCurrentComMode_GetCurrentComMode_UR_USR_CHNL_f276589c: RteEventRef=OpEventGetCurrentComMode_GetCurrentComMode_UR_USR_CHNL_f276589c
          OpEventRequestComMode_RequestComMode_UR_USR_CHNL_f276589c: RteEventRef=OpEventRequestComMode_RequestComMode_UR_USR_CHNL_f276589c
          OpEventLimitChannelToNoComMode_LimitChannelToNoComMode_CL_CAN00_f26020e5: RteEventRef=OpEventLimitChannelToNoComMode_LimitChannelToNoComMode_CL_CAN00_f26020e5
          OpEventGetRequestedComMode_GetRequestedComMode_UR_USR_CHNL_f276589c: RteEventRef=OpEventGetRequestedComMode_GetRequestedComMode_UR_USR_CHNL_f276589c
          OpEventGetInhibitionStatus_GetInhibitionStatus_CL_CAN00_f26020e5: RteEventRef=OpEventGetInhibitionStatus_GetInhibitionStatus_CL_CAN00_f26020e5
          OpEventGetMaxComMode_GetMaxComMode_UR_USR_CHNL_f276589c: RteEventRef=OpEventGetMaxComMode_GetMaxComMode_UR_USR_CHNL_f276589c
          OpEventPreventWakeUp_PreventWakeUp_CW_CAN00_f26020e5: RteEventRef=OpEventPreventWakeUp_PreventWakeUp_CW_CAN00_f26020e5
          OpEventGetInhibitionStatus_GetInhibitionStatus_CW_CAN00_f26020e5: RteEventRef=OpEventGetInhibitionStatus_GetInhibitionStatus_CW_CAN00_f26020e5
      BswM_EcuSwComposition: RteSoftwareComponentInstanceRef=BswM
        4 x RteEventToTaskMapping, all with RteImmediateRestart=false, RteMappedToTaskRef=Task_10ms:
          Timer_BswM_MainFunction: RtePositionInTask=0, RteEventRef=Timer_BswM_MainFunction, RteUsedOsEventRef=Rte_Ev_Cyclic2_Task_10ms_0_10ms, RteUsedOsAlarmRef=Rte_Al_TE2_Task_10ms_0_10ms
          MST_BswM_Notification_Dcm_DiagSessionControl_RP_Notification_Dcm_DiagSessionControl_RP_ON_ENTRY_DEFAULT_SESSION: RtePositionInTask=1, RteEventRef=MST_BswM_Notification_Dcm_DiagSessionControl_RP_Notification_Dcm_DiagSessionControl_RP_ON_ENTRY_DEFAULT_SESSION, RteUsedOsEventRef=Rte_Ev_Run_BswM_BswM_Notification_Dcm_DiagSessionControl_RP
          MST_BswM_Notification_Dcm_DiagSessionControl_RP_Notification_Dcm_DiagSessionControl_RP_ON_ENTRY_PROGRAMMING_SESSION: RtePositionInTask=1, RteEventRef=MST_BswM_Notification_Dcm_DiagSessionControl_RP_Notification_Dcm_DiagSessionControl_RP_ON_ENTRY_PROGRAMMING_SESSION, RteUsedOsEventRef=Rte_Ev_Run_BswM_BswM_Notification_Dcm_DiagSessionControl_RP
          MST_BswM_Notification_Dcm_DiagSessionControl_RP_Notification_Dcm_DiagSessionControl_RP_ON_ENTRY_EXTENDED_SESSION: RtePositionInTask=1, RteEventRef=MST_BswM_Notification_Dcm_DiagSessionControl_RP_Notification_Dcm_DiagSessionControl_RP_ON_ENTRY_EXTENDED_SESSION, RteUsedOsEventRef=Rte_Ev_Run_BswM_BswM_Notification_Dcm_DiagSessionControl_RP
      EcuM_EcuSwComposition: RteSoftwareComponentInstanceRef=EcuM
        8 x RteEventToTaskMapping, all with RteImmediateRestart=false:
          Timer_EcuM_MainFunction: RtePositionInTask=3, RteEventRef=Timer_EcuM_MainFunction, RteMappedToTaskRef=Task_10ms, RteUsedOsEventRef=Rte_Ev_Cyclic2_Task_10ms_0_10ms, RteUsedOsAlarmRef=Rte_Al_TE2_Task_10ms_0_10ms
          OpEventGetLastShutdownTarget_GetLastShutdownTarget_EcuM_ShutdownTarget: RteEventRef=OpEventGetLastShutdownTarget_GetLastShutdownTarget_EcuM_ShutdownTarget
          OpEventGetShutdownCause_GetShutdownCause_EcuM_ShutdownTarget: RteEventRef=OpEventGetShutdownCause_GetShutdownCause_EcuM_ShutdownTarget
          OpEventGetShutdownTarget_GetShutdownTarget_EcuM_ShutdownTarget: RteEventRef=OpEventGetShutdownTarget_GetShutdownTarget_EcuM_ShutdownTarget
          OpEventSelectShutdownCause_SelectShutdownCause_EcuM_ShutdownTarget: RteEventRef=OpEventSelectShutdownCause_SelectShutdownCause_EcuM_ShutdownTarget
          OpEventSelectBootTarget_SelectBootTarget_EcuM_BootTarget: RteEventRef=OpEventSelectBootTarget_SelectBootTarget_EcuM_BootTarget
          OpEventGetBootTarget_GetBootTarget_EcuM_BootTarget: RteEventRef=OpEventGetBootTarget_GetBootTarget_EcuM_BootTarget
          OpEventSelectShutdownTarget_SelectShutdownTarget_EcuM_ShutdownTarget: RteEventRef=OpEventSelectShutdownTarget_SelectShutdownTarget_EcuM_ShutdownTarget
    3 x RteBswModuleInstance:
      Dcm: RteBswImplementationRef=Dcm_Impl, RteBswModuleConfigurationRef=Dcm
        DCM_EXCLUSIVE_AREA_0 (RteBswExclusiveAreaImpl): RteExclusiveAreaImplMechanism=ALL_INTERRUPT_BLOCKING, RteBswExclusiveAreaRef=DCM_EXCLUSIVE_AREA_0
        Dcm_MainFunctionTimingEvent0 (RteBswEventToTaskMapping):
          RteBswImmediateRestart = false
          RteBswPositionInTask = 5
          RteBswEventRef = Dcm_MainFunctionTimingEvent0
          RteBswMappedToTaskRef = Task_10ms
          RteBswUsedOsEventRef = Rte_Ev_Cyclic2_Task_10ms_0_10ms
          RteBswUsedOsAlarmRef = Rte_Al_TE2_Task_10ms_0_10ms
      Mcu: RteBswImplementationRef=BswImplementation_0, RteBswModuleConfigurationRef=Mcu
      Dem: RteBswImplementationRef=Dem_Impl, RteBswModuleConfigurationRef=Dem
        Dem_MasterMainFunctionTimingEvent0 (RteBswEventToTaskMapping):
          RteBswImmediateRestart = false
          RteBswPositionInTask = 4
          RteBswEventRef = Dem_MasterMainFunctionTimingEvent0
          RteBswMappedToTaskRef = Task_10ms
          RteBswUsedOsEventRef = Rte_Ev_Cyclic2_Task_10ms_0_5ms
          RteBswUsedOsAlarmRef = Rte_Al_TE2_Task_10ms_0_5ms
        Dem_SatelliteMainFunctionTimingEvent0 (RteBswEventToTaskMapping):
          RteBswImmediateRestart = false
          RteBswPositionInTask = 6
          RteBswEventRef = Dem_SatelliteMainFunctionTimingEvent0
          RteBswMappedToTaskRef = Task_10ms
          RteBswUsedOsEventRef = Rte_Ev_Cyclic2_Task_10ms_0_5ms
          RteBswUsedOsAlarmRef = Rte_Al_TE2_Task_10ms_0_5ms
        5 x RteBswExclusiveAreaImpl, all with RteExclusiveAreaImplMechanism=ALL_INTERRUPT_BLOCKING:
          DEM_EXCLUSIVE_AREA_{0..4}: RteBswExclusiveAreaRef=DEM_EXCLUSIVE_AREA_{0..4}
    3 x RteSwComponentInstance:
      Dcm_EcuSwComposition: RteSoftwareComponentInstanceRef=Dcm
        6 x RteEventToTaskMapping, all with RteImmediateRestart=false:
          Timer_Dcm_MainFunction: RtePositionInTask=5, RteEventRef=Timer_Dcm_MainFunction, RteMappedToTaskRef=Task_10ms, RteUsedOsEventRef=Rte_Ev_Cyclic2_Task_10ms_0_10ms, RteUsedOsAlarmRef=Rte_Al_TE2_Task_10ms_0_10ms
          OpEventGetActiveProtocol_GetActiveProtocol_DCMServices: RteEventRef=OpEventGetActiveProtocol_GetActiveProtocol_DCMServices
          OpEventGetSesCtrlType_GetSesCtrlType_DCMServices: RteEventRef=OpEventGetSesCtrlType_GetSesCtrlType_DCMServices
          OpEventResetToDefaultSession_ResetToDefaultSession_DCMServices: RteEventRef=OpEventResetToDefaultSession_ResetToDefaultSession_DCMServices
          OpEventSetActiveDiagnostic_SetActiveDiagnostic_DCMServices: RteEventRef=OpEventSetActiveDiagnostic_SetActiveDiagnostic_DCMServices
          OpEventGetRequestKind_GetRequestKind_DCMServices: RteEventRef=OpEventGetRequestKind_GetRequestKind_DCMServices
      DemMaster_0_EcuSwComposition: RteSoftwareComponentInstanceRef=DemMaster_0
        20 x RteEventToTaskMapping, all with RteImmediateRestart=false:
          Timer_Dem_MasterMainFunction: RtePositionInTask=4, RteEventRef=Timer_Dem_MasterMainFunction, RteMappedToTaskRef=Task_10ms, RteUsedOsEventRef=Rte_Ev_Cyclic2_Task_10ms_0_5ms, RteUsedOsAlarmRef=Rte_Al_TE2_Task_10ms_0_5ms
          OpEventPostRunRequested_GetPostRunRequested_DemServices: RteEventRef=OpEventPostRunRequested_GetPostRunRequested_DemServices
          OpEventGetDTCStatusAvailabilityMask_GetDTCStatusAvailabilityMask_DemServices: RteEventRef=OpEventGetDTCStatusAvailabilityMask_GetDTCStatusAvailabilityMask_DemServices
          OpEventClearDTC_ClearDTC_ClearDTC_DemClient: RteEventRef=OpEventClearDTC_ClearDTC_ClearDTC_DemClient
          OpEventSelectDTC_SelectDTC_ClearDTC_DemClient: RteEventRef=OpEventSelectDTC_SelectDTC_ClearDTC_DemClient
          OpEventGetNumberOfEventMemoryEntries_GetNumberOfEventMemoryEntries_OverflowIndPrimaryMemory_DemClient: RteEventRef=OpEventGetNumberOfEventMemoryEntries_GetNumberOfEventMemoryEntries_OverflowIndPrimaryMemory_DemClient
          OpEventGetEventMemoryOverflow_GetEventMemoryOverflow_OverflowIndPrimaryMemory_DemClient: RteEventRef=OpEventGetEventMemoryOverflow_GetEventMemoryOverflow_OverflowIndPrimaryMemory_DemClient
          OpEventGetOperationCycleState_GetOperationCycleState_OpCycle_DemOperationCycle: RteEventRef=OpEventGetOperationCycleState_GetOperationCycleState_OpCycle_DemOperationCycle
          OpEventSetOperationCycleState_SetOperationCycleState_OpCycle_DemOperationCycle: RteEventRef=OpEventSetOperationCycleState_SetOperationCycleState_OpCycle_DemOperationCycle
          OpEventGetEventUdsStatus_GetEventUdsStatus_GeneralEvtInfo: RteEventRef=OpEventGetEventUdsStatus_GetEventUdsStatus_GeneralEvtInfo
          OpEventGetEventStatus_GetEventStatus_GeneralEvtInfo: RteEventRef=OpEventGetEventStatus_GetEventStatus_GeneralEvtInfo
          OpEventGetEventFailed_GetEventFailed_GeneralEvtInfo: RteEventRef=OpEventGetEventFailed_GetEventFailed_GeneralEvtInfo
          OpEventGetEventTested_GetEventTested_GeneralEvtInfo: RteEventRef=OpEventGetEventTested_GetEventTested_GeneralEvtInfo
          OpEventGetDTCOfEvent_GetDTCOfEvent_GeneralEvtInfo: RteEventRef=OpEventGetDTCOfEvent_GetDTCOfEvent_GeneralEvtInfo
          OpEventGetFaultDetectionCounter_GetFaultDetectionCounter_GeneralEvtInfo: RteEventRef=OpEventGetFaultDetectionCounter_GetFaultDetectionCounter_GeneralEvtInfo
          OpEventGetEventFreezeFrameDataEx_GetEventFreezeFrameDataEx_GeneralEvtInfo: RteEventRef=OpEventGetEventFreezeFrameDataEx_GetEventFreezeFrameDataEx_GeneralEvtInfo
          OpEventGetEventExtendedDataRecordEx_GetEventExtendedDataRecordEx_GeneralEvtInfo: RteEventRef=OpEventGetEventExtendedDataRecordEx_GetEventExtendedDataRecordEx_GeneralEvtInfo
          OpEventGetEventEnableCondition_GetEventEnableCondition_GeneralEvtInfo: RteEventRef=OpEventGetEventEnableCondition_GetEventEnableCondition_GeneralEvtInfo
          OpEventGetDebouncingOfEvent_GetDebouncingOfEvent_GeneralEvtInfo: RteEventRef=OpEventGetDebouncingOfEvent_GetDebouncingOfEvent_GeneralEvtInfo
          OpEventGetMonitorStatus_GetMonitorStatus_GeneralEvtInfo: RteEventRef=OpEventGetMonitorStatus_GetMonitorStatus_GeneralEvtInfo
      DemSatellite_0_EcuSwComposition: RteSoftwareComponentInstanceRef=DemSatellite_0
        67 x RteEventToTaskMapping, all with RteImmediateRestart=false:
          Timer_Dem_SatelliteMainFunction: RtePositionInTask=6, RteEventRef=Timer_Dem_SatelliteMainFunction, RteMappedToTaskRef=Task_10ms, RteUsedOsEventRef=Rte_Ev_Cyclic2_Task_10ms_0_5ms, RteUsedOsAlarmRef=Rte_Al_TE2_Task_10ms_0_5ms
          OpEventGetEventUdsStatus_GetEventUdsStatus_EvtInfo_DemEventParameter_MCAL: RteEventRef=OpEventGetEventUdsStatus_GetEventUdsStatus_EvtInfo_DemEventParameter_MCAL
          OpEventGetEventUdsStatus_GetEventUdsStatus_Event_DemEventParameter_MCAL: RteEventRef=OpEventGetEventUdsStatus_GetEventUdsStatus_Event_DemEventParameter_MCAL
          OpEventGetEventStatus_GetEventStatus_EvtInfo_DemEventParameter_MCAL: RteEventRef=OpEventGetEventStatus_GetEventStatus_EvtInfo_DemEventParameter_MCAL
          OpEventGetEventStatus_GetEventStatus_Event_DemEventParameter_MCAL: RteEventRef=OpEventGetEventStatus_GetEventStatus_Event_DemEventParameter_MCAL
          OpEventGetEventFailed_GetEventFailed_EvtInfo_DemEventParameter_MCAL: RteEventRef=OpEventGetEventFailed_GetEventFailed_EvtInfo_DemEventParameter_MCAL
          OpEventGetEventFailed_GetEventFailed_Event_DemEventParameter_MCAL: RteEventRef=OpEventGetEventFailed_GetEventFailed_Event_DemEventParameter_MCAL
          OpEventGetEventTested_GetEventTested_EvtInfo_DemEventParameter_MCAL: RteEventRef=OpEventGetEventTested_GetEventTested_EvtInfo_DemEventParameter_MCAL
          OpEventGetEventTested_GetEventTested_Event_DemEventParameter_MCAL: RteEventRef=OpEventGetEventTested_GetEventTested_Event_DemEventParameter_MCAL
          OpEventGetDTCOfEvent_GetDTCOfEvent_EvtInfo_DemEventParameter_MCAL: RteEventRef=OpEventGetDTCOfEvent_GetDTCOfEvent_EvtInfo_DemEventParameter_MCAL
          OpEventGetDTCOfEvent_GetDTCOfEvent_Event_DemEventParameter_MCAL: RteEventRef=OpEventGetDTCOfEvent_GetDTCOfEvent_Event_DemEventParameter_MCAL
          OpEventGetFaultDetectionCounter_GetFaultDetectionCounter_EvtInfo_DemEventParameter_MCAL: RteEventRef=OpEventGetFaultDetectionCounter_GetFaultDetectionCounter_EvtInfo_DemEventParameter_MCAL
          OpEventGetFaultDetectionCounter_GetFaultDetectionCounter_Event_DemEventParameter_MCAL: RteEventRef=OpEventGetFaultDetectionCounter_GetFaultDetectionCounter_Event_DemEventParameter_MCAL
          OpEventGetEventFreezeFrameDataEx_GetEventFreezeFrameDataEx_EvtInfo_DemEventParameter_MCAL: RteEventRef=OpEventGetEventFreezeFrameDataEx_GetEventFreezeFrameDataEx_EvtInfo_DemEventParameter_MCAL
          OpEventGetEventFreezeFrameDataEx_GetEventFreezeFrameDataEx_Event_DemEventParameter_MCAL: RteEventRef=OpEventGetEventFreezeFrameDataEx_GetEventFreezeFrameDataEx_Event_DemEventParameter_MCAL
          OpEventGetEventExtendedDataRecordEx_GetEventExtendedDataRecordEx_EvtInfo_DemEventParameter_MCAL: RteEventRef=OpEventGetEventExtendedDataRecordEx_GetEventExtendedDataRecordEx_EvtInfo_DemEventParameter_MCAL
          OpEventGetEventExtendedDataRecordEx_GetEventExtendedDataRecordEx_Event_DemEventParameter_MCAL: RteEventRef=OpEventGetEventExtendedDataRecordEx_GetEventExtendedDataRecordEx_Event_DemEventParameter_MCAL
          OpEventGetEventEnableCondition_GetEventEnableCondition_EvtInfo_DemEventParameter_MCAL: RteEventRef=OpEventGetEventEnableCondition_GetEventEnableCondition_EvtInfo_DemEventParameter_MCAL
          OpEventGetDebouncingOfEvent_GetDebouncingOfEvent_EvtInfo_DemEventParameter_MCAL: RteEventRef=OpEventGetDebouncingOfEvent_GetDebouncingOfEvent_EvtInfo_DemEventParameter_MCAL
          OpEventGetMonitorStatus_GetMonitorStatus_EvtInfo_DemEventParameter_MCAL: RteEventRef=OpEventGetMonitorStatus_GetMonitorStatus_EvtInfo_DemEventParameter_MCAL
          OpEventSetEventStatus_SetEventStatus_Event_DemEventParameter_MCAL: RteEventRef=OpEventSetEventStatus_SetEventStatus_Event_DemEventParameter_MCAL
          OpEventResetEventStatus_ResetEventStatus_Event_DemEventParameter_MCAL: RteEventRef=OpEventResetEventStatus_ResetEventStatus_Event_DemEventParameter_MCAL
          OpEventResetEventDebounceStatus_ResetEventDebounceStatus_Event_DemEventParameter_MCAL: RteEventRef=OpEventResetEventDebounceStatus_ResetEventDebounceStatus_Event_DemEventParameter_MCAL
          OpEventGetEventFailed_GetEventFailed_EvtInfo_DemEventParameter_NVM_E_WRITE_FAILED: RteEventRef=OpEventGetEventFailed_GetEventFailed_EvtInfo_DemEventParameter_NVM_E_WRITE_FAILED
          OpEventGetEventTested_GetEventTested_EvtInfo_DemEventParameter_NVM_E_WRITE_FAILED: RteEventRef=OpEventGetEventTested_GetEventTested_EvtInfo_DemEventParameter_NVM_E_WRITE_FAILED
          OpEventGetEventFreezeFrameDataEx_GetEventFreezeFrameDataEx_EvtInfo_DemEventParameter: RteEventRef=OpEventGetEventFreezeFrameDataEx_GetEventFreezeFrameDataEx_EvtInfo_DemEventParameter
          OpEventGetDebouncingOfEvent_GetDebouncingOfEvent_EvtInfo_DemEventParameter_NVM_E_WRITE_FAILED: RteEventRef=OpEventGetDebouncingOfEvent_GetDebouncingOfEvent_EvtInfo_DemEventParameter_NVM_E_WRITE_FAILED
          OpEventGetEventExtendedDataRecordEx_GetEventExtendedDataRecordEx_EvtInfo_DemEventParameter_NVM_E_WRITE_FAILED: RteEventRef=OpEventGetEventExtendedDataRecordEx_GetEventExtendedDataRecordEx_EvtInfo_DemEventParameter_NVM_E_WRITE_FAILED
          OpEventGetEventStatus_GetEventStatus_Event_DemEventParameter: RteEventRef=OpEventGetEventStatus_GetEventStatus_Event_DemEventParameter
          OpEventGetEventFailed_GetEventFailed_Event_DemEventParameter: RteEventRef=OpEventGetEventFailed_GetEventFailed_Event_DemEventParameter
          OpEventResetEventStatus_ResetEventStatus_Event_DemEventParameter: RteEventRef=OpEventResetEventStatus_ResetEventStatus_Event_DemEventParameter
          OpEventGetEventEnableCondition_GetEventEnableCondition_EvtInfo_DemEventParameter: RteEventRef=OpEventGetEventEnableCondition_GetEventEnableCondition_EvtInfo_DemEventParameter
          OpEventGetFaultDetectionCounter_GetFaultDetectionCounter_EvtInfo_DemEventParameter_NVM_E_WRITE_FAILED: RteEventRef=OpEventGetFaultDetectionCounter_GetFaultDetectionCounter_EvtInfo_DemEventParameter_NVM_E_WRITE_FAILED
          OpEventGetDebouncingOfEvent_GetDebouncingOfEvent_EvtInfo_DemEventParameter: RteEventRef=OpEventGetDebouncingOfEvent_GetDebouncingOfEvent_EvtInfo_DemEventParameter
          OpEventGetMonitorStatus_GetMonitorStatus_EvtInfo_DemEventParameter: RteEventRef=OpEventGetMonitorStatus_GetMonitorStatus_EvtInfo_DemEventParameter
          OpEventGetFaultDetectionCounter_GetFaultDetectionCounter_EvtInfo_DemEventParameter: RteEventRef=OpEventGetFaultDetectionCounter_GetFaultDetectionCounter_EvtInfo_DemEventParameter
          OpEventGetEventExtendedDataRecordEx_GetEventExtendedDataRecordEx_EvtInfo_DemEventParameter: RteEventRef=OpEventGetEventExtendedDataRecordEx_GetEventExtendedDataRecordEx_EvtInfo_DemEventParameter
          OpEventGetDTCOfEvent_GetDTCOfEvent_EvtInfo_DemEventParameter: RteEventRef=OpEventGetDTCOfEvent_GetDTCOfEvent_EvtInfo_DemEventParameter
          OpEventGetEventFreezeFrameDataEx_GetEventFreezeFrameDataEx_EvtInfo_DemEventParameter_NVM_E_WRITE_FAILED: RteEventRef=OpEventGetEventFreezeFrameDataEx_GetEventFreezeFrameDataEx_EvtInfo_DemEventParameter_NVM_E_WRITE_FAILED
          OpEventGetFaultDetectionCounter_GetFaultDetectionCounter_Event_DemEventParameter: RteEventRef=OpEventGetFaultDetectionCounter_GetFaultDetectionCounter_Event_DemEventParameter
          OpEventGetEventTested_GetEventTested_EvtInfo_DemEventParameter: RteEventRef=OpEventGetEventTested_GetEventTested_EvtInfo_DemEventParameter
          OpEventGetEventExtendedDataRecordEx_GetEventExtendedDataRecordEx_Event_DemEventParameter: RteEventRef=OpEventGetEventExtendedDataRecordEx_GetEventExtendedDataRecordEx_Event_DemEventParameter
          OpEventGetEventUdsStatus_GetEventUdsStatus_EvtInfo_DemEventParameter: RteEventRef=OpEventGetEventUdsStatus_GetEventUdsStatus_EvtInfo_DemEventParameter
          OpEventResetEventDebounceStatus_ResetEventDebounceStatus_Event_DemEventParameter: RteEventRef=OpEventResetEventDebounceStatus_ResetEventDebounceStatus_Event_DemEventParameter
          OpEventGetEventUdsStatus_GetEventUdsStatus_EvtInfo_DemEventParameter_NVM_E_WRITE_FAILED: RteEventRef=OpEventGetEventUdsStatus_GetEventUdsStatus_EvtInfo_DemEventParameter_NVM_E_WRITE_FAILED
          OpEventGetEventStatus_GetEventStatus_EvtInfo_DemEventParameter_NVM_E_WRITE_FAILED: RteEventRef=OpEventGetEventStatus_GetEventStatus_EvtInfo_DemEventParameter_NVM_E_WRITE_FAILED
          OpEventGetEventFailed_GetEventFailed_EvtInfo_DemEventParameter: RteEventRef=OpEventGetEventFailed_GetEventFailed_EvtInfo_DemEventParameter
          OpEventGetMonitorStatus_GetMonitorStatus_EvtInfo_DemEventParameter_NVM_E_WRITE_FAILED: RteEventRef=OpEventGetMonitorStatus_GetMonitorStatus_EvtInfo_DemEventParameter_NVM_E_WRITE_FAILED
          OpEventGetEventStatus_GetEventStatus_EvtInfo_DemEventParameter: RteEventRef=OpEventGetEventStatus_GetEventStatus_EvtInfo_DemEventParameter
          OpEventGetDTCOfEvent_GetDTCOfEvent_EvtInfo_DemEventParameter_NVM_E_WRITE_FAILED: RteEventRef=OpEventGetDTCOfEvent_GetDTCOfEvent_EvtInfo_DemEventParameter_NVM_E_WRITE_FAILED
          OpEventGetEventFreezeFrameDataEx_GetEventFreezeFrameDataEx_Event_DemEventParameter: RteEventRef=OpEventGetEventFreezeFrameDataEx_GetEventFreezeFrameDataEx_Event_DemEventParameter
          OpEventSetEventStatus_SetEventStatus_Event_DemEventParameter: RteEventRef=OpEventSetEventStatus_SetEventStatus_Event_DemEventParameter
          OpEventGetEventEnableCondition_GetEventEnableCondition_EvtInfo_DemEventParameter_NVM_E_WRITE_FAILED: RteEventRef=OpEventGetEventEnableCondition_GetEventEnableCondition_EvtInfo_DemEventParameter_NVM_E_WRITE_FAILED
          OpEventGetEventUdsStatus_GetEventUdsStatus_Event_DemEventParameter: RteEventRef=OpEventGetEventUdsStatus_GetEventUdsStatus_Event_DemEventParameter
          OpEventGetDTCOfEvent_GetDTCOfEvent_Event_DemEventParameter: RteEventRef=OpEventGetDTCOfEvent_GetDTCOfEvent_Event_DemEventParameter
          OpEventGetEventTested_GetEventTested_Event_DemEventParameter: RteEventRef=OpEventGetEventTested_GetEventTested_Event_DemEventParameter
          OpEventGetEventUdsStatus_GetEventUdsStatus_GeneralEvtInfo: RteEventRef=OpEventGetEventUdsStatus_GetEventUdsStatus_GeneralEvtInfo
          OpEventGetEventStatus_GetEventStatus_GeneralEvtInfo: RteEventRef=OpEventGetEventStatus_GetEventStatus_GeneralEvtInfo
          OpEventGetEventFailed_GetEventFailed_GeneralEvtInfo: RteEventRef=OpEventGetEventFailed_GetEventFailed_GeneralEvtInfo
          OpEventGetEventTested_GetEventTested_GeneralEvtInfo: RteEventRef=OpEventGetEventTested_GetEventTested_GeneralEvtInfo
          OpEventGetDTCOfEvent_GetDTCOfEvent_GeneralEvtInfo: RteEventRef=OpEventGetDTCOfEvent_GetDTCOfEvent_GeneralEvtInfo
          OpEventGetFaultDetectionCounter_GetFaultDetectionCounter_GeneralEvtInfo: RteEventRef=OpEventGetFaultDetectionCounter_GetFaultDetectionCounter_GeneralEvtInfo
          OpEventGetEventFreezeFrameDataEx_GetEventFreezeFrameDataEx_GeneralEvtInfo: RteEventRef=OpEventGetEventFreezeFrameDataEx_GetEventFreezeFrameDataEx_GeneralEvtInfo
          OpEventGetEventExtendedDataRecordEx_GetEventExtendedDataRecordEx_GeneralEvtInfo: RteEventRef=OpEventGetEventExtendedDataRecordEx_GetEventExtendedDataRecordEx_GeneralEvtInfo
          OpEventGetEventEnableCondition_GetEventEnableCondition_GeneralEvtInfo: RteEventRef=OpEventGetEventEnableCondition_GetEventEnableCondition_GeneralEvtInfo
          OpEventGetDebouncingOfEvent_GetDebouncingOfEvent_GeneralEvtInfo: RteEventRef=OpEventGetDebouncingOfEvent_GetDebouncingOfEvent_GeneralEvtInfo
          OpEventGetMonitorStatus_GetMonitorStatus_GeneralEvtInfo: RteEventRef=OpEventGetMonitorStatus_GetMonitorStatus_GeneralEvtInfo
    7 x RteBswModuleInstance:
      Fee: RteBswImplementationRef=Fee_Impl, RteBswModuleConfigurationRef=Fee
        FEE_EXCLUSIVE_AREA_0 (RteBswExclusiveAreaImpl): RteExclusiveAreaImplMechanism=ALL_INTERRUPT_BLOCKING, RteBswExclusiveAreaRef=FEE_EXCLUSIVE_AREA_0
        Fee_MainFunctionTimingEvent0 (RteBswEventToTaskMapping):
          RteBswImmediateRestart = false
          RteBswPositionInTask = 1
          RteBswEventRef = Fee_MainFunctionTimingEvent0
          RteBswMappedToTaskRef = Task_5ms
          RteBswUsedOsEventRef = Rte_Ev_Cyclic2_Task_5ms_0_5ms
          RteBswUsedOsAlarmRef = Rte_Al_TE2_Task_5ms_0_5ms
      Fls: RteBswImplementationRef=BswImplementation_0, RteBswModuleConfigurationRef=Fls
        FlsTimingEvent_MainFunction (RteBswEventToTaskMapping):
          RteBswImmediateRestart = false
          RteBswPositionInTask = 7
          RteBswEventRef = FlsTimingEvent_MainFunction
          RteBswMappedToTaskRef = Task_5ms
          RteBswUsedOsEventRef = Rte_Ev_Cyclic2_Task_5ms_0_5ms
          RteBswUsedOsAlarmRef = Rte_Al_TE2_Task_5ms_0_5ms
        6 x RteBswExclusiveAreaImpl, all with RteExclusiveAreaImplMechanism=ALL_INTERRUPT_BLOCKING:
          FLS_EXCLUSIVE_AREA_00: RteBswExclusiveAreaRef=FLS_EXCLUSIVE_AREA_00
          FLS_EXCLUSIVE_AREA_{10..14}: RteBswExclusiveAreaRef=FLS_EXCLUSIVE_AREA_{10..14}
      CanIf: RteBswImplementationRef=CanIf_Impl, RteBswModuleConfigurationRef=CanIf
        8 x RteBswExclusiveAreaImpl, all with RteExclusiveAreaImplMechanism=ALL_INTERRUPT_BLOCKING:
          CANIF_EXCLUSIVE_AREA_{0..7}: RteBswExclusiveAreaRef=CANIF_EXCLUSIVE_AREA_{0..7}
      CanSM: RteBswImplementationRef=CanSM_Impl, RteBswModuleConfigurationRef=CanSM
        5 x RteBswExclusiveAreaImpl, all with RteExclusiveAreaImplMechanism=ALL_INTERRUPT_BLOCKING:
          CANSM_EXCLUSIVE_AREA_{1..5}: RteBswExclusiveAreaRef=CANSM_EXCLUSIVE_AREA_{1..5}
        CanSM_MainFunctionTimingEvent0 (RteBswEventToTaskMapping):
          RteBswImmediateRestart = false
          RteBswPositionInTask = 6
          RteBswEventRef = CanSM_MainFunctionTimingEvent0
          RteBswMappedToTaskRef = Task_5ms
          RteBswUsedOsEventRef = Rte_Ev_Cyclic2_Task_5ms_0_10ms
          RteBswUsedOsAlarmRef = Rte_Al_TE2_Task_5ms_0_10ms
        CANSM_EXCLUSIVE_AREA_6 (RteBswExclusiveAreaImpl): RteExclusiveAreaImplMechanism=ALL_INTERRUPT_BLOCKING, RteBswExclusiveAreaRef=CANSM_EXCLUSIVE_AREA_6
      CanTp: RteBswImplementationRef=CanTp_Impl, RteBswModuleConfigurationRef=CanTp
        CANTP_EXCLUSIVE_AREA_0 (RteBswExclusiveAreaImpl): RteExclusiveAreaImplMechanism=ALL_INTERRUPT_BLOCKING, RteBswExclusiveAreaRef=CANTP_EXCLUSIVE_AREA_0
        CanTp_MainFunctionTimingEvent0 (RteBswEventToTaskMapping):
          RteBswImmediateRestart = false
          RteBswPositionInTask = 3
          RteBswEventRef = CanTp_MainFunctionTimingEvent0
          RteBswMappedToTaskRef = Task_5ms
          RteBswUsedOsEventRef = Rte_Ev_Cyclic2_Task_5ms_0_5ms
          RteBswUsedOsAlarmRef = Rte_Al_TE2_Task_5ms_0_5ms
      EcuM: RteBswImplementationRef=EcuM_Impl, RteBswModuleConfigurationRef=EcuM
        3 x RteBswExclusiveAreaImpl, all with RteExclusiveAreaImplMechanism=ALL_INTERRUPT_BLOCKING:
          ECUM_EXCLUSIVE_AREA_{0..2}: RteBswExclusiveAreaRef=ECUM_EXCLUSIVE_AREA_{0..2}
        EcuM_MainFunctionTimingEvent0 (RteBswEventToTaskMapping):
          RteBswImmediateRestart = false
          RteBswPositionInTask = 3
          RteBswEventRef = EcuM_MainFunctionTimingEvent0
          RteBswMappedToTaskRef = Task_10ms
          RteBswUsedOsEventRef = Rte_Ev_Cyclic2_Task_10ms_0_10ms
          RteBswUsedOsAlarmRef = Rte_Al_TE2_Task_10ms_0_10ms
        ECUM_EXCLUSIVE_AREA_3 (RteBswExclusiveAreaImpl): RteExclusiveAreaImplMechanism=ALL_INTERRUPT_BLOCKING, RteBswExclusiveAreaRef=ECUM_EXCLUSIVE_AREA_3
      Det: RteBswImplementationRef=Det_Impl, RteBswModuleConfigurationRef=Det
        DET_EXCLUSIVE_AREA_0 (RteBswExclusiveAreaImpl): RteExclusiveAreaImplMechanism=ALL_INTERRUPT_BLOCKING, RteBswExclusiveAreaRef=DET_EXCLUSIVE_AREA_0
    Det_EcuSwComposition (RteSwComponentInstance): RteSoftwareComponentInstanceRef=Det
    NvM (RteBswModuleInstance): RteBswImplementationRef=NvM_Impl, RteBswModuleConfigurationRef=NvM
      NvM_MainFunctionTimingEvent0 (RteBswEventToTaskMapping):
        RteBswImmediateRestart = false
        RteBswPositionInTask = 2
        RteBswEventRef = NvM_MainFunctionTimingEvent0
        RteBswMappedToTaskRef = Task_5ms
        RteBswUsedOsEventRef = Rte_Ev_Cyclic2_Task_5ms_0_10ms
        RteBswUsedOsAlarmRef = Rte_Al_TE2_Task_5ms_0_10ms
      NVM_EXCLUSIVE_AREA_0 (RteBswExclusiveAreaImpl): RteExclusiveAreaImplMechanism=ALL_INTERRUPT_BLOCKING, RteBswExclusiveAreaRef=NVM_EXCLUSIVE_AREA_0
    NvM_EcuSwComposition (RteSwComponentInstance): RteSoftwareComponentInstanceRef=NvM
      32 x RteEventToTaskMapping, all with RteImmediateRestart=false:
        Timer_NvM_MainFunction: RtePositionInTask=2, RteEventRef=Timer_NvM_MainFunction, RteMappedToTaskRef=Task_5ms, RteUsedOsEventRef=Rte_Ev_Cyclic2_Task_5ms_0_10ms, RteUsedOsAlarmRef=Rte_Al_TE2_Task_5ms_0_10ms
        OpEventEraseBlock_EraseBlock_PS_StatusOfDTCMemory: RteEventRef=OpEventEraseBlock_EraseBlock_PS_StatusOfDTCMemory
        OpEventSetBlockProtection_SetBlockProtection_PAdmin_NvmBlock_Version_EEPROM: RteEventRef=OpEventSetBlockProtection_SetBlockProtection_PAdmin_NvmBlock_Version_EEPROM
        OpEventGetErrorStatus_GetErrorStatus_PS_NvMConfigBlock: RteEventRef=OpEventGetErrorStatus_GetErrorStatus_PS_NvMConfigBlock
        OpEventReadBlock_ReadBlock_PS_Product_Life_Data: RteEventRef=OpEventReadBlock_ReadBlock_PS_Product_Life_Data
        OpEventGetErrorStatus_GetErrorStatus_PS_NvmBlock_Version_EEPROM: RteEventRef=OpEventGetErrorStatus_GetErrorStatus_PS_NvmBlock_Version_EEPROM
        OpEventReadBlock_ReadBlock_PS_NvMConfigBlock: RteEventRef=OpEventReadBlock_ReadBlock_PS_NvMConfigBlock
        OpEventSetRamBlockStatus_SetRamBlockStatus_PS_Product_Life_Data: RteEventRef=OpEventSetRamBlockStatus_SetRamBlockStatus_PS_Product_Life_Data
        OpEventSetRamBlockStatus_SetRamBlockStatus_PS_NvMConfigBlock: RteEventRef=OpEventSetRamBlockStatus_SetRamBlockStatus_PS_NvMConfigBlock
        OpEventWriteBlock_WriteBlock_PS_NvmBlock_Version_EEPROM: RteEventRef=OpEventWriteBlock_WriteBlock_PS_NvmBlock_Version_EEPROM
        OpEventRestoreBlockDefaults_RestoreBlockDefaults_PS_NvmBlock_Version_EEPROM: RteEventRef=OpEventRestoreBlockDefaults_RestoreBlockDefaults_PS_NvmBlock_Version_EEPROM
        OpEventWriteBlock_WriteBlock_PS_StatusOfDTCMemory: RteEventRef=OpEventWriteBlock_WriteBlock_PS_StatusOfDTCMemory
        OpEventEraseBlock_EraseBlock_PS_Product_Life_Data: RteEventRef=OpEventEraseBlock_EraseBlock_PS_Product_Life_Data
        OpEventSetBlockProtection_SetBlockProtection_PAdmin_StatusOfDTCMemory: RteEventRef=OpEventSetBlockProtection_SetBlockProtection_PAdmin_StatusOfDTCMemory
        OpEventGetErrorStatus_GetErrorStatus_PS_Product_Life_Data: RteEventRef=OpEventGetErrorStatus_GetErrorStatus_PS_Product_Life_Data
        OpEventEraseBlock_EraseBlock_PS_NvMConfigBlock: RteEventRef=OpEventEraseBlock_EraseBlock_PS_NvMConfigBlock
        OpEventSetRamBlockStatus_SetRamBlockStatus_PS_NvmBlock_Version_EEPROM: RteEventRef=OpEventSetRamBlockStatus_SetRamBlockStatus_PS_NvmBlock_Version_EEPROM
        OpEventSetBlockProtection_SetBlockProtection_PAdmin_NvMConfigBlock: RteEventRef=OpEventSetBlockProtection_SetBlockProtection_PAdmin_NvMConfigBlock
        OpEventSetBlockProtection_SetBlockProtection_PAdmin_Product_Life_Data: RteEventRef=OpEventSetBlockProtection_SetBlockProtection_PAdmin_Product_Life_Data
        OpEventInvalidateNvBlock_InvalidateNvBlock_PS_NvmBlock_Version_EEPROM: RteEventRef=OpEventInvalidateNvBlock_InvalidateNvBlock_PS_NvmBlock_Version_EEPROM
        OpEventInvalidateNvBlock_InvalidateNvBlock_PS_NvMConfigBlock: RteEventRef=OpEventInvalidateNvBlock_InvalidateNvBlock_PS_NvMConfigBlock
        OpEventInvalidateNvBlock_InvalidateNvBlock_PS_StatusOfDTCMemory: RteEventRef=OpEventInvalidateNvBlock_InvalidateNvBlock_PS_StatusOfDTCMemory
        OpEventRestoreBlockDefaults_RestoreBlockDefaults_PS_StatusOfDTCMemory: RteEventRef=OpEventRestoreBlockDefaults_RestoreBlockDefaults_PS_StatusOfDTCMemory
        OpEventGetErrorStatus_GetErrorStatus_PS_StatusOfDTCMemory: RteEventRef=OpEventGetErrorStatus_GetErrorStatus_PS_StatusOfDTCMemory
        OpEventReadBlock_ReadBlock_PS_StatusOfDTCMemory: RteEventRef=OpEventReadBlock_ReadBlock_PS_StatusOfDTCMemory
        OpEventReadBlock_ReadBlock_PS_NvmBlock_Version_EEPROM: RteEventRef=OpEventReadBlock_ReadBlock_PS_NvmBlock_Version_EEPROM
        OpEventWriteBlock_WriteBlock_PS_NvMConfigBlock: RteEventRef=OpEventWriteBlock_WriteBlock_PS_NvMConfigBlock
        OpEventSetRamBlockStatus_SetRamBlockStatus_PS_StatusOfDTCMemory: RteEventRef=OpEventSetRamBlockStatus_SetRamBlockStatus_PS_StatusOfDTCMemory
        OpEventInvalidateNvBlock_InvalidateNvBlock_PS_Product_Life_Data: RteEventRef=OpEventInvalidateNvBlock_InvalidateNvBlock_PS_Product_Life_Data
        OpEventWriteBlock_WriteBlock_PS_Product_Life_Data: RteEventRef=OpEventWriteBlock_WriteBlock_PS_Product_Life_Data
        OpEventRestoreBlockDefaults_RestoreBlockDefaults_PS_Product_Life_Data: RteEventRef=OpEventRestoreBlockDefaults_RestoreBlockDefaults_PS_Product_Life_Data
        OpEventEraseBlock_EraseBlock_PS_NvmBlock_Version_EEPROM: RteEventRef=OpEventEraseBlock_EraseBlock_PS_NvmBlock_Version_EEPROM
    4 x RteBswModuleInstance:
      Can: RteBswImplementationRef=Can_Impl, RteBswModuleConfigurationRef=Can
        3 x RteBswEventToTaskMapping, all with RteBswImmediateRestart=false:
          Can_MainFunction_BusOffTimingEvent0: RteBswEventRef=Can_MainFunction_BusOffTimingEvent0
          Can_MainFunction_WakeupTimingEvent0: RteBswEventRef=Can_MainFunction_WakeupTimingEvent0
          Can_MainFunction_ModeTimingEvent0: RteBswEventRef=Can_MainFunction_ModeTimingEvent0
        7 x RteBswExclusiveAreaImpl, all with RteExclusiveAreaImplMechanism=ALL_INTERRUPT_BLOCKING:
          CAN_EXCLUSIVE_AREA_{0..6}: RteBswExclusiveAreaRef=CAN_EXCLUSIVE_AREA_{0..6}
      BswM: RteBswImplementationRef=BswM_Impl, RteBswModuleConfigurationRef=BswM
        BswM_MainFunctionTimingEvent0 (RteBswEventToTaskMapping):
          RteBswImmediateRestart = false
          RteBswPositionInTask = 0
          RteBswEventRef = BswM_MainFunctionTimingEvent0
          RteBswMappedToTaskRef = Task_10ms
          RteBswUsedOsEventRef = Rte_Ev_Cyclic2_Task_10ms_0_10ms
          RteBswUsedOsAlarmRef = Rte_Al_TE2_Task_10ms_0_10ms
        BSWM_EXCLUSIVE_AREA_0 (RteBswExclusiveAreaImpl): RteExclusiveAreaImplMechanism=ALL_INTERRUPT_BLOCKING, RteBswExclusiveAreaRef=BSWM_EXCLUSIVE_AREA_0
      Dio: RteBswImplementationRef=BswImplementation_0, RteBswModuleConfigurationRef=Dio
      Port: RteBswImplementationRef=BswImplementation_0, RteBswModuleConfigurationRef=Port
        4 x RteBswExclusiveAreaImpl, all with RteExclusiveAreaImplMechanism=ALL_INTERRUPT_BLOCKING:
          PORT_EXCLUSIVE_AREA_{00..03}: RteBswExclusiveAreaRef=PORT_EXCLUSIVE_AREA_{00..03}
