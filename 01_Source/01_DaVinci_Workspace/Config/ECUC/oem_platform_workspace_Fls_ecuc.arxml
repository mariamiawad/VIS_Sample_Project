AUTOSAR XML (schema 4-2-1)
package /ActiveEcuC
  module config Fls: implementation-config-variant=VARIANT-PRE-COMPILE, module-description=BswImplementation_0
    CommonPublishedInformation: ArReleaseMajorVersion=4, ArReleaseMinorVersion=2, ArReleaseRevisionVersion=2, ModuleId=92, SwMajorVersion=1, SwMinorVersion=0, SwPatchVersion=0
    FlsConfigSet:
      FlsAcErase = 1073751296
      FlsAcErasePointer = NULL_PTR
      FlsAcWrite = 1073751296
      FlsAcWritePointer = NULL_PTR
      FlsCallCycle = 0.005
      FlsDefaultMode = MEMIF_MODE_SLOW
      FlsJobEndNotification = Fee_JobEndNotification
      FlsJobErrorNotification = Fee_JobErrorNotification
      FlsMaxReadFastMode = 1048576
      FlsMaxReadNormalMode = 1024
      FlsMaxWriteFastMode = 256
      FlsMaxWriteNormalMode = 32
      FlsProtection = 0
      FlsSectorList
        FlsSector_0 (FlsSector):
          FlsHwCh = FLS_CH_INTERN
          FlsNumberOfSectors = 1
          FlsPageSize = 8
          FlsPageWriteAsynch = false
          FlsPhysicalSector = FLS_DATA_ARRAY_0_BLOCK_1_S000
          FlsPhysicalSectorUnlock = true
          FlsProgrammingSize = FLS_WRITE_DOUBLE_WORD
          FlsQspiSectorCh = NOT_QSPI_CHANNEL
          FlsSectorEraseAsynch = false
          FlsSectorHwAddress = 0
          FlsSectorIndex = 0
          FlsSectorIrqMode = false
          FlsSectorSize = 2048
          FlsSectorStartaddress = 0
        FlsSector_1 (FlsSector):
          FlsHwCh = FLS_CH_INTERN
          FlsNumberOfSectors = 1
          FlsPageSize = 8
          FlsPageWriteAsynch = false
          FlsPhysicalSector = FLS_DATA_ARRAY_0_BLOCK_1_S001
          FlsPhysicalSectorUnlock = true
          FlsProgrammingSize = FLS_WRITE_DOUBLE_WORD
          FlsQspiSectorCh = NOT_QSPI_CHANNEL
          FlsSectorEraseAsynch = false
          FlsSectorHwAddress = 0
          FlsSectorIndex = 1
          FlsSectorIrqMode = false
          FlsSectorSize = 2048
          FlsSectorStartaddress = 2048
      FlsDemEventParameterRefs:
        FLS_E_COMPARE_FAILED = DemEventParameter_MCAL
        FLS_E_ERASE_FAILED = DemEventParameter_MCAL
        FLS_E_READ_FAILED = DemEventParameter_MCAL
        FLS_E_UNEXPECTED_FLASH_ID = DemEventParameter_MCAL
        FLS_E_WRITE_FAILED = DemEventParameter_MCAL
    FlsGeneral:
      FlsAcLoadOnJobStart = false
      FlsBaseAddress = 0
      FlsBlankCheckApi = false
      FlsCancelApi = true
      FlsCompareApi = true
      FlsDevErrorDetect = false
      FlsDriverIndex = 0
      FlsDsiHandlerApi = false
      FlsEraseBlankCheck = true
      FlsGetJobResultApi = true
      FlsGetStatusApi = true
      FlsMaxEraseBlankCheck = 256
      FlsRuntimeErrorDetect = true
      FlsSetModeApi = true
      FlsTotalSize = 0
      FlsUseInterrupts = false
      FlsVersionInfoApi = true
      FlsWriteBlankCheck = true
      FlsWriteVerifyCheck = true
      FlsTimeouts:
        FlsAsyncWriteTimeout = 2147483647
        FlsAsyncEraseTimeout = 2147483647
        FlsSyncWriteTimeout = 2147483647
        FlsSyncEraseTimeout = 2147483647
        FlsQspiSyncReadTimeout = 2147483647
        FlsQspiAsyncWriteTimeout = 2147483647
        FlsQspiAsyncEraseTimeout = 2147483647
        FlsQspiSyncWriteTimeout = 2147483647
        FlsQspiSyncEraseTimeout = 2147483647
        FlsQspiIrqReadTimeout = 2147483647
        FlsQspiIrqEraseTimeout = 2147483647
        FlsQspiIrqWriteTimeout = 2147483647
        FlsAbortTimeout = 32767
    FlsPublishedInformation:
      FlsAcLocationErase = 0
      FlsAcLocationWrite = 0
      FlsAcSizeErase = 0
      FlsAcSizeWrite = 0
      FlsEraseTime = 5
      FlsErasedValue = 4294967295
      FlsExpectedHwId = 0
      FlsSpecifiedEraseCycles = 100000
      FlsWriteTime = 0.0005
    NonAutosar:
      FlsCheckFlexNvmRatio = false
      FlsDisableDemReportErrorStatus = false
      FlsEnableUserModeSupport = false
      FlsExternalSectorsConfigured = false
      FlsInternalSectorsConfigured = true
      FlsQspiHyperflashEnable = false
      FlsQspiLockLUT = false
      FlsSynchronizeCache = false
