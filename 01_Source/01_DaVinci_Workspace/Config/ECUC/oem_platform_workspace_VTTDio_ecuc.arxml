AUTOSAR XML (schema 4-2-1)
package /ActiveEcuC
  module config VTTDio: implementation-config-variant=VARIANT-PRE-COMPILE, module-description=VTTDio_Impl
    DioGeneral: DioDevErrorDetect=false, DioFlipChannelApi=true, DioVersionInfoApi=false, DioSafeBswChecks=false
    DioConfig_0 (DioConfig)
      5 x DioPort:
        DioPort_E: DioPortId=4
          DioChannel_Trncv (DioChannel): DioChannelId=9
        DioPort_1: DioPortId=3
          3 x DioChannel:
            Dio_Led3: DioChannelId=16
            Dio_Led2: DioChannelId=15
            DioChannel_RF_P_ON: DioChannelId=4
        DioPort_0: DioPortId=2
          3 x DioChannel:
            Dio_DbgLed: DioChannelId=0
            DioChannel_0: DioChannelId=6
            Dio_Key1: DioChannelId=12
          DioChannelGroup_0 (DioChannelGroup): DioPortMask=1, DioPortOffset=0, DioChannelGroupIdentification=DioChannelGroup
        DioPort_A: DioPortId=0
          14 x DioChannel:
            DMX_E4L: DioChannelId=3
            CMD_ALIM_E_TOR_REV_E: DioChannelId=15
            DMX_E2L: DioChannelId=1
            DMX_E3L: DioChannelId=2
            DMX_E1L: DioChannelId=0
            DMX_E4W: DioChannelId=9
            CMD_ALIM_E_TOR_REV_B: DioChannelId=12
            CMD_ALIM_E_TOR_REV_C: DioChannelId=13
            CMD_ALIM_E_TOR_REV_A: DioChannelId=11
            DMX_E3W: DioChannelId=8
            DMX_E2W: DioChannelId=7
            CMD_ALIM_E_TOR_REV_F: DioChannelId=16
            CMD_ALIM_E_TOR_REV_D: DioChannelId=14
            DMX_E1W: DioChannelId=6
        DioPort_B: DioPortId=1
          3 x DioChannel:
            TRSP_ICUtoDIOin: DioChannelId=10
            TRSP_PWMtoDIOout: DioChannelId=15
            TRSP_CLK: DioChannelId=17
