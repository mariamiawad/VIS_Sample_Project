AUTOSAR XML (schema 4-2-1)
package /ActiveEcuC
  module config VTTPort: implementation-config-variant=VARIANT-PRE-COMPILE, module-description=VTTPort_Impl
    PortGeneral: PortDevErrorDetect=false, PortSetPinDirectionApi=true, PortSetPinModeApi=true, PortVersionInfoApi=true, PortSafeBswChecks=false
    PortConfigSet: Port_PinModeType=uint8, Port_PinType=uint8
      PortContainer_0 (PortContainer): PortNumberOfPortPins=2
        PortPin_Can_Tx (PortPin): PortPinDirection=PORT_PIN_OUT, PortPinDirectionChangeable=false, PortPinLevelValue=PORT_PIN_LEVEL_LOW, PortPinModeChangeable=false, PortPinId=43
        PortPin_Can_Rx (PortPin): PortPinDirection=PORT_PIN_IN, PortPinDirectionChangeable=false, PortPinLevelValue=PORT_PIN_LEVEL_LOW, PortPinModeChangeable=false, PortPinId=42
