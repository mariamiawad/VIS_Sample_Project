AUTOSAR XML (schema 4-2-1)
package /ActiveEcuC
  module config Dcm: implementation-config-variant=VARIANT-PRE-COMPILE, module-description=Dcm_Impl
    DcmConfigSet
      DcmDsd
        DcmDsdServiceTable: DcmDsdSidTabId=0
          5 x DcmDsdService:
            SessionControl: DcmDsdSidTabServiceId=16, DcmDsdSidTabSubfuncAvail=true
              3 x DcmDsdSubService, all with DcmDsdSubServiceSessionLevelRef=DcmDspSession/Extended:
                Default: DcmDsdSubServiceId=1, DcmDsdSubServiceSessionLevelRef=DcmDspSession/Default, DcmDsdSubServiceSessionLevelRef=DcmDspSession/Programming
                Programming: DcmDsdSubServiceId=2, DcmDsdSubServiceSessionLevelRef=DcmDspSession/Programming
                Extended: DcmDsdSubServiceId=3, DcmDsdSubServiceSessionLevelRef=DcmDspSession/Default
            TesterPresent: DcmDsdSidTabServiceId=62, DcmDsdSidTabSubfuncAvail=true, DcmDsdSidTabSessionLevelRef=DcmDspSession/Default, DcmDsdSidTabSessionLevelRef=DcmDspSession/Extended, DcmDsdSidTabSessionLevelRef=DcmDspSession/Programming
              zeroSubFunction (DcmDsdSubService): DcmDsdSubServiceId=0
            ReadDataByIdentifier: DcmDsdSidTabServiceId=34, DcmDsdSidTabSubfuncAvail=false
            ClearDiagnosticInformation: DcmDsdSidTabServiceId=20, DcmDsdSidTabSubfuncAvail=false
            DcmDsdService: DcmDsdSidTabServiceId=49, DcmDsdSidTabSubfuncAvail=true
      DcmDsl
        DcmDslBuffer: DcmDslBufferSize=256
        DcmDslDiagResp: DcmDslDiagRespMaxNumRespPend=2, DcmDslDiagRespOnSecondDeclinedRequest=false, DcmDslDiagRespMaxNumOfDeclinedRequests=3
        DcmDslProtocol
          DcmDslProtocolRow_0 (DcmDslProtocolRow):
            DcmDslProtocolEndiannessConvEnabled = false
            DcmDslProtocolID = DCM_UDS_ON_CAN
            DcmDslProtocolPreemptTimeout = 100
            DcmDslProtocolPriority = 0
            DcmSendRespPendOnTransToBoot = true
            DcmTimStrP2ServerAdjust = 0
            DcmTimStrP2StarServerAdjust = 0
            DcmDslProtocolTransType = TYPE2
            DcmDslProtocolRxBufferID = DcmDslBuffer
            DcmDslProtocolSIDTable = DcmDsdServiceTable
            DcmDslProtocolTxBufferID = DcmDslBuffer
            DcmDemClientRef = DemClient
            DcmDslConnection
              DcmDslMainConnection: DcmDslProtocolRxTesterSourceAddr=0, DcmDslAddressingType=DCM_NET_ADDR_NORMAL, DcmDslProtocolRxConnectionId=1
                DcmDslProtocolRx_0 (DcmDslProtocolRx):
                  DcmDslProtocolRxAddrType = DCM_PHYSICAL_TYPE
                  DcmDslProtocolRxChannelId = 0
                  DcmDslProtocolRxPduId = 1
                  DcmDslProtocolRxGlobalEcuAddress = 0
                  DcmDslProtocolRxPduRef = DiagReq_Phy_Tp2Dcm
                  DcmDslProtocolRxComMChannelRef = CAN00_f26020e5
                DcmDslProtocolTx: DcmDslTxConfirmationPduId=0, DcmDslProtocolTxPduRef=TXDiagValeo_Dcm2TpResp
                DcmDslProtocolRx_1 (DcmDslProtocolRx):
                  DcmDslProtocolRxAddrType = DCM_FUNCTIONAL_TYPE
                  DcmDslProtocolRxChannelId = 0
                  DcmDslProtocolRxPduId = 0
                  DcmDslProtocolRxPduRef = DiagReq_Func_Tp2Dcm
                  DcmDslProtocolRxComMChannelRef = CAN00_f26020e5
      DcmDsp: DcmDspReadDIDReportsNODIByte=false
        DcmDspSecurity: DcmDspSecurityResetAttemptCounterOnTimeout=false
          DCM_SEC_LEV_L1 (DcmDspSecurityRow):
            DcmDspSecurityAttemptCounterEnabled = false
            DcmDspSecurityDelayTime = 0
            DcmDspSecurityDelayTimeOnBoot = 0
            DcmDspSecurityKeySize = 4
            DcmDspSecurityLevel = 0
            DcmDspSecurityNumAttDelay = 0
            DcmDspSecuritySeedSize = 4
            DcmDspSecurityUsePort = USE_ASYNCH_CLIENT_SERVER
        DcmDspSession
          3 x DcmDspSessionRow, all with DcmDspSessionForBoot=DCM_NO_BOOT:
            Default: DcmDspSessionLevel=1, DcmDspSessionP2ServerMax=0.05, DcmDspSessionP2StarServerMax=5
            Extended: DcmDspSessionLevel=3, DcmDspSessionP2ServerMax=0.05, DcmDspSessionP2StarServerMax=5
            Programming: DcmDspSessionLevel=2, DcmDspSessionP2ServerMax=1, DcmDspSessionP2StarServerMax=7
        ECU_Core_Assembly_No (DcmDspDid): DcmDspDidIdentifier=61713, DcmDspDidUsed=true, DcmDspDidUsePort=USE_DATA_ELEMENT_SPECIFIC_INTERFACES, DcmDspDidInfoRef=ECU_Core_Assembly_No_Info
          ECU_Core_Assembly_No_Signal (DcmDspDidSignal): DcmDspDidDataPos=0, DcmDspDidDataRef=ECU_Core_Assembly_No_Data
        ECU_Core_Assembly_No_Info (DcmDspDidInfo): DcmDspDidDynamicallyDefined=false
          DcmDspDidAccess
            DcmDspDidRead
        ECU_Core_Assembly_No_Data (DcmDspData):
          DcmDspDataSize = 24
          DcmDspDataUsePort = USE_DATA_ASYNCH_CLIENT_SERVER
          DcmDspDataType = UINT32
          DcmDspDataEndianness = LITTLE_ENDIAN
          DcmDspDataInfoRef = ECU_Core_Assembly_No_DataInfo
        ECU_Core_Assembly_No_DataInfo (DcmDspDataInfo): DcmDspDataFixedLength=true
        ECU_Delivery_Assembly_No_DataInfo (DcmDspDataInfo): DcmDspDataFixedLength=true
        ECU_Delivery_Assembly_No_Data (DcmDspData):
          DcmDspDataSize = 24
          DcmDspDataUsePort = USE_DATA_ASYNCH_CLIENT_SERVER
          DcmDspDataType = UINT32
          DcmDspDataEndianness = LITTLE_ENDIAN
          DcmDspDataInfoRef = ECU_Delivery_Assembly_No_DataInfo
        ECU_Delivery_Assembly_No_Info (DcmDspDidInfo): DcmDspDidDynamicallyDefined=false
          DcmDspDidAccess
            DcmDspDidRead
        ECU_Delivery_Assembly_No (DcmDspDid):
          DcmDspDidIdentifier = 61715
          DcmDspDidUsed = true
          DcmDspDidUsePort = USE_DATA_ELEMENT_SPECIFIC_INTERFACES
          DcmDspDidInfoRef = ECU_Delivery_Assembly_No_Info
          ECU_Delivery_Assembly_No_Signal (DcmDspDidSignal): DcmDspDidDataPos=0, DcmDspDidDataRef=ECU_Delivery_Assembly_No_Data
        DcmDspRoutine_Enable_KL15_Info (DcmDspRoutineInfo)
          DcmDspRoutineAuthorization: DcmDspRoutineSessionRef=DcmDspSession/Default, DcmDspRoutineSessionRef=DcmDspSession/Extended
          DcmDspRoutineRequestResOut
            DcmDspRoutineRequestResOutSignal: DcmDspRoutineSignalLength=8, DcmDspRoutineSignalPos=0, DcmDspRoutineSignalType=UINT8, DcmDspRoutineSignalEndianness=opaque
          DcmDspStartRoutineIn
            DcmDspStartRoutineInSignal: DcmDspRoutineSignalLength=8, DcmDspRoutineSignalPos=0, DcmDspRoutineSignalType=SINT8, DcmDspRoutineSignalEndianness=opaque
        DcmDspRoutine:
          DcmDspRequestResultsRoutineSupported = true
          DcmDspRoutineFixedLength = true
          DcmDspRoutineIdentifier = 65530
          DcmDspRoutineUsePort = true
          DcmDspRoutineUsed = true
          DcmDspStopRoutineSupported = true
          DcmDspRoutineInfoRef = DcmDspRoutine_Enable_KL15_Info
      DcmGeneral:
        DcmDevErrorDetect = false
        DcmRequestManufacturerNotificationEnabled = false
        DcmRequestSupplierNotificationEnabled = false
        DcmRespondAllRequest = true
        DcmTaskTime = 0.01
        DcmVersionInfoApi = false
        DcmDspDataDefaultEndianness = LITTLE_ENDIAN
        DcmSupportedIDCalculationSuppressionEnabled = false
        DcmDtrDataProvisionViaDemEnabled = false
        DcmForeignDiagnosticRequestDetectionEnabled = false
        DcmSuppressResponseOnCanTpFuncMixedAddrRequests = false
        DcmDemApiVersion = DCM_DEM_API_4_03_00
        DcmCalibrationOfObdIdsEnabled = false
        DcmSenderReceiverPRPortsEnabled = false
        DcmSafeBswChecks = false
      DcmPageBufferCfg: DcmPagedBufferEnabled=true
