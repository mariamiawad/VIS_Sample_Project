AUTOSAR XML (schema 4-2-1)
package /InitialEcuC
  ecuc value collection InitialEcuC: ecuc-values=[Can, CanIf, CanSM, CanTp, ComM, EcuC, EcuM, PduR]
  module config Can
    CanConfigSet
      CT_CAN00_7c865b08 (CanController):
        CanControllerActivation = true
        CanControllerDefaultBaudrate = CanControllerBaudrateConfig
        CanWakeupSourceRef = EcuMCommonConfiguration/CAN00_f26020e5
        CanControllerBaudrateConfig
      CN_CAN00_7c865b08_Tx (CanHardwareObject): CanHandleType=BASIC, CanIdValue=0, CanObjectType=TRANSMIT, CanControllerRef=CanConfigSet/CT_CAN00_7c865b08
    CanGeneral: CanIndex=0
  module config CanIf
    Can (CanIfCtrlDrvCfg): CanIfCtrlDrvInitHohConfigRef=CanIfInitHohCfg, CanIfCtrlDrvNameRef=CanGeneral
      CT_CAN00_7c865b08 (CanIfCtrlCfg): CanIfCtrlCanCtrlRef=CanConfigSet/CT_CAN00_7c865b08
    CanIfInitCfg
      CanIfBufferCfg_0fb271d2 (CanIfBufferCfg): CanIfBufferSize=0, CanIfBufferHthRef=CanIfInitHohCfg/CN_CAN00_7c865b08_Tx  # CHNL
      CanIfInitHohCfg: CanIfInitRefCfgSet=CanConfigSet
        CN_CAN00_7c865b08_Tx (CanIfHthCfg): CanIfHthCanCtrlIdRef=Can/CT_CAN00_7c865b08, CanIfHthIdSymRef=CanConfigSet/CN_CAN00_7c865b08_Tx
      TXDiagValeo_Tp2CanResp_D_1860T_Tp_oCAN00_Tx_3abd61be (CanIfTxPduCfg):
        CanIfTxPduCanId = 1860
        CanIfTxPduCanIdType = STANDARD_CAN
        CanIfTxPduDlc = 8
        CanIfTxPduUserTxConfirmationUL = CDD
        CanIfTxPduBufferRef = CanIfBufferCfg_0fb271d2
        CanIfTxPduRef = PT_TXDiagValeo_Tp2CanResp_D_1860T_Tp_PP_TXDiagValeo_Tp2CanResp_D_1860T_Tp_Tx_0fb271d2_6e6dcc7a
    CanIfPrivateCfg: CanIfPrivateSoftwareFilterType=LINEAR
    CanIfPublicCfg: CanIfPublicPnSupport=false
  module config CanSM
    CanSMConfiguration
      CHNL_f276589c (CanSMManagerNetwork): CanSMComMNetworkHandleRef=ComMConfigSet/CAN00_f26020e5
        CT_CAN00_7c865b08 (CanSMController): CanSMControllerId=Can/CT_CAN00_7c865b08
  module config CanTp
    CanTpConfig: CanTpMainFunctionPeriod=0.005
  module config ComM
    ComMConfigSet: ComMPncEnabled=false
      CAN00_f26020e5 (ComMChannel): ComMBusType=COMM_BUS_TYPE_CAN, ComMChannelId=0  # CN_CAN00
        ComMNetworkManagement: ComMNmVariant=NONE
        CHNL_f276589c (ComMUserPerChannel): ComMUserChannel=USR_CHNL_f276589c  # CN_CAN00
      USR_CHNL_f276589c (ComMUser): ComMUserIdentifier=0  # CN_CAN00
    ComMGeneral: ComMPncIdCounting=COMM_PNC_ID_COUNT_FROM_NM_MESSAGE, ComMPncSupport=false
  module config EcuC
    EcucPduCollection: PduIdTypeEnum=UINT8, PduLengthTypeEnum=UINT8
      PT_TXDiagValeo_Tp2CanResp_D_1860T_PP_TXDiagValeo_Tp2CanResp_D_1860T_Tx_0fb271d2_6e6dcc7a (Pdu): PduLength=8  # TXDiagValeo_Tp2CanResp_D_1860T_oCAN00
      PT_TXDiagValeo_Tp2CanResp_D_1860T_Tp_PP_TXDiagValeo_Tp2CanResp_D_1860T_Tp_Tx_0fb271d2_6e6dcc7a (Pdu): PduLength=8, SysTPduToFrameMappingRef=TXDiagValeo_Tp2CanResp_D_1860T_Tp  # TXDiagValeo_Tp2CanResp_D_1860T_Tp_oCAN00
  module config EcuM
    EcuMConfiguration
      EcuMCommonConfiguration
        EcuMDriverInitListOne
        EcuMDriverRestartList
        CAN00_f26020e5 (EcuMWakeupSource): EcuMWakeupSourceId=5, EcuMComMChannelRef=ComMConfigSet/CAN00_f26020e5  # CN_CAN00
      EcuMFlexConfiguration: EcuMFlexModuleConfigurationRef=CanConfigSet
  module config PduR
    PduRGeneral
    PduRRoutingTables
      PduRRoutingTable
        Can_PT_TXDiagValeo_Tp2CanResp_D_1860T_0fb271d2 (PduRRoutingPath)  # TXDiagValeo_Tp2CanResp_D_1860T_oCAN00
          DST_Can_PT_TXDiagValeo_Tp2CanResp_D_1860T_0fb271d2 (PduRDestPdu): PduRDestPduRef=PT_TXDiagValeo_Tp2CanResp_D_1860T_PP_TXDiagValeo_Tp2CanResp_D_1860T_Tx_0fb271d2_6e6dcc7a
          SRC_Can_PT_TXDiagValeo_Tp2CanResp_D_1860T_0fb271d2 (PduRSrcPdu): PduRSrcPduRef=PT_TXDiagValeo_Tp2CanResp_D_1860T_PP_TXDiagValeo_Tp2CanResp_D_1860T_Tx_0fb271d2_6e6dcc7a
