AUTOSAR XML (schema 4-2-1)
package /ActiveEcuC
  module config NvM: implementation-config-variant=VARIANT-PRE-COMPILE, module-description=NvM_Impl
    NvMConfigBlock (NvMBlockDescriptor):
      NvMBlockCrcType = NVM_CRC16
      NvMBlockManagementType = NVM_BLOCK_REDUNDANT
      NvMInitBlockCallback = NULL_PTR
      NvMResistantToChangedSw = true
      NvMSelectBlockForReadAll = true
      NvMSelectBlockForWriteAll = true
      NvMUseInitCallback = false
      NvMUseJobendCallback = false
      NvMSingleBlockCallback = NULL_PTR
      NvMBswMBlockStatusInformation = false
      NvMBlockUseCrc = true
      NvMBlockUseSyncMechanism = false
      NvMCalcRamBlockCrc = false
      NvMUseServicePorts = true
      NvMNvramBlockIdentifier = 1
      NvMNvBlockNum = 2
      NvMNvBlockLength = 2
      NvMRomBlockDataAddress = NULL_PTR
      NvMBlockJobPriority = 127
      NvMBlockWriteProt = false
      NvMWriteBlockOnce = false
      NvMBlockUseCRCCompMechanism = false
      NvMRamBlockDataAddress = NvM_ConfigurationId
      NvMBlockPostReadTransformCallback = NULL_PTR
      NvMBlockPreWriteTransformCallback = NULL_PTR
      NvMBlockUseSetRamBlockStatus = true
      NvMInvokeCallbacksForReadAll = false
      NvMInvokeCallbacksForWriteAll = false
      NvMTargetBlockReference
        NvMFeeRef: NvMNameOfFeeBlock=FeeBlockConfiguration
    NvMCommon:
      NvMDevErrorDetect = true
      NvMVersionInfoApi = false
      NvMApiConfigClass = NVM_API_CONFIG_CLASS_3
      NvMBswMMultiBlockJobStatusInformation = true
      NvMCompiledConfigId = 1
      NvMCrcNumOfBytes = 64
      NvMDatasetSelectionBits = 4
      NvMDrvModeSwitch = true
      NvMDynamicConfiguration = false
      NvMJobPrioritization = false
      NvMPollingMode = true
      NvMSetRamBlockStatusApi = true
      NvMSizeStandardJobQueue = 8
      NvMMaxNoOfWriteRetries = 1
      NvMMainFunctionPeriod = 0.01
      NvMUseBlockIdCheck = false
      NvMRepairRedundantBlocksApi = false
      NvMSafeBswChecks = false
    NvMCommonVendorParams: NvMMultiblockId=MultiBlockRequest, NvMCrcIntBuffer=true, NvMKillWriteAllApi=true, NvMCfgCbkIncludeList=Dem.h, NvMCfgCbkIncludeList=Users_Nvm.h
    6 x NvMBlockDescriptor, all with NvMBswMBlockStatusInformation=false, NvMBlockUseCrc=true, NvMBlockUseSyncMechanism=false, NvMCalcRamBlockCrc=false, NvMBlockWriteProt=false, NvMBlockUseCRCCompMechanism=false, NvMBlockUseSetRamBlockStatus=false, NvMInvokeCallbacksForReadAll=false, NvMInvokeCallbacksForWriteAll=false:
      NvMDem_block_Admin: NvMBlockCrcType=NVM_CRC16, NvMBlockManagementType=NVM_BLOCK_NATIVE, NvMInitBlockCallback=Dem_NvM_InitAdminData, NvMResistantToChangedSw=true, NvMSelectBlockForReadAll=true, NvMSelectBlockForWriteAll=true, NvMUseInitCallback=true, NvMUseJobendCallback=true, NvMSingleBlockCallback=Dem_NvM_JobFinished, NvMBlockJobPriority=127, NvMNvBlockLength=14, NvMNvBlockNum=1, NvMNvramBlockIdentifier=2, NvMWriteBlockOnce=false, NvMUseServicePorts=false, NvMRamBlockDataAddress=&Dem_Cfg_AdminData, NvMRomBlockDataAddress=NULL_PTR
        NvMTargetBlockReference
          NvMFeeRef: NvMNameOfFeeBlock=FeeBlockConfiguration_Dem_Admin
      NvMDem_block_Status: NvMBlockCrcType=NVM_CRC16, NvMBlockManagementType=NVM_BLOCK_NATIVE, NvMInitBlockCallback=Dem_NvM_InitStatusData, NvMResistantToChangedSw=true, NvMSelectBlockForReadAll=true, NvMSelectBlockForWriteAll=true, NvMUseInitCallback=true, NvMUseJobendCallback=false, NvMSingleBlockCallback=, NvMBlockJobPriority=127, NvMNvBlockLength=20, NvMNvBlockNum=1, NvMNvramBlockIdentifier=6, NvMWriteBlockOnce=false, NvMUseServicePorts=false, NvMRamBlockDataAddress=&Dem_Cfg_StatusData, NvMRomBlockDataAddress=NULL_PTR
        NvMTargetBlockReference
          NvMFeeRef: NvMNameOfFeeBlock=FeeBlockConfiguration_Dem_Status
      NvMDem_block_primary: NvMBlockCrcType=NVM_CRC16, NvMBlockManagementType=NVM_BLOCK_NATIVE, NvMInitBlockCallback=NULL_PTR, NvMResistantToChangedSw=true, NvMSelectBlockForReadAll=true, NvMSelectBlockForWriteAll=true, NvMUseInitCallback=false, NvMUseJobendCallback=true, NvMSingleBlockCallback=Dem_NvM_JobFinished, NvMBlockJobPriority=127, NvMNvBlockLength=20, NvMNvBlockNum=1, NvMNvramBlockIdentifier=7, NvMWriteBlockOnce=false, NvMUseServicePorts=false, NvMRamBlockDataAddress=&Dem_Cfg_PrimaryEntry_0, NvMRomBlockDataAddress=&Dem_Cfg_MemoryEntryInit
        NvMTargetBlockReference
          NvMFeeRef: NvMNameOfFeeBlock=FeeBlockConfiguration_Dem_Primary
      NvmBlock_Version_EEPROM: NvMBlockCrcType=NVM_CRC16, NvMBlockManagementType=NVM_BLOCK_NATIVE, NvMInitBlockCallback=NULL_PTR, NvMResistantToChangedSw=false, NvMSelectBlockForReadAll=false, NvMSelectBlockForWriteAll=false, NvMUseInitCallback=false, NvMUseJobendCallback=false, NvMSingleBlockCallback=NULL_PTR, NvMBlockJobPriority=127, NvMNvBlockLength=4, NvMNvBlockNum=1, NvMNvramBlockIdentifier=5, NvMWriteBlockOnce=true, NvMUseServicePorts=true, NvMRamBlockDataAddress=&Nvm_Ram_Version_EEPROM, NvMRomBlockDataAddress=&Nvm_Rom_Version_EEPROM, NvMWriteVerification=true, NvMWriteVerificationDataSize=10
        NvMTargetBlockReference
          NvMFeeRef: NvMNameOfFeeBlock=FeeBlockConfiguration_NvmBlock_Version_EEPROM
      Product_Life_Data: NvMBlockCrcType=NVM_CRC16, NvMBlockManagementType=NVM_BLOCK_REDUNDANT, NvMInitBlockCallback=Nvm_Product_Life_Data_CB, NvMResistantToChangedSw=true, NvMSelectBlockForReadAll=true, NvMSelectBlockForWriteAll=true, NvMUseInitCallback=true, NvMUseJobendCallback=false, NvMSingleBlockCallback=NULL_PTR, NvMBlockJobPriority=0, NvMNvBlockLength=32, NvMNvBlockNum=2, NvMNvramBlockIdentifier=4, NvMWriteBlockOnce=false, NvMUseServicePorts=true, NvMRamBlockDataAddress=&Nvm_Ram_Product_Life_Data, NvMWriteVerification=false
        NvMTargetBlockReference
          NvMFeeRef: NvMNameOfFeeBlock=FeeBlockConfiguration_Product_Life_Data
      StatusOfDTCMemory: NvMBlockCrcType=NVM_CRC32, NvMBlockManagementType=NVM_BLOCK_REDUNDANT, NvMInitBlockCallback=NULL_PTR, NvMResistantToChangedSw=false, NvMSelectBlockForReadAll=true, NvMSelectBlockForWriteAll=true, NvMUseInitCallback=false, NvMUseJobendCallback=false, NvMSingleBlockCallback=NULL_PTR, NvMBlockJobPriority=127, NvMNvBlockLength=24, NvMNvBlockNum=2, NvMNvramBlockIdentifier=3, NvMWriteBlockOnce=false, NvMUseServicePorts=true, NvMRamBlockDataAddress=&Dem_StatusOfDtcRam, NvMRomBlockDataAddress=&Nvm_Rom_StatusOfDTCMemory, NvMWriteVerification=false
        NvMTargetBlockReference
          NvMFeeRef: NvMNameOfFeeBlock=FeeBlockConfiguration_StatusOfDTCMemory
