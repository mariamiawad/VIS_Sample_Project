AUTOSAR XML (schema 4-2-1)
package /ActiveEcuC
  module config Mcu: implementation-config-variant=VARIANT-POST-BUILD, module-description=BswImplementation_0
    CommonPublishedInformation:
      ArReleaseMajorVersion = 4
      ArReleaseMinorVersion = 2
      ArReleaseRevisionVersion = 2
      ModuleId = 101
      SwMajorVersion = 1
      SwMinorVersion = 0
      SwPatchVersion = 0
      VendorApiInfix = 
      VendorId = 43
    McuDebugConfiguration: McuDisableDemReportErrorStatus=false, McuGetMidrStructureApi=false, McuGetPeriphStateApi=false
    McuGeneralConfiguration:
      McuCalloutBeforePerformReset = false
      McuDevErrorDetect = false
      McuEnableUserModeSupport = false
      McuEnterLowPowerMode = false
      McuGetRamStateApi = false
      McuInitClock = true
      McuNoPll = false
      McuPerformResetApi = true
      McuPerformResetCallout = NULL_PTR
      McuTimeout = 50000
      McuVersionInfoApi = false
    McuModuleConfiguration:
      McuClockSrcFailureNotification = DISABLED
      McuLPO1KClockEnable = true
      McuLPO32KClockEnable = true
      McuLPOClockSelect = LPO_CLK_128K
      McuNumberOfMcuModes = 1
      McuRTCCLKINFrequencyHz = 32000
      McuRamSectors = 1
      McuRtcClkSelect = LPO_CLK_32K
      McuAllowedModes: McuAllowHighSpeedRunMode=true, McuAllowVeryLowPowerModes=false
      McuClockSettingConfig_0 (McuClockSettingConfig): McuClockSettingId=0, McuScgClkOutSelect=SOSC, McuSysClockUnderMcuControl=true
        17 x McuClockReferencePoint:
          McuClockReferencePoint_FTM0: McuClockFrequencySelect=FTM0_CLK, McuClockReferencePointFrequency=40000000
          McuClockReferencePoint_FTM2: McuClockFrequencySelect=FTM2_CLK, McuClockReferencePointFrequency=8000000
          McuClockReferencePoint_FTM3: McuClockFrequencySelect=FTM3_CLK, McuClockReferencePointFrequency=40000000
          McuClockReferencePoint_LPIT0_CLK: McuClockFrequencySelect=LPIT_CLK, McuClockReferencePointFrequency=4000000
          McuClockReferencePoint_LPSPI_0: McuClockFrequencySelect=LPSPI0_CLK, McuClockReferencePointFrequency=4000000
          McuClockReferencePoint_LPSPI_1: McuClockFrequencySelect=LPSPI1_CLK, McuClockReferencePointFrequency=20000000
          McuClockReferencePoint_LPUART0_CLK: McuClockFrequencySelect=LPUART0_CLK, McuClockReferencePointFrequency=4000000
          McuClockReferencePoint_PLL_DIV2: McuClockFrequencySelect=SPLLDIV2_CLK, McuClockReferencePointFrequency=20000000
          McuClockReferencePoint_RUN_BUS_CLK: McuClockFrequencySelect=RUN_BUS_CLK, McuClockReferencePointFrequency=40000000
          McuClockReferencePoint_SIRC: McuClockFrequencySelect=SIRC_CLK, McuClockReferencePointFrequency=8000000
          McuClockReferencePoint_SIRCDIV2_CLK: McuClockFrequencySelect=SIRCDIV2_CLK, McuClockReferencePointFrequency=4000000
          McuClockReferencePoint_SIRC_CLK: McuClockFrequencySelect=SIRC_CLK, McuClockReferencePointFrequency=8000000
          McuClockReferencePoint_SOSCDIV1_CLK: McuClockFrequencySelect=SOSCDIV1_CLK, McuClockReferencePointFrequency=8000000
          McuClockReferencePoint_SOSCDIV2_CLK: McuClockFrequencySelect=SOSCDIV2_CLK, McuClockReferencePointFrequency=4000000
          McuClockReferencePoint_SPLLDIV2_CLK: McuClockFrequencySelect=SPLLDIV2_CLK, McuClockReferencePointFrequency=20000000
          McuClockReferencePoint_SYS_CLK: McuClockFrequencySelect=RUN_SYS_CLK, McuClockReferencePointFrequency=80000000
          McuClockReferencePoint_WDG_CLK: McuClockFrequencySelect=LPO_CLK_128K, McuClockReferencePointFrequency=128000
        McuFIRCClockConfig:
          McuFIRCDiv1 = 1
          McuFIRCDiv1Frequency = 48000000
          McuFIRCDiv2 = 2
          McuFIRCDiv2Frequency = 24000000
          McuFIRCEnable = true
          McuFIRCFrequency = 48000000
          McuFIRCRangeSelect = TRIMMED_TO_48MHZ
          McuFIRCRegulatorEnable = false
          McuFIRCUnderMcuControl = true
        McuHsrunClockConfig:
          McuBusClockDivider = 2
          McuBusClockFrequency = 40000000
          McuCoreClockDivider = 2
          McuCoreClockFrequency = 80000000
          McuFlashClockFrequency = 20000000
          McuPreDivSystemClockFrequency = 160000000
          McuScgClkOutFrequency = 8000000
          McuSlowClockDivider = 4
          McuSystemClockFrequency = 80000000
          McuSystemClockSwitch = SPLL
        32 x McuPeripheralClockConfig, all with McuPeripheralClockDivider=1, McuPeripheralFractionalDivider=0:
          McuPeripheralClockConfig_0: McuPerName=FTFC, McuPeripheralClockEnable=true, McuPeripheralClockFrequency=0, McuPeripheralClockSelect=EXT_CLK_OR_CLK_OFF
          McuPeripheralClockConfig_1: McuPerName=DMAMUX0, McuPeripheralClockEnable=true, McuPeripheralClockFrequency=0, McuPeripheralClockSelect=EXT_CLK_OR_CLK_OFF
          McuPeripheralClockConfig_10: McuPerName=PDB1, McuPeripheralClockEnable=true, McuPeripheralClockFrequency=0, McuPeripheralClockSelect=EXT_CLK_OR_CLK_OFF
          McuPeripheralClockConfig_11: McuPerName=CRC, McuPeripheralClockEnable=false, McuPeripheralClockFrequency=0, McuPeripheralClockSelect=EXT_CLK_OR_CLK_OFF
          McuPeripheralClockConfig_12: McuPerName=PDB0, McuPeripheralClockEnable=true, McuPeripheralClockFrequency=0, McuPeripheralClockSelect=EXT_CLK_OR_CLK_OFF
          McuPeripheralClockConfig_13: McuPerName=LPIT, McuPeripheralClockEnable=true, McuPeripheralClockFrequency=4000000, McuPeripheralClockSelect=SOSC
          McuPeripheralClockConfig_14: McuPerName=FTM0, McuPeripheralClockEnable=true, McuPeripheralClockFrequency=40000000, McuPeripheralClockSelect=SPLL
          McuPeripheralClockConfig_15: McuPerName=FTM1, McuPeripheralClockEnable=true, McuPeripheralClockFrequency=8000000, McuPeripheralClockSelect=SOSC
          McuPeripheralClockConfig_16: McuPerName=FTM2, McuPeripheralClockEnable=true, McuPeripheralClockFrequency=8000000, McuPeripheralClockSelect=SOSC
          McuPeripheralClockConfig_17: McuPerName=ADC0, McuPeripheralClockEnable=true, McuPeripheralClockFrequency=4000000, McuPeripheralClockSelect=SOSC
          McuPeripheralClockConfig_18: McuPerName=RTC, McuPeripheralClockEnable=false, McuPeripheralClockFrequency=0, McuPeripheralClockSelect=EXT_CLK_OR_CLK_OFF
          McuPeripheralClockConfig_19: McuPerName=LPTMR0, McuPeripheralClockEnable=true, McuPeripheralClockFrequency=0, McuPeripheralClockSelect=EXT_CLK_OR_CLK_OFF
          McuPeripheralClockConfig_2: McuPerName=FLEXCAN0, McuPeripheralClockEnable=true, McuPeripheralClockFrequency=0, McuPeripheralClockSelect=EXT_CLK_OR_CLK_OFF
          McuPeripheralClockConfig_20: McuPerName=PORTA, McuPeripheralClockEnable=true, McuPeripheralClockFrequency=0, McuPeripheralClockSelect=EXT_CLK_OR_CLK_OFF
          McuPeripheralClockConfig_21: McuPerName=PORTB, McuPeripheralClockEnable=true, McuPeripheralClockFrequency=0, McuPeripheralClockSelect=EXT_CLK_OR_CLK_OFF
          McuPeripheralClockConfig_22: McuPerName=PORTC, McuPeripheralClockEnable=true, McuPeripheralClockFrequency=0, McuPeripheralClockSelect=EXT_CLK_OR_CLK_OFF
          McuPeripheralClockConfig_23: McuPerName=PORTD, McuPeripheralClockEnable=true, McuPeripheralClockFrequency=0, McuPeripheralClockSelect=EXT_CLK_OR_CLK_OFF
          McuPeripheralClockConfig_24: McuPerName=PORTE, McuPeripheralClockEnable=true, McuPeripheralClockFrequency=0, McuPeripheralClockSelect=EXT_CLK_OR_CLK_OFF
          McuPeripheralClockConfig_25: McuPerName=FLEXIO, McuPeripheralClockEnable=true, McuPeripheralClockFrequency=0, McuPeripheralClockSelect=EXT_CLK_OR_CLK_OFF
          McuPeripheralClockConfig_26: McuPerName=EWM, McuPeripheralClockEnable=true, McuPeripheralClockFrequency=0, McuPeripheralClockSelect=EXT_CLK_OR_CLK_OFF
          McuPeripheralClockConfig_27: McuPerName=LPI2C0, McuPeripheralClockEnable=false, McuPeripheralClockFrequency=0, McuPeripheralClockSelect=EXT_CLK_OR_CLK_OFF
          McuPeripheralClockConfig_28: McuPerName=LPUART0, McuPeripheralClockEnable=true, McuPeripheralClockFrequency=4000000, McuPeripheralClockSelect=SOSC
          McuPeripheralClockConfig_29: McuPerName=LPUART1, McuPeripheralClockEnable=true, McuPeripheralClockFrequency=4000000, McuPeripheralClockSelect=SOSC
          McuPeripheralClockConfig_3: McuPerName=FLEXCAN1, McuPeripheralClockEnable=true, McuPeripheralClockFrequency=0, McuPeripheralClockSelect=EXT_CLK_OR_CLK_OFF
          McuPeripheralClockConfig_30: McuPerName=LPUART2, McuPeripheralClockEnable=true, McuPeripheralClockFrequency=4000000, McuPeripheralClockSelect=SOSC
          McuPeripheralClockConfig_31: McuPerName=CMP0, McuPeripheralClockEnable=false, McuPeripheralClockFrequency=0, McuPeripheralClockSelect=EXT_CLK_OR_CLK_OFF
          McuPeripheralClockConfig_4: McuPerName=FTM3, McuPeripheralClockEnable=true, McuPeripheralClockFrequency=40000000, McuPeripheralClockSelect=SPLL
          McuPeripheralClockConfig_5: McuPerName=ADC1, McuPeripheralClockEnable=true, McuPeripheralClockFrequency=0, McuPeripheralClockSelect=EXT_CLK_OR_CLK_OFF
          McuPeripheralClockConfig_6: McuPerName=FLEXCAN2, McuPeripheralClockEnable=false, McuPeripheralClockFrequency=0, McuPeripheralClockSelect=EXT_CLK_OR_CLK_OFF
          McuPeripheralClockConfig_7: McuPerName=LPSPI0, McuPeripheralClockEnable=true, McuPeripheralClockFrequency=4000000, McuPeripheralClockSelect=SIRC
          McuPeripheralClockConfig_8: McuPerName=LPSPI1, McuPeripheralClockEnable=true, McuPeripheralClockFrequency=20000000, McuPeripheralClockSelect=SPLL
          McuPeripheralClockConfig_9: McuPerName=LPSPI2, McuPeripheralClockEnable=false, McuPeripheralClockFrequency=0, McuPeripheralClockSelect=EXT_CLK_OR_CLK_OFF
        McuRunClockConfig:
          McuBusClockDivider = 2
          McuBusClockFrequency = 40000000
          McuCoreClockDivider = 2
          McuCoreClockFrequency = 80000000
          McuFlashClockFrequency = 20000000
          McuPreDivSystemClockFrequency = 160000000
          McuScgClkOutFrequency = 8000000
          McuSlowClockDivider = 4
          McuSystemClockFrequency = 80000000
          McuSystemClockSwitch = SPLL
        McuSIMClockConfig:
          McuClockOutDivider = 1
          McuClockOutEnable = true
          McuClockOutSelect = SOSC_DIV2
          McuDMAClockGatingEnable = true
          McuDebugTraceDividerEnable = true
          McuEIMClockGatingEnable = true
          McuERMClockGatingEnable = true
          McuMPUClockGatingEnable = true
          McuMSCMClockGatingEnable = true
          McuTraceClockDivider = 1
          McuTraceClockFraction = 0
          McuTraceClockSelect = CORE_CLK
        McuSIRCClockConfig:
          McuSIRCDiv1 = 1
          McuSIRCDiv1Frequency = 8000000
          McuSIRCDiv2 = 2
          McuSIRCDiv2Frequency = 4000000
          McuSIRCEnable = true
          McuSIRCFrequency = 8000000
          McuSIRCLowPowerEnable = true
          McuSIRCRangeSelect = HIGH_RANGE_CLOCK
          McuSIRCStopEnable = false
          McuSIRCUnderMcuControl = true
        McuSystemOSCClockConfig:
          McuSOSCClockMonitorEnable = false
          McuSOSCClockMonitorResetEnable = false
          McuSOSCDiv1 = 1
          McuSOSCDiv1Frequency = 8000000
          McuSOSCDiv2 = 2
          McuSOSCDiv2Frequency = 4000000
          McuSOSCEnable = true
          McuSOSCExternalReferenceSelect = false
          McuSOSCFrequency = 8000000
          McuSOSCHighGainOscillatorSelect = true
          McuSOSCRangeSelect = HIGH_FREQ_RANGE
          McuSOSCUnderMcuControl = true
        McuSystemPll:
          McuSPLLClockMonitorEnable = false
          McuSPLLClockMonitorResetEnable = false
          McuSPLLDiv1 = 4
          McuSPLLDiv1Frequency = 40000000
          McuSPLLDiv2 = 8
          McuSPLLDiv2Frequency = 20000000
          McuSPLLEnable = true
          McuSPLLFrequency = 160000000
          McuSPLLInputClkPreDivider = 1
          McuSPLLInputFrequency = 8000000
          McuSPLLMultiplier = 40
          McuSystemPllUnderMcuControl = true
        McuVlprClockConfig:
          McuBusClockDivider = 1
          McuBusClockFrequency = 4000000
          McuCoreClockDivider = 2
          McuCoreClockFrequency = 4000000
          McuFlashClockFrequency = 1000000
          McuPreDivSystemClockFrequency = 8000000
          McuScgClkOutFrequency = 8000000
          McuSlowClockDivider = 4
          McuSystemClockFrequency = 4000000
          McuSystemClockSwitch = SIRC
        McuClockReferencePoint_LPUART2_CLK (McuClockReferencePoint): McuClockFrequencySelect=LPUART2_CLK, McuClockReferencePointFrequency=4000000
      McuInterruptEvents: McuAlternateResetEvent=false, McuVoltageErrorEvent=false
      McuModeSettingConf_0 (McuModeSettingConf): McuMode=0, McuPowerMode=RUN
      McuPowerControl:
        McuClockBiasDisable = false
        McuLPODisable = false
        McuLowPowerBiasEnable = false
        McuLowVoltageDetectInterruptEnable = false
        McuLowVoltageDetectResetEnable = false
        McuLowVoltageWarningInterruptEnable = false
        McuLpoTrimming = 0
      McuRamSectorSettingConf_0 (McuRamSectorSettingConf):
        McuRamDefaultValue = 0
        McuRamSectionBaseAddrLinkerSym = 
        McuRamSectionBaseAddress = 536854528
        McuRamSectionSize = 1024
        McuRamSectionSizeLinkerSym = 
        McuRamSectorId = 0
      McuResetConfig: McuResetPinFilterBusClockSelect=0, McuResetPinFilterInRunAndWait=ALL_FILTERING_DISABLE, McuResetPinFilterInStopMode=ALL_FILTERING_DISABLE
        McuSystemInterruptEnable:
          McuCoreLockupInterrupt = false
          McuExternalResetPinInterrupt = false
          McuGlobalInterrupt = true
          McuJTAGResetInterrupt = false
          McuLossOfClockInterrupt = false
          McuLossOfLockInterrupt = false
          McuMDMAPSystemResetInterrupt = false
          McuResetDelayTime = DELAY_514_LPO_CYCLES
          McuSoftwareInterrupt = false
          McuStopAcknowledgeErrorInterrupt = false
          McuWatchdogInterrupt = true
      McuSIMConfig
        McuAdcOptionsConfiguration:
          McuADC0PreTrigeerSourceSelect = PDB_PRE_TRIGGER
          McuADC0SoftwarePreTrigeerSourceSelect = SW_PRE_TRIGGER_DISABLE
          McuADC0TrigeerSourceSelect = PDB
          McuADC1PreTrigeerSourceSelect = PDB_PRE_TRIGGER
          McuADC1SoftwarePreTrigeerSourceSelect = SW_PRE_TRIGGER_DISABLE
          McuADC1TrigeerSourceSelect = PDB
          McuSoftwareTriggerToTRGMUX = false
        McuChipControlConfiguration:
          McuAdcSupply = VDD
          McuEnableAdcSupplyMonitoring = true
          McuPDBBackToBackSelect = false
          McuPTB0InterleaveChannelSelect = false
          McuPTB13InterleaveChannelSelect = false
          McuPTB14InterleaveChannelSelect = false
          McuPTB1InterleaveChannelSelect = false
        McuFlexTimerConfiguration:
          McuFTM0Ch{0..7}ModulationSelect = false
          McuFTM0ExternalClockPinSelect = NO_CLOCK
          McuFTM0Fault{0..2}Select = FTM0_FLT{0..2}_PIN
          McuFTM0OBEControl = false
          McuFTM0SyncBit = false
          McuFTM1Ch0InputSelect = FTM1_CH0_INPUT
          McuFTM1ExternalClockPinSelect = NO_CLOCK
          McuFTM1Fault{0..2}Select = FTM1_FLT{0..2}_PIN
          McuFTM1OBEControl = false
          McuFTM1SyncBit = false
          McuFTM2Ch0InputSelect = FTM2_CH0_INPUT
          McuFTM2Ch1InputSelect = FTM2_CHI1_INPUT
          McuFTM2ExternalClockPinSelect = NO_CLOCK
          McuFTM2Fault{0..2}Select = FTM2_FLT{0..2}_PIN
          McuFTM2OBEControl = false
          McuFTM2SyncBit = false
          McuFTM3Ch{0..7}ModulationSelect = false
          McuFTM3ExternalClockPinSelect = NO_CLOCK
          McuFTM3Fault{0..2}Select = FTM3_FLT{0..2}_PIN
          McuFTM3OBEControl = false
          McuFTM3SyncBit = false
          McuFTM4ExternalClockPinSelect = TCLK0_PIN
          McuFTM4OBEControl = false
          McuFTM4SyncBit = false
          McuFTM5ExternalClockPinSelect = TCLK0_PIN
          McuFTM5OBEControl = false
          McuFTM5SyncBit = false
          McuFTM6ExternalClockPinSelect = TCLK0_PIN
          McuFTM6OBEControl = false
          McuFTM6SyncBit = false
          McuFTM7ExternalClockPinSelect = TCLK0_PIN
          McuFTM7OBEControl = false
          McuFTM7SyncBit = false
          McuFTMGlobalLoadEnable = false
          McuFTM_GTBControl = false
          McuQspiClkSelect = false
          McuRMII_ClkSelect = false
          McuRMII_Clk_OBE = false
    McuPublishedInformation
      14 x McuResetReasonConf, all with McuResetReason=5:
        MCU_CORE_LOCKUP_RESET
        MCU_EXTERNAL_PIN_RESET
        MCU_JTAG_RESET
        MCU_LOSS_OF_CLOCK_RESET
        MCU_LOSS_OF_LOCK_RESET
        MCU_LOW_OR_HIGH_VOLTAGE_DETECT_RESET
        MCU_MDM_AP_SYSTEM_RESET
        MCU_MULTIPLE_RESET_REASON
        MCU_NO_RESET_REASON
        MCU_POWER_ON_RESET
        MCU_RESET_UNDEFINED
        MCU_SOFTWARE_RESET
        MCU_STOP_ACKNOWLEDGE_ERROR_RESET
        MCU_WATCHDOG_RESET
