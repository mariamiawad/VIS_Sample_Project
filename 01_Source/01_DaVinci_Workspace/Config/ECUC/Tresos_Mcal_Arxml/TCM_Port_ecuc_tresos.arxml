AUTOSAR XML (schema 4-2-2)
package /Port
  module config Port: implementation-config-variant=VARIANT-POST-BUILD, module-description=BswImplementation_0
    CommonPublishedInformation:
      ArReleaseMajorVersion = 4
      ArReleaseMinorVersion = 2
      ArReleaseRevisionVersion = 2
      ModuleId = 124
      SwMajorVersion = 1
      SwMinorVersion = 0
      SwPatchVersion = 0
      VendorId = 43
    PortConfigSet
      NotUsedPortPin: PortPinDSE=Low_Drive_Strength, PortPinDirection=PORT_PIN_OUT, PortPinLevelValue=PORT_PIN_LEVEL_LOW, PortPinPE=PullDisabled, PortPinPS=PullDown
      PortContainer_0 (PortContainer): PortNumberOfPortPins=47
        47 x PortPin, all with PortPinInitialMode=PORT_GPIO_MODE, PortPinPFE=false:
          PortPin_CLESS_SWIT_SCLK: PortPinDSE=Low_drive_strength, PortPinDirection=PORT_PIN_OUT, PortPinDirectionChangeable=true, PortPinId=2, PortPinLevelValue=PORT_PIN_LEVEL_LOW, PortPinMode=LPSPI0_SCK, PortPinModeChangeable=false, PortPinPE=PullDisabled, PortPinPS=PullDown, PortPinPcr=34
          PortPin_CLESS_SWIT_SCS: PortPinDSE=Low_drive_strength, PortPinDirection=PORT_PIN_OUT, PortPinDirectionChangeable=true, PortPinId=37, PortPinLevelValue=PORT_PIN_LEVEL_LOW, PortPinMode=LPSPI0_PCS0, PortPinModeChangeable=false, PortPinPE=PullDisabled, PortPinPS=PullDown, PortPinPcr=37
          PortPin_CLESS_SWIT_SIN: PortPinDSE=Low_drive_strength, PortPinDirection=PORT_PIN_IN, PortPinDirectionChangeable=true, PortPinId=15, PortPinLevelValue=PORT_PIN_LEVEL_LOW, PortPinMode=LPSPI0_SIN, PortPinModeChangeable=false, PortPinPE=PullDisabled, PortPinPS=PullDown, PortPinPcr=35
          PortPin_CLESS_SWIT_SOUT: PortPinDSE=Low_drive_strength, PortPinDirection=PORT_PIN_OUT, PortPinDirectionChangeable=true, PortPinId=14, PortPinLevelValue=PORT_PIN_LEVEL_LOW, PortPinMode=LPSPI0_SOUT, PortPinModeChangeable=false, PortPinPE=PullDisabled, PortPinPS=PullDown, PortPinPcr=36
          PortPin_CLESS_SWT_ICU: PortPinDSE=Low_drive_strength, PortPinDirection=PORT_PIN_IN, PortPinDirectionChangeable=false, PortPinId=41, PortPinLevelValue=PORT_PIN_LEVEL_LOW, PortPinMode=GPIO, PortPinModeChangeable=false, PortPinPE=PullDisabled, PortPinPS=PullDown, PortPinPcr=66
          PortPin_CMD_TOR_A: PortPinDSE=Low_drive_strength, PortPinDirection=PORT_PIN_OUT, PortPinDirectionChangeable=false, PortPinId=25, PortPinLevelValue=PORT_PIN_LEVEL_LOW, PortPinMode=GPIO, PortPinModeChangeable=false, PortPinPE=PullDisabled, PortPinPS=PullDown, PortPinPcr=11
          PortPin_CMD_TOR_B: PortPinDSE=Low_drive_strength, PortPinDirection=PORT_PIN_OUT, PortPinDirectionChangeable=false, PortPinId=26, PortPinLevelValue=PORT_PIN_LEVEL_LOW, PortPinMode=GPIO, PortPinModeChangeable=false, PortPinPE=PullDisabled, PortPinPS=PullDown, PortPinPcr=12
          PortPin_CMD_TOR_C: PortPinDSE=Low_drive_strength, PortPinDirection=PORT_PIN_OUT, PortPinDirectionChangeable=false, PortPinId=27, PortPinLevelValue=PORT_PIN_LEVEL_LOW, PortPinMode=GPIO, PortPinModeChangeable=false, PortPinPE=PullDisabled, PortPinPS=PullDown, PortPinPcr=13
          PortPin_CMD_TOR_D: PortPinDSE=Low_drive_strength, PortPinDirection=PORT_PIN_OUT, PortPinDirectionChangeable=false, PortPinId=28, PortPinLevelValue=PORT_PIN_LEVEL_LOW, PortPinMode=GPIO, PortPinModeChangeable=false, PortPinPE=PullDisabled, PortPinPS=PullDown, PortPinPcr=14
          PortPin_CMD_TOR_E: PortPinDSE=Low_drive_strength, PortPinDirection=PORT_PIN_OUT, PortPinDirectionChangeable=false, PortPinId=29, PortPinLevelValue=PORT_PIN_LEVEL_LOW, PortPinMode=GPIO, PortPinModeChangeable=false, PortPinPE=PullDisabled, PortPinPS=PullDown, PortPinPcr=15
          PortPin_CMD_TOR_F: PortPinDSE=Low_drive_strength, PortPinDirection=PORT_PIN_OUT, PortPinDirectionChangeable=false, PortPinId=30, PortPinLevelValue=PORT_PIN_LEVEL_LOW, PortPinMode=GPIO, PortPinModeChangeable=false, PortPinPE=PullDisabled, PortPinPS=PullDown, PortPinPcr=16
          PortPin_Can_Rx: PortPinDSE=Low_drive_strength, PortPinDirection=PORT_PIN_IN, PortPinDirectionChangeable=false, PortPinId=42, PortPinLevelValue=PORT_PIN_LEVEL_LOW, PortPinMode=CAN0_RX, PortPinModeChangeable=false, PortPinPE=PullDisabled, PortPinPS=PullDown, PortPinPcr=132
          PortPin_Can_Tx: PortPinDSE=Low_drive_strength, PortPinDirection=PORT_PIN_OUT, PortPinDirectionChangeable=false, PortPinId=43, PortPinLevelValue=PORT_PIN_LEVEL_LOW, PortPinMode=CAN0_TX, PortPinModeChangeable=false, PortPinPE=PullDisabled, PortPinPS=PullDown, PortPinPcr=133
          PortPin_DBG_LED: PortPinDSE=Low_drive_strength, PortPinDirection=PORT_PIN_OUT, PortPinDirectionChangeable=true, PortPinId=12, PortPinLevelValue=PORT_PIN_LEVEL_LOW, PortPinMode=GPIO, PortPinModeChangeable=true, PortPinPE=PullDisabled, PortPinPS=PullDown, PortPinPcr=64
          PortPin_DMX_E1L: PortPinDSE=Low_drive_strength, PortPinDirection=PORT_PIN_IN, PortPinDirectionChangeable=false, PortPinId=17, PortPinLevelValue=PORT_PIN_LEVEL_LOW, PortPinMode=GPIO, PortPinModeChangeable=false, PortPinPE=PullDisabled, PortPinPS=PullDown, PortPinPcr=0
          PortPin_DMX_E1W: PortPinDSE=Low_drive_strength, PortPinDirection=PORT_PIN_IN, PortPinDirectionChangeable=false, PortPinId=21, PortPinLevelValue=PORT_PIN_LEVEL_LOW, PortPinMode=GPIO, PortPinModeChangeable=false, PortPinPE=PullDisabled, PortPinPS=PullDown, PortPinPcr=6
          PortPin_DMX_E2L: PortPinDSE=Low_drive_strength, PortPinDirection=PORT_PIN_IN, PortPinDirectionChangeable=false, PortPinId=18, PortPinLevelValue=PORT_PIN_LEVEL_LOW, PortPinMode=GPIO, PortPinModeChangeable=false, PortPinPE=PullDisabled, PortPinPS=PullDown, PortPinPcr=1
          PortPin_DMX_E2W: PortPinDSE=Low_drive_strength, PortPinDirection=PORT_PIN_IN, PortPinDirectionChangeable=false, PortPinId=22, PortPinLevelValue=PORT_PIN_LEVEL_LOW, PortPinMode=GPIO, PortPinModeChangeable=false, PortPinPE=PullDisabled, PortPinPS=PullDown, PortPinPcr=7
          PortPin_DMX_E3L: PortPinDSE=Low_drive_strength, PortPinDirection=PORT_PIN_IN, PortPinDirectionChangeable=false, PortPinId=19, PortPinLevelValue=PORT_PIN_LEVEL_LOW, PortPinMode=GPIO, PortPinModeChangeable=false, PortPinPE=PullDisabled, PortPinPS=PullDown, PortPinPcr=2
          PortPin_DMX_E3W: PortPinDSE=Low_drive_strength, PortPinDirection=PORT_PIN_IN, PortPinDirectionChangeable=false, PortPinId=23, PortPinLevelValue=PORT_PIN_LEVEL_LOW, PortPinMode=GPIO, PortPinModeChangeable=false, PortPinPE=PullDisabled, PortPinPS=PullDown, PortPinPcr=8
          PortPin_DMX_E4L: PortPinDSE=Low_drive_strength, PortPinDirection=PORT_PIN_IN, PortPinDirectionChangeable=false, PortPinId=20, PortPinLevelValue=PORT_PIN_LEVEL_LOW, PortPinMode=GPIO, PortPinModeChangeable=false, PortPinPE=PullDisabled, PortPinPS=PullDown, PortPinPcr=3
          PortPin_DMX_E4W: PortPinDSE=Low_drive_strength, PortPinDirection=PORT_PIN_IN, PortPinDirectionChangeable=false, PortPinId=24, PortPinLevelValue=PORT_PIN_LEVEL_LOW, PortPinMode=GPIO, PortPinModeChangeable=false, PortPinPE=PullDisabled, PortPinPS=PullDown, PortPinPcr=9
          PortPin_EXTAL: PortPinDSE=Low_drive_strength, PortPinDirection=PORT_PIN_IN, PortPinDirectionChangeable=true, PortPinId=8, PortPinLevelValue=PORT_PIN_LEVEL_LOW, PortPinMode=EXTAL, PortPinModeChangeable=false, PortPinPE=PullDisabled, PortPinPS=PullDown, PortPinPcr=39
          PortPin_EXT_CLOCK: PortPinDSE=Low_drive_strength, PortPinDirection=PORT_PIN_OUT, PortPinDirectionChangeable=true, PortPinId=6, PortPinLevelValue=PORT_PIN_LEVEL_LOW, PortPinMode=CLKOUT, PortPinModeChangeable=true, PortPinPE=PullDisabled, PortPinPS=PullDown, PortPinPcr=138
          PortPin_JTAG_TCLK: PortPinDSE=Low_drive_strength, PortPinDirection=PORT_PIN_IN, PortPinDirectionChangeable=true, PortPinId=11, PortPinLevelValue=PORT_PIN_LEVEL_LOW, PortPinMode=JTAG_TCLK_SWD_CLK, PortPinModeChangeable=false, PortPinPE=PullEnabled, PortPinPS=PullDown, PortPinPcr=68
          PortPin_JTAG_TDI: PortPinDSE=Low_drive_strength, PortPinDirection=PORT_PIN_IN, PortPinDirectionChangeable=true, PortPinId=10, PortPinLevelValue=PORT_PIN_LEVEL_LOW, PortPinMode=JTAG_TDI, PortPinModeChangeable=false, PortPinPE=PullEnabled, PortPinPS=PullUp, PortPinPcr=69
          PortPin_JTAG_TDO: PortPinDSE=Low_drive_strength, PortPinDirection=PORT_PIN_OUT, PortPinDirectionChangeable=true, PortPinId=9, PortPinLevelValue=PORT_PIN_LEVEL_LOW, PortPinMode=JTAG_TDO, PortPinModeChangeable=false, PortPinPE=PullDisabled, PortPinPS=PullDown, PortPinPcr=10
          PortPin_JTAG_TMS: PortPinDSE=Low_drive_strength, PortPinDirection=PORT_PIN_IN, PortPinDirectionChangeable=true, PortPinId=13, PortPinLevelValue=PORT_PIN_LEVEL_LOW, PortPinMode=JTAG_TMS_SWD_DIO, PortPinModeChangeable=true, PortPinPE=PullEnabled, PortPinPS=PullUp, PortPinPcr=4
          PortPin_Key1: PortPinDSE=Low_drive_strength, PortPinDirection=PORT_PIN_IN, PortPinDirectionChangeable=false, PortPinId=5, PortPinLevelValue=PORT_PIN_LEVEL_LOW, PortPinMode=GPIO, PortPinModeChangeable=false, PortPinPE=PullDisabled, PortPinPS=PullDown, PortPinPcr=76
          PortPin_Led2: PortPinDSE=Low_drive_strength, PortPinDirection=PORT_PIN_OUT, PortPinDirectionChangeable=true, PortPinId=3, PortPinLevelValue=PORT_PIN_LEVEL_HIGH, PortPinMode=GPIO, PortPinModeChangeable=true, PortPinPE=PullDisabled, PortPinPS=PullDown, PortPinPcr=111
          PortPin_Led3: PortPinDSE=Low_drive_strength, PortPinDirection=PORT_PIN_OUT, PortPinDirectionChangeable=true, PortPinId=4, PortPinLevelValue=PORT_PIN_LEVEL_HIGH, PortPinMode=GPIO, PortPinModeChangeable=true, PortPinPE=PullDisabled, PortPinPS=PullDown, PortPinPcr=112
          PortPin_RF_ICU: PortPinDSE=Low_drive_strength, PortPinDirection=PORT_PIN_IN, PortPinDirectionChangeable=false, PortPinId=39, PortPinLevelValue=PORT_PIN_LEVEL_LOW, PortPinMode=GPIO, PortPinModeChangeable=false, PortPinPE=PullDisabled, PortPinPS=PullDown, PortPinPcr=65
          PortPin_RF_P_ON: PortPinDSE=Low_drive_strength, PortPinDirection=PORT_PIN_OUT, PortPinDirectionChangeable=false, PortPinId=40, PortPinLevelValue=PORT_PIN_LEVEL_LOW, PortPinMode=GPIO, PortPinModeChangeable=false, PortPinPE=PullDisabled, PortPinPS=PullDown, PortPinPcr=100
          PortPin_RF_SCLK: PortPinDSE=Low_drive_strength, PortPinDirection=PORT_PIN_OUT, PortPinDirectionChangeable=false, PortPinId=34, PortPinLevelValue=PORT_PIN_LEVEL_LOW, PortPinMode=LPSPI1_SCK, PortPinModeChangeable=false, PortPinPE=PullDisabled, PortPinPS=PullDown, PortPinPcr=96
          PortPin_RF_SCS: PortPinDSE=Low_drive_strength, PortPinDirection=PORT_PIN_OUT, PortPinDirectionChangeable=true, PortPinId=38, PortPinLevelValue=PORT_PIN_LEVEL_LOW, PortPinMode=LPSPI1_PCS0, PortPinModeChangeable=false, PortPinPE=PullDisabled, PortPinPS=PullDown, PortPinPcr=99
          PortPin_RF_SIN: PortPinDSE=Low_drive_strength, PortPinDirection=PORT_PIN_IN, PortPinDirectionChangeable=true, PortPinId=35, PortPinLevelValue=PORT_PIN_LEVEL_LOW, PortPinMode=LPSPI1_SIN, PortPinModeChangeable=false, PortPinPE=PullDisabled, PortPinPS=PullDown, PortPinPcr=97
          PortPin_RF_SOUT: PortPinDSE=Low_drive_strength, PortPinDirection=PORT_PIN_OUT, PortPinDirectionChangeable=true, PortPinId=36, PortPinLevelValue=PORT_PIN_LEVEL_LOW, PortPinMode=LPSPI1_SOUT, PortPinModeChangeable=false, PortPinPE=PullDisabled, PortPinPS=PullDown, PortPinPcr=98
          PortPin_SOUND_FREQ: PortPinDSE=Low_drive_strength, PortPinDirection=PORT_PIN_IN, PortPinDirectionChangeable=false, PortPinId=16, PortPinLevelValue=PORT_PIN_LEVEL_LOW, PortPinMode=FTM1_CH4, PortPinModeChangeable=false, PortPinPE=PullDisabled, PortPinPS=PullDown, PortPinPcr=104
          PortPin_SOUND_VOL: PortPinDSE=Low_drive_strength, PortPinDirection=PORT_PIN_OUT, PortPinDirectionChangeable=false, PortPinId=1, PortPinLevelValue=PORT_PIN_LEVEL_LOW, PortPinMode=FTM2_CH2, PortPinModeChangeable=false, PortPinPE=PullDisabled, PortPinPS=PullDown, PortPinPcr=108
          PortPin_TRSP_CLK: PortPinDSE=Low_drive_strength, PortPinDirection=PORT_PIN_OUT, PortPinDirectionChangeable=false, PortPinId=31, PortPinLevelValue=PORT_PIN_LEVEL_LOW, PortPinMode=GPIO, PortPinModeChangeable=false, PortPinPE=PullDisabled, PortPinPS=PullDown, PortPinPcr=49
          PortPin_TRSP_ICUtoDIOin: PortPinDSE=Low_drive_strength, PortPinDirection=PORT_PIN_IN, PortPinDirectionChangeable=true, PortPinId=32, PortPinLevelValue=PORT_PIN_LEVEL_LOW, PortPinMode=FTM3_CH2, PortPinModeChangeable=true, PortPinPE=PullDisabled, PortPinPS=PullDown, PortPinPcr=42
          PortPin_TRSP_PWMtoDIOout: PortPinDSE=Low_drive_strength, PortPinDirection=PORT_PIN_OUT, PortPinDirectionChangeable=true, PortPinId=33, PortPinLevelValue=PORT_PIN_LEVEL_LOW, PortPinMode=FTM0_CH3, PortPinModeChangeable=true, PortPinPE=PullDisabled, PortPinPS=PullDown, PortPinPcr=47
          PortPin_XTAL: PortPinDSE=High_drive_strength, PortPinDirection=PORT_PIN_OUT, PortPinDirectionChangeable=true, PortPinId=7, PortPinLevelValue=PORT_PIN_LEVEL_LOW, PortPinMode=XTAL, PortPinModeChangeable=false, PortPinPE=PullDisabled, PortPinPS=PullDown, PortPinPcr=38
          Test_OS_Time: PortPinDirectionChangeable=true, PortPinModeChangeable=true, PortPinId=44, PortPinPcr=70, PortPinMode=GPIO, PortPinDSE=Low_drive_strength, PortPinPE=PullDisabled, PortPinPS=PullDown, PortPinDirection=PORT_PIN_OUT, PortPinLevelValue=PORT_PIN_LEVEL_LOW
          LIN_TX: PortPinDirectionChangeable=true, PortPinModeChangeable=true, PortPinId=47, PortPinPcr=103, PortPinMode=LPUART2_TX, PortPinDSE=Low_drive_strength, PortPinPE=PullDisabled, PortPinPS=PullDown, PortPinDirection=PORT_PIN_OUT, PortPinLevelValue=PORT_PIN_LEVEL_LOW
          LIN_RX: PortPinDirectionChangeable=true, PortPinModeChangeable=true, PortPinId=45, PortPinPcr=102, PortPinMode=LPUART2_RX, PortPinDSE=Low_drive_strength, PortPinPE=PullDisabled, PortPinPS=PullDown, PortPinDirection=PORT_PIN_OUT, PortPinLevelValue=PORT_PIN_LEVEL_LOW
          LIN_Tranciver: PortPinDirectionChangeable=true, PortPinModeChangeable=true, PortPinId=46, PortPinPcr=137, PortPinMode=GPIO, PortPinDSE=Low_drive_strength, PortPinPE=PullDisabled, PortPinPS=PullDown, PortPinDirection=PORT_PIN_OUT, PortPinLevelValue=PORT_PIN_LEVEL_LOW
    PortGeneral:
      PortDevErrorDetect = false
      PortEnableUserModeSupport = false
      PortSetPinDirectionApi = true
      PortSetPinModeApi = true
      PortSetPinModeDoesNotTouchGpioLevel = false
      PortVersionInfoApi = true
