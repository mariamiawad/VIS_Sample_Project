AUTOSAR XML (schema 4-2-2)
package /Gpt
  module config Gpt: implementation-config-variant=VARIANT-POST-BUILD, module-description=BswImplementation_0
    CommonPublishedInformation:
      ArReleaseMajorVersion = 4
      ArReleaseMinorVersion = 2
      ArReleaseRevisionVersion = 2
      ModuleId = 100
      SwMajorVersion = 1
      SwMinorVersion = 0
      SwPatchVersion = 0
      VendorId = 43
    GptChannelConfigSet
      3 x GptChannelConfiguration, all with GptChannelTickFrequency=4000000, GptEnableWakeup=false, GptFreezeEnable=true, GptLPitEnReloadOnTrigger=false, GptLPitEnStartOnTrigger=false, GptLPitEnStopOnInterrupt=false, GptLPitIsExternalTrigger=false:
        GptChannelConfiguration_LedBlinker: GptChannelId=0, GptChannelMode=GPT_CH_MODE_CONTINUOUS, GptChannelTickValueMax=4294967295, GptFtmChannelClkSrc=SYSTEM_CLOCK, GptFtmPrescaler=1, GptFtmPrescaler_Alternate=1, GptHwChannel=LPIT_0_CH_0, GptLptmrChannelClkSrc=SIRCDIV2_CLK, GptLptmrPrescaler=2, GptLptmrPrescaler_Alternate=2, GptNotification=SampleAppGptLed, GptSRtcChannelClkSrc=EXTERNAL_CLOCK, GptChannelClkSrcRef=GptClockReferencePoint_0
        OS_TIMER: GptChannelId=2, GptChannelMode=GPT_CH_MODE_CONTINUOUS, GptChannelTickValueMax=65535, GptHwChannel=LPIT_0_CH_2, GptNotification=GPT_SYS_TICK, GptChannelClkSrcRef=GptClockReferencePoint_1
        TRSP_Timer: GptChannelId=1, GptChannelMode=GPT_CH_MODE_ONESHOT, GptChannelTickValueMax=4294967295, GptFtmChannelClkSrc=SYSTEM_CLOCK, GptFtmPrescaler=4, GptHwChannel=LPIT_0_CH_1, GptNotification=GPT_TimerNotification0, GptChannelClkSrcRef=GptClockReferencePoint_0
    GptConfigurationOfOptApiServices:
      GptDeinitApi = true
      GptEnableDisableNotificationApi = true
      GptPredefTimerFunctionalityApi = false
      GptTimeElapsedApi = true
      GptTimeRemainingApi = true
      GptVersionInfoApi = true
      GptWakeupFunctionalityApi = true
    GptDriverConfiguration:
      GptDevErrorDetect = false
      GptPredefTimer100us32bitEnable = false
      GptPredefTimer1usEnablingGrade = GPT_PREDEF_TIMER_1US_16BIT_ENABLED
      GptRegisterLockingMode = NO_REGISTER_LOCKING
      GptReportWakeupSource = true
      GptClockReferencePoint_0 (GptClockReferencePoint): GptClockReference=McuClockReferencePoint_SIRCDIV2_CLK
      GptClockReferencePoint_1 (GptClockReferencePoint): GptClockReference=McuClockReferencePoint_LPIT0_CLK
    22 x GptHwConfiguration:
      GptHwConfiguration_0: GptIsrEnable=true, GptIsrHwId=LPIT_0_CH_0, GptModuleIsUsed=true
      GptHwConfiguration_1: GptIsrEnable=true, GptIsrHwId=LPIT_0_CH_1, GptModuleIsUsed=true
      GptHwConfiguration_10: GptIsrEnable=false, GptIsrHwId=FTM_1_CH_4_CH_5, GptModuleIsUsed=false
      GptHwConfiguration_11: GptIsrEnable=false, GptIsrHwId=FTM_1_CH_6_CH_7, GptModuleIsUsed=false
      GptHwConfiguration_12: GptIsrEnable=false, GptIsrHwId=FTM_2_CH_0_CH_1, GptModuleIsUsed=false
      GptHwConfiguration_13: GptIsrEnable=false, GptIsrHwId=FTM_2_CH_2_CH_3, GptModuleIsUsed=false
      GptHwConfiguration_14: GptIsrEnable=false, GptIsrHwId=FTM_2_CH_4_CH_5, GptModuleIsUsed=false
      GptHwConfiguration_15: GptIsrEnable=false, GptIsrHwId=FTM_2_CH_6_CH_7, GptModuleIsUsed=false
      GptHwConfiguration_16: GptIsrEnable=false, GptIsrHwId=FTM_3_CH_0_CH_1, GptModuleIsUsed=false
      GptHwConfiguration_17: GptIsrEnable=false, GptIsrHwId=FTM_3_CH_2_CH_3, GptModuleIsUsed=false
      GptHwConfiguration_18: GptIsrEnable=false, GptIsrHwId=FTM_3_CH_4_CH_5, GptModuleIsUsed=false
      GptHwConfiguration_19: GptIsrEnable=false, GptIsrHwId=FTM_3_CH_6_CH_7, GptModuleIsUsed=false
      GptHwConfiguration_2: GptIsrEnable=true, GptIsrHwId=LPIT_0_CH_2, GptModuleIsUsed=true
      GptHwConfiguration_20: GptIsrEnable=true, GptIsrHwId=LPTMR_0_CH_0, GptModuleIsUsed=true
      GptHwConfiguration_21: GptIsrEnable=false, GptIsrHwId=SRTC_0_CH_0, GptModuleIsUsed=false
      GptHwConfiguration_3: GptIsrEnable=false, GptIsrHwId=LPIT_0_CH_3, GptModuleIsUsed=false
      GptHwConfiguration_4: GptIsrEnable=false, GptIsrHwId=FTM_0_CH_0_CH_1, GptModuleIsUsed=false
      GptHwConfiguration_5: GptIsrEnable=false, GptIsrHwId=FTM_0_CH_2_CH_3, GptModuleIsUsed=false
      GptHwConfiguration_6: GptIsrEnable=false, GptIsrHwId=FTM_0_CH_4_CH_5, GptModuleIsUsed=false
      GptHwConfiguration_7: GptIsrEnable=false, GptIsrHwId=FTM_0_CH_6_CH_7, GptModuleIsUsed=false
      GptHwConfiguration_8: GptIsrEnable=false, GptIsrHwId=FTM_1_CH_0_CH_1, GptModuleIsUsed=false
      GptHwConfiguration_9: GptIsrEnable=false, GptIsrHwId=FTM_1_CH_2_CH_3, GptModuleIsUsed=false
    GptNonAUTOSAR: GptEnableDualClockMode=false, GptEnableTriggers=false, GptEnableUserModeSupport=false
    GptPredefTimerConfiguration
