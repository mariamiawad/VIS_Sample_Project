AUTOSAR XML (schema 4-2-2)
package /Pwm
  module config Pwm: implementation-config-variant=VARIANT-POST-BUILD, module-description=BswImplementation_0
    CommonPublishedInformation:
      ArReleaseMajorVersion = 4
      ArReleaseMinorVersion = 2
      ArReleaseRevisionVersion = 2
      ModuleId = 121
      SwMajorVersion = 1
      SwMinorVersion = 0
      SwPatchVersion = 0
      VendorId = 43
    PwmChannelConfigSet
      3 x PwmChannel, all with PwmDutycycleDefault=8192, PwmIdleState=PWM_LOW, PwmPeriodInTicks=true, PwmPolarity=PWM_HIGH, PwmMcuClockReferencePoint=McuClockReferencePoint_RUN_BUS_CLK:
        Pwm_Freq: PwmChannelClass=PWM_VARIABLE_PERIOD, PwmChannelId=2, PwmPeriodDefault=166, PwmFtmChannel=PwmFtmModule_1/PwmFtmChannels_0
        Pwm_TRSP_Dout: PwmChannelClass=PWM_VARIABLE_PERIOD, PwmChannelId=0, PwmNotification=Pwm_TRSPNotification, PwmPeriodDefault=0, PwmFtmChannel=PwmFtmModule_0/PwmFtmChannels_0
        Pwm_Volume: PwmChannelClass=PWM_FIXED_PERIOD, PwmChannelId=1, PwmPeriodDefault=10, PwmFtmChannel=PwmFtmModule_2/PwmFtmChannels_0
      3 x PwmFtmModule, all with PwmBDMEnable=CNT_ON_OUTPUTS_ON, PwmChanEdgeAlignment=PWM_EDGE_ALIGNED, PwmClockSelection=PWM_SYSTEM_CLOCK, PwmFtmFaultFunctionality=FLTCTRL_DISABLED, PwmPrescaler_Alternate=PRESC_1, PwmReloadFrequency=LDFQ_EACH1, PwmUpdatedEndPeriod=true, PwmUpdatedMiddlePeriod=false:
        PwmFtmModule_0: FtmModule=FTM_0, PwmPrescaler=PRESC_4
          PwmExternalTriggerSettings:
            PwmEnableExternalTriggerChannel{0..7} = false
            PwmEnableInitializationTrigger = false
          PwmFtmChannelFaultSettings:
            PwmDisableOutputOnFault{0..3} = false
            PwmFilterValue = 0
            PwmFtmFaultOutputState = SAFE_VALUES
            PwmFtmChannelFault{0..3}Settings: PwmEnableFault{0..3}Filter=false, PwmFault{0..3}Notification=NULL, PwmFault{0..3}Polarity=false
          PwmFtmChannels_0 (PwmFtmChannels): ChannelCombDeadTimeEn=true, ChannelEdgeSetup=INDEPENDENT, PwmFtmChannelId=FTM_0_CH_3, PwmPhaseShift=0
        PwmFtmModule_1: FtmModule=FTM_1, PwmPrescaler=PRESC_128
          PwmExternalTriggerSettings:
            PwmEnableExternalTriggerChannel{0..7} = false
            PwmEnableInitializationTrigger = false
          PwmFtmChannelFaultSettings:
            PwmDisableOutputOnFault{0..3} = false
            PwmFilterValue = 0
            PwmFtmFaultOutputState = SAFE_VALUES
            PwmFtmChannelFault{0..3}Settings: PwmEnableFault{0..3}Filter=false, PwmFault{0..3}Notification=NULL, PwmFault{0..3}Polarity=false
          PwmFtmChannels_0 (PwmFtmChannels): ChannelCombDeadTimeEn=false, ChannelEdgeSetup=INDEPENDENT, PwmFtmChannelId=FTM_1_CH_4, PwmPhaseShift=0
        PwmFtmModule_2: FtmModule=FTM_2, PwmPrescaler=PRESC_64
          PwmExternalTriggerSettings:
            PwmEnableExternalTriggerChannel{0..7} = false
            PwmEnableInitializationTrigger = false
          PwmFtmChannelFaultSettings:
            PwmDisableOutputOnFault{0..3} = false
            PwmFilterValue = 0
            PwmFtmFaultOutputState = SAFE_VALUES
            PwmFtmChannelFault{0..3}Settings: PwmEnableFault{0..3}Filter=false, PwmFault{0..3}Notification=NULL, PwmFault{0..3}Polarity=false
          PwmFtmChannels_0 (PwmFtmChannels): ChannelCombDeadTimeEn=false, ChannelEdgeSetup=INDEPENDENT, PwmFtmChannelId=FTM_2_CH_2, PwmPhaseShift=0
    PwmConfigurationOfOptApiServices:
      PwmDeInitApi = true
      PwmDiableTrigger = false
      PwmEnableTrigger = false
      PwmForceOutputToZeroApi = false
      PwmGetChannelStateApi = false
      PwmGetOutputState = false
      PwmSetDutyCycle = true
      PwmSetDutyCycle_NoUpdate = false
      PwmSetOutputToIdle = true
      PwmSetPeriodAndDuty = true
      PwmSetPeriodAndDuty_NoUpdate = false
      PwmSetPhaseShift = false
      PwmSetPhaseShiftNoUpdate = false
      PwmSwResetCounter = false
      PwmVersionInfoApi = true
    PwmGeneral:
      EnableMaskingOperations = true
      PwmCommonTimebaseSupported = false
      PwmDevErrorDetect = false
      PwmDutycycleUpdatedEndperiod = true
      PwmEnableDualClockMode = false
      PwmEnablePhaseShift = false
      PwmEnableUserModeSupport = false
      PwmFaultSupport = true
      PwmFtmEnableExtTrigger = false
      PwmIndex = 0
      PwmMultiChannelSynch = false
      PwmNotificationSupported = true
      PwmPeriodUpdatedEndperiod = true
      40 x PwmHwConfiguration:
        PwmHwConfiguration_0: PwmChannelIsUsed=false, PwmInterruptEnable=false, PwmInterruptHwId=PWM_FTM_2_CH_0_ISR
        PwmHwConfiguration_1: PwmChannelIsUsed=false, PwmInterruptEnable=false, PwmInterruptHwId=PWM_FTM_0_CH_1_ISR
        PwmHwConfiguration_10: PwmChannelIsUsed=false, PwmInterruptEnable=false, PwmInterruptHwId=PWM_FTM_1_CH_0_ISR
        PwmHwConfiguration_11: PwmChannelIsUsed=false, PwmInterruptEnable=false, PwmInterruptHwId=PWM_FTM_1_CH_1_ISR
        PwmHwConfiguration_12: PwmChannelIsUsed=false, PwmInterruptEnable=false, PwmInterruptHwId=PWM_FTM_1_CH_2_ISR
        PwmHwConfiguration_13: PwmChannelIsUsed=false, PwmInterruptEnable=false, PwmInterruptHwId=PWM_FTM_1_CH_3_ISR
        PwmHwConfiguration_14: PwmChannelIsUsed=true, PwmInterruptEnable=true, PwmInterruptHwId=PWM_FTM_1_CH_4_ISR
        PwmHwConfiguration_15: PwmChannelIsUsed=false, PwmInterruptEnable=false, PwmInterruptHwId=PWM_FTM_1_CH_5_ISR
        PwmHwConfiguration_16: PwmChannelIsUsed=false, PwmInterruptEnable=false, PwmInterruptHwId=PWM_FTM_1_CH_6_ISR
        PwmHwConfiguration_17: PwmChannelIsUsed=false, PwmInterruptEnable=false, PwmInterruptHwId=PWM_FTM_1_CH_7_ISR
        PwmHwConfiguration_18: PwmChannelIsUsed=false, PwmInterruptEnable=true, PwmInterruptHwId=PWM_FTM_1_TOF_ISR
        PwmHwConfiguration_19: PwmChannelIsUsed=false, PwmInterruptEnable=false, PwmInterruptHwId=PWM_FTM_1_FAULT_ISR
        PwmHwConfiguration_2: PwmChannelIsUsed=false, PwmInterruptEnable=false, PwmInterruptHwId=PWM_FTM_0_CH_2_ISR
        PwmHwConfiguration_20: PwmChannelIsUsed=false, PwmInterruptEnable=false, PwmInterruptHwId=PWM_FTM_2_CH_0_ISR
        PwmHwConfiguration_21: PwmChannelIsUsed=false, PwmInterruptEnable=false, PwmInterruptHwId=PWM_FTM_2_CH_1_ISR
        PwmHwConfiguration_22: PwmChannelIsUsed=true, PwmInterruptEnable=true, PwmInterruptHwId=PWM_FTM_2_CH_2_ISR
        PwmHwConfiguration_23: PwmChannelIsUsed=false, PwmInterruptEnable=false, PwmInterruptHwId=PWM_FTM_2_CH_3_ISR
        PwmHwConfiguration_24: PwmChannelIsUsed=false, PwmInterruptEnable=false, PwmInterruptHwId=PWM_FTM_2_CH_4_ISR
        PwmHwConfiguration_25: PwmChannelIsUsed=false, PwmInterruptEnable=false, PwmInterruptHwId=PWM_FTM_2_CH_5_ISR
        PwmHwConfiguration_26: PwmChannelIsUsed=false, PwmInterruptEnable=false, PwmInterruptHwId=PWM_FTM_2_CH_6_ISR
        PwmHwConfiguration_27: PwmChannelIsUsed=false, PwmInterruptEnable=false, PwmInterruptHwId=PWM_FTM_2_CH_7_ISR
        PwmHwConfiguration_28: PwmChannelIsUsed=false, PwmInterruptEnable=true, PwmInterruptHwId=PWM_FTM_2_TOF_ISR
        PwmHwConfiguration_29: PwmChannelIsUsed=false, PwmInterruptEnable=false, PwmInterruptHwId=PWM_FTM_2_FAULT_ISR
        PwmHwConfiguration_3: PwmChannelIsUsed=true, PwmInterruptEnable=true, PwmInterruptHwId=PWM_FTM_0_CH_3_ISR
        PwmHwConfiguration_30: PwmChannelIsUsed=false, PwmInterruptEnable=false, PwmInterruptHwId=PWM_FTM_3_CH_0_ISR
        PwmHwConfiguration_31: PwmChannelIsUsed=false, PwmInterruptEnable=false, PwmInterruptHwId=PWM_FTM_3_CH_1_ISR
        PwmHwConfiguration_32: PwmChannelIsUsed=false, PwmInterruptEnable=false, PwmInterruptHwId=PWM_FTM_3_CH_2_ISR
        PwmHwConfiguration_33: PwmChannelIsUsed=false, PwmInterruptEnable=false, PwmInterruptHwId=PWM_FTM_3_CH_3_ISR
        PwmHwConfiguration_34: PwmChannelIsUsed=false, PwmInterruptEnable=false, PwmInterruptHwId=PWM_FTM_3_CH_4_ISR
        PwmHwConfiguration_35: PwmChannelIsUsed=false, PwmInterruptEnable=false, PwmInterruptHwId=PWM_FTM_3_CH_5_ISR
        PwmHwConfiguration_36: PwmChannelIsUsed=false, PwmInterruptEnable=false, PwmInterruptHwId=PWM_FTM_3_CH_6_ISR
        PwmHwConfiguration_37: PwmChannelIsUsed=false, PwmInterruptEnable=false, PwmInterruptHwId=PWM_FTM_3_CH_7_ISR
        PwmHwConfiguration_38: PwmChannelIsUsed=false, PwmInterruptEnable=false, PwmInterruptHwId=PWM_FTM_3_TOF_ISR
        PwmHwConfiguration_39: PwmChannelIsUsed=false, PwmInterruptEnable=false, PwmInterruptHwId=PWM_FTM_3_FAULT_ISR
        PwmHwConfiguration_{4..7}: PwmChannelIsUsed=false, PwmInterruptEnable=false, PwmInterruptHwId=PWM_FTM_0_CH_{4..7}_ISR
        PwmHwConfiguration_8: PwmChannelIsUsed=false, PwmInterruptEnable=true, PwmInterruptHwId=PWM_FTM_0_TOF_ISR
        PwmHwConfiguration_9: PwmChannelIsUsed=false, PwmInterruptEnable=false, PwmInterruptHwId=PWM_FTM_0_FAULT_ISR
