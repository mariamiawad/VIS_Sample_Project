AUTOSAR XML (schema 4-2-2)
package /Spi
  module config Spi: implementation-config-variant=VARIANT-POST-BUILD, module-description=BswImplementation_0
    CommonPublishedInformation:
      ArReleaseMajorVersion = 4
      ArReleaseMinorVersion = 2
      ArReleaseRevisionVersion = 2
      ModuleId = 83
      SwMajorVersion = 1
      SwMinorVersion = 0
      SwPatchVersion = 0
      VendorId = 43
    SpiDriver_0 (SpiDriver): SpiMaxChannel=2, SpiMaxJob=2, SpiMaxSequence=2
      SpiChannel_CLESS_SWIT (SpiChannel): SpiChannelId=0, SpiChannelType=EB, SpiDataWidth=8, SpiDefaultData=255, SpiEbMaxLength=13, SpiIbNBuffers=8, SpiTransferStart=MSB, SpiTransferWidth=1
      SpiChannel_RF (SpiChannel): SpiChannelId=1, SpiChannelType=EB, SpiDataWidth=8, SpiEbMaxLength=27, SpiIbNBuffers=1, SpiTransferStart=MSB, SpiTransferWidth=1
      SpiExternalDevice_CLESS_SWIT (SpiExternalDevice):
        SpiBaudrate = 1000000
        SpiBaudrateAlternate = 100000
        SpiByteSwap = FALSE
        SpiCsContinous = TRUE
        SpiCsIdentifier = PCS0
        SpiCsPolarity = LOW
        SpiCsSelection = CS_VIA_PERIPHERAL_ENGINE
        SpiDataShiftEdge = LEADING
        SpiEnableCs = true
        SpiHwUnit = CSIB0
        SpiShiftClockIdleLevel = HIGH
        SpiSlaveMode = false
        SpiTimeClk2Cs = 0.000001
        SpiTimeCs2Clk = 0.000001
        SpiTimeCs2Cs = 0.000003
      SpiExternalDevice_RF (SpiExternalDevice):
        SpiBaudrate = 1250000
        SpiBaudrateAlternate = 100000
        SpiByteSwap = FALSE
        SpiCsContinous = TRUE
        SpiCsIdentifier = PCS0
        SpiCsPolarity = LOW
        SpiCsSelection = CS_VIA_PERIPHERAL_ENGINE
        SpiDataShiftEdge = LEADING
        SpiEnableCs = true
        SpiHwUnit = CSIB1
        SpiShiftClockIdleLevel = HIGH
        SpiSlaveMode = false
        SpiTimeClk2Cs = 0.000001
        SpiTimeCs2Clk = 0.000001
        SpiTimeCs2Cs = 0.000002
      SpiJob_CLESS_SWIT (SpiJob): SpiHwUnitSynchronous=SYNCHRONOUS, SpiJobId=0, SpiJobPriority=0, SpiJobStartNotification=NULL_PTR, SpiDeviceAssignment=SpiExternalDevice_CLESS_SWIT
        SpiChannelList_0 (SpiChannelList): SpiChannelIndex=0, SpiChannelAssignment=SpiChannel_CLESS_SWIT
      SpiJob_RF (SpiJob): SpiHwUnitSynchronous=SYNCHRONOUS, SpiJobId=1, SpiJobPriority=0, SpiDeviceAssignment=SpiExternalDevice_RF
        SpiChannelList_RF (SpiChannelList): SpiChannelIndex=0, SpiChannelAssignment=SpiChannel_RF
      SpiSequence_CLESS_SWIT (SpiSequence): SpiInterruptibleSequence=false, SpiSequenceId=0, SpiJobAssignment=SpiJob_CLESS_SWIT
      SpiSequence_RF (SpiSequence): SpiInterruptibleSequence=false, SpiSeqEndNotification=RF_SpiEndNotifyHW, SpiSequenceId=1, SpiJobAssignment=SpiJob_RF
    SpiGeneral:
      SpiCancelApi = true
      SpiChannelBuffersAllowed = 2
      SpiDevErrorDetect = false
      SpiGlobalDmaEnable = false
      SpiHwStatusApi = true
      SpiInterruptibleSeqAllowed = false
      SpiLevelDelivered = 2
      SpiOptimizeOneJobSequences = false
      SpiOptimizedChannelsNumber = 0
      SpiOptimizedSeqNumber = 0
      SpiSupportConcurrentSyncTransmit = false
      SpiTransmitTimeout = 50000
      SpiVersionInfoApi = true
      SpiCPUClockRef = McuClockReferencePoint_RUN_BUS_CLK
      SpiPhyUnit_0 (SpiPhyUnit):
        SpiPhyUnitAsyncMethod = PIO_FIFO
        SpiPhyUnitMapping = LPSPI_0
        SpiPhyUnitMode = SPI_MASTER
        SpiPhyUnitSync = true
        SpiPhyRxDmaChannel = DMAChannel_0
        SpiPhyTxDmaChannel = DMAChannel_0
        SpiPhyUnitClockRef = McuClockReferencePoint_LPSPI_0
      SpiPhyUnit_1 (SpiPhyUnit):
        SpiPhyUnitAsyncMethod = PIO_FIFO
        SpiPhyUnitMapping = LPSPI_1
        SpiPhyUnitMode = SPI_MASTER
        SpiPhyUnitSync = true
        SpiPhyUnitClockRef = McuClockReferencePoint_LPSPI_1
    SpiNonAUTOSAR:
      SpiAllowBigSizeCollections = false
      SpiDisableDemReportErrorStatus = false
      SpiEnableHWUnitAsyncMode = false
      SpiEnableUserModeSupport = false
      SpiJobStartNotificationEnable = false
    SpiPublishedInformation: SpiMaxHwUnit=0
