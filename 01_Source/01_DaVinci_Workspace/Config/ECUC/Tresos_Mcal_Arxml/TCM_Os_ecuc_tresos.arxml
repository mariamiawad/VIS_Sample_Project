AUTOSAR XML (schema 4-2-2)
package /Os
  module config Os: implementation-config-variant=VARIANT-PRE-COMPILE
    SystemTimer (OsCounter): OsCounterMaxAllowedValue=100, OsCounterMinCycle=1, OsCounterTicksPerBase=1, OsCounterType=HARDWARE
