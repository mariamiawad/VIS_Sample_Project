AUTOSAR XML (schema 4-2-2)
package /Adc
  module config Adc: implementation-config-variant=VARIANT-POST-BUILD, module-description=BswImplementation_0
    AdcConfigSet
      AdcHwUnit_0 (AdcHwUnit):
        AdcClockSource = ADC_ALTCLK1
        AdcHwUnitId = ADC0
        AdcLogicalUnitId = 0
        AdcOffsetCorrectionValue = 0
        AdcPrescale = 1
        AdcResolution = BITS_12
        AdcTransferType = ADC_INTERRUPT
        AdcVoltageReferenceSelection = VREFH_VREFL
        AdcAlternateConversionTimings:
          AdcClockDivideSelectAlternate = DIV_NONE
          AdcHardwareAverageEnableAlternate = false
          AdcHardwareAverageSelectAlternate = SAMPLES_4
          AdcSampleTimeDurationAlternate = 2
        AdcChannel_0 (AdcChannel):
          AdcChannelConvTime = 0
          AdcChannelId = AN_12
          AdcChannelRefVoltsrcHigh = UPPER_REF_VOLT_0
          AdcChannelRefVoltsrcLow = LOWER_REF_VOLT_0
          AdcChannelSampTime = 8
          AdcLogicalChannelId = 0
        AdcGroup_0 (AdcGroup):
          AdcDelayNextPdb = 0
          AdcEnableDoubleBuffering = false
          AdcExtraNotification = NULL_PTR
          AdcGroupAccessMode = ADC_ACCESS_MODE_SINGLE
          AdcGroupConversionMode = ADC_CONV_MODE_ONESHOT
          AdcGroupConversionType = ADC_CONV_TYPE_NORMAL
          AdcGroupId = 0
          AdcGroupInBacktoBackMode = true
          AdcGroupPriority = 0
          AdcGroupReplacement = ADC_GROUP_REPL_ABORT_RESTART
          AdcGroupTriggSrc = ADC_TRIGG_SRC_SW
          AdcGroupUsesChannelDelays = false
          AdcHwTrigSignal = ADC_HW_TRIG_RISING_EDGE
          AdcHwTrigSrc = PDB
          AdcHwTrigTimer = 50
          AdcNotification = NULL_PTR
          AdcPdbPeriodContinuousMode = 0
          AdcStreamingBufferMode = ADC_STREAM_BUFFER_LINEAR
          AdcStreamingNumSamples = 1
          AdcWithoutInterrupts = false
          AdcGroupDefinition = AdcChannel_0
          AdcGroupAlternateConversionTimings:
            AdcGroupAltClockDivideSelect = DIV_NONE
            AdcGroupAltHardwareAverageEnable = false
            AdcGroupAltHardwareAverageSelect = SAMPLES_4
            AdcGroupAltSampleTimeDuration = 2
          AdcGroupNormalConversionTimings: AdcGroupClockDivideSelect=DIV_2, AdcGroupHardwareAverageEnable=false, AdcGroupHardwareAverageSelect=SAMPLES_4, AdcGroupSampleTimeDuration=2
        AdcNormalConversionTimings: AdcClockDivideSelect=DIV_NONE, AdcHardwareAverageEnable=false, AdcHardwareAverageSelect=SAMPLES_4, AdcSampleTimeDuration=2
        AdcPdbSettings: AdcPdbChannelSequenceErrorEnable=false, AdcPdbErrorNotification=NULL_PTR, AdcPdbMultiplicationFactorSelect=0, AdcPdbPrescalerDividerSelect=0
    AdcDemEventParameterRefs
    AdcGeneral:
      AdcDeInitApi = true
      AdcDevErrorDetect = false
      AdcDmaTimeout = 65535
      AdcEnableLimitCheck = false
      AdcEnableQueuing = true
      AdcEnableStartStopGroupApi = true
      AdcGrpNotifCapability = true
      AdcHwTriggerApi = false
      AdcPriorityImplementation = ADC_PRIORITY_NONE
      AdcPriorityQueueMaxDepth = 1
      AdcReadGroupApi = true
      AdcResultAlignment = ADC_ALIGN_RIGHT
      AdcTimeout = 65535
      AdcVersionInfoApi = true
    AdcInterrupt_0 (AdcInterrupt): AdcInterruptEnable=true, AdcInterruptSource=ADC0_COCO
    AdcInterrupt_1 (AdcInterrupt): AdcInterruptEnable=false, AdcInterruptSource=ADC1_COCO
    AdcPublishedInformation: AdcChannelValueSigned=false, AdcGroupFirstChannelFixed=false, AdcMaxChannelResolution=12
    CommonPublishedInformation:
      ArReleaseMajorVersion = 4
      ArReleaseMinorVersion = 2
      ArReleaseRevisionVersion = 2
      ModuleId = 123
      SwMajorVersion = 1
      SwMinorVersion = 0
      SwPatchVersion = 0
      VendorApiInfix = 
      VendorId = 43
    NonAutosar:
      AdcBypassConsistencyLoop = false
      AdcContinuousWithoutInterrupt = false
      AdcConvTimeOnce = false
      AdcDisableDemReportErrorStatus = false
      AdcEnableCalibration = false
      AdcEnableDmaTrasferMode = false
      AdcEnableDoubleBufferingOptimization = false
      AdcEnableDualClockMode = true
      AdcEnableGroupDependentChannelNames = false
      AdcEnableInitialNotification = false
      AdcEnableSetChannel = false
      AdcEnableUserModeSupport = false
      AdcOptimizeOneShotHwTriggerConversions = false
      AdcUseHardwareNormalGroups = false
