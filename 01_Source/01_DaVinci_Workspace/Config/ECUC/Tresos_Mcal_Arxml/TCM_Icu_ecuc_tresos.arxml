AUTOSAR XML (schema 4-2-2)
package /Icu
  module config Icu: implementation-config-variant=VARIANT-POST-BUILD, module-description=BswImplementation_0
    CommonPublishedInformation:
      ArReleaseMajorVersion = 4
      ArReleaseMinorVersion = 2
      ArReleaseRevisionVersion = 2
      ModuleId = 122
      SwMajorVersion = 1
      SwMinorVersion = 0
      SwPatchVersion = 0
      VendorId = 43
    IcuConfigSet: IcuMaxChannel=3
      3 x IcuChannel, all with IcuDMAChannelEnable=false, IcuDefaultStartEdge=ICU_RISING_EDGE, IcuLockableChannel=false, IcuOverflowNotification=NULL_PTR, IcuWakeupCapability=false:
        IcuChannel_CLESS_SWT: IcuChannelId=2, IcuHwIP=PORT, IcuMeasurementMode=ICU_MODE_SIGNAL_EDGE_DETECT, IcuDMAChannelRef=DMAChannel_0, IcuPortChannelRef=IcuPortChannels_CLESS_SWT
          IcuSignalEdgeDetection: IcuSignalNotification=CLESS_SWT_vidSignalDetection
        IcuChannel_RF: IcuChannelId=1, IcuHwIP=PORT, IcuMeasurementMode=ICU_MODE_SIGNAL_EDGE_DETECT, IcuDMAChannelRef=DMAChannel_1, IcuPortChannelRef=IcuPortChannels_RF
          IcuSignalEdgeDetection: IcuSignalNotification=RF_vidSignalDetection
        IcuChannel_TRSP: IcuChannelId=0, IcuHwIP=FTM, IcuMeasurementMode=ICU_MODE_TIMESTAMP, IcuDMAChannelRef=DMAChannel_2, IcuFtmChannelRef=IcuFtmChannels_0
          IcuTimestampMeasurement: IcuTimestampMeasurementProperty=ICU_CIRCULAR_BUFFER, IcuTimestampNotification=Icu_TimestampNotification_0
      IcuFtm_1 (IcuFtm):
        IcuFtmModule = FTM_3
        Icu_FlexTimer_ClockSource = ICU_FTM_SYSTEM_CLOCK
        Icu_FlexTimer_Prescaler = ICU_FTM_PRESCALER_DIVIDE_4
        Icu_FlexTimer_Prescaler_Alternate = ICU_FTM_PRESCALER_DIVIDE_128
        IcuFtmChannels_0 (IcuFtmChannels): IcuFreezeEnable=true, IcuFtmChannel=CH_2, Icu_FlexTimerFilter=0
        IcuFtmChannels_1 (IcuFtmChannels): IcuFreezeEnable=true, IcuFtmChannel=CH_3, Icu_FlexTimerFilter=0
      126 x IcuHwInterruptConfigList:
        IcuHwInterruptConfigList_0: IcuIsrEnable=false, IcuIsrHwId=FTM_0_CH_0
        IcuHwInterruptConfigList_1: IcuIsrEnable=false, IcuIsrHwId=FTM_0_CH_1
        IcuHwInterruptConfigList_10: IcuIsrEnable=false, IcuIsrHwId=FTM_1_CH_2
        IcuHwInterruptConfigList_100: IcuIsrEnable=false, IcuIsrHwId=PORT_3_CH_14
        IcuHwInterruptConfigList_101: IcuIsrEnable=false, IcuIsrHwId=PORT_3_CH_15
        IcuHwInterruptConfigList_102: IcuIsrEnable=false, IcuIsrHwId=PORT_3_CH_16
        IcuHwInterruptConfigList_103: IcuIsrEnable=false, IcuIsrHwId=PORT_3_CH_17
        IcuHwInterruptConfigList_104: IcuIsrEnable=false, IcuIsrHwId=PORT_4_CH_0
        IcuHwInterruptConfigList_105: IcuIsrEnable=false, IcuIsrHwId=PORT_4_CH_1
        IcuHwInterruptConfigList_106: IcuIsrEnable=false, IcuIsrHwId=PORT_4_CH_2
        IcuHwInterruptConfigList_107: IcuIsrEnable=false, IcuIsrHwId=PORT_4_CH_3
        IcuHwInterruptConfigList_108: IcuIsrEnable=false, IcuIsrHwId=PORT_4_CH_4
        IcuHwInterruptConfigList_109: IcuIsrEnable=false, IcuIsrHwId=PORT_4_CH_5
        IcuHwInterruptConfigList_11: IcuIsrEnable=false, IcuIsrHwId=FTM_1_CH_3
        IcuHwInterruptConfigList_110: IcuIsrEnable=false, IcuIsrHwId=PORT_4_CH_6
        IcuHwInterruptConfigList_111: IcuIsrEnable=false, IcuIsrHwId=PORT_4_CH_7
        IcuHwInterruptConfigList_112: IcuIsrEnable=false, IcuIsrHwId=PORT_4_CH_8
        IcuHwInterruptConfigList_113: IcuIsrEnable=false, IcuIsrHwId=PORT_4_CH_9
        IcuHwInterruptConfigList_114: IcuIsrEnable=false, IcuIsrHwId=PORT_4_CH_10
        IcuHwInterruptConfigList_115: IcuIsrEnable=false, IcuIsrHwId=PORT_4_CH_11
        IcuHwInterruptConfigList_116: IcuIsrEnable=false, IcuIsrHwId=PORT_4_CH_12
        IcuHwInterruptConfigList_117: IcuIsrEnable=false, IcuIsrHwId=PORT_4_CH_13
        IcuHwInterruptConfigList_118: IcuIsrEnable=false, IcuIsrHwId=PORT_4_CH_14
        IcuHwInterruptConfigList_119: IcuIsrEnable=false, IcuIsrHwId=PORT_4_CH_15
        IcuHwInterruptConfigList_12: IcuIsrEnable=false, IcuIsrHwId=FTM_1_CH_4
        IcuHwInterruptConfigList_120: IcuIsrEnable=false, IcuIsrHwId=PORT_4_CH_16
        IcuHwInterruptConfigList_121: IcuIsrEnable=false, IcuIsrHwId=LPIT_0_CH_0
        IcuHwInterruptConfigList_122: IcuIsrEnable=false, IcuIsrHwId=LPIT_0_CH_1
        IcuHwInterruptConfigList_123: IcuIsrEnable=false, IcuIsrHwId=LPIT_0_CH_2
        IcuHwInterruptConfigList_124: IcuIsrEnable=false, IcuIsrHwId=LPIT_0_CH_3
        IcuHwInterruptConfigList_125: IcuIsrEnable=false, IcuIsrHwId=LPTMR_0_CH_0
        IcuHwInterruptConfigList_13: IcuIsrEnable=false, IcuIsrHwId=FTM_1_CH_5
        IcuHwInterruptConfigList_14: IcuIsrEnable=false, IcuIsrHwId=FTM_1_CH_6
        IcuHwInterruptConfigList_15: IcuIsrEnable=false, IcuIsrHwId=FTM_1_CH_7
        IcuHwInterruptConfigList_16: IcuIsrEnable=false, IcuIsrHwId=FTM_2_CH_0
        IcuHwInterruptConfigList_17: IcuIsrEnable=false, IcuIsrHwId=FTM_2_CH_1
        IcuHwInterruptConfigList_18: IcuIsrEnable=false, IcuIsrHwId=FTM_2_CH_2
        IcuHwInterruptConfigList_19: IcuIsrEnable=false, IcuIsrHwId=FTM_2_CH_3
        IcuHwInterruptConfigList_2: IcuIsrEnable=false, IcuIsrHwId=FTM_0_CH_2
        IcuHwInterruptConfigList_20: IcuIsrEnable=false, IcuIsrHwId=FTM_2_CH_4
        IcuHwInterruptConfigList_21: IcuIsrEnable=false, IcuIsrHwId=FTM_2_CH_5
        IcuHwInterruptConfigList_22: IcuIsrEnable=false, IcuIsrHwId=FTM_2_CH_6
        IcuHwInterruptConfigList_23: IcuIsrEnable=false, IcuIsrHwId=FTM_2_CH_7
        IcuHwInterruptConfigList_24: IcuIsrEnable=false, IcuIsrHwId=FTM_3_CH_0
        IcuHwInterruptConfigList_25: IcuIsrEnable=false, IcuIsrHwId=FTM_3_CH_1
        IcuHwInterruptConfigList_26: IcuIsrEnable=true, IcuIsrHwId=FTM_3_CH_2
        IcuHwInterruptConfigList_27: IcuIsrEnable=false, IcuIsrHwId=FTM_3_CH_3
        IcuHwInterruptConfigList_28: IcuIsrEnable=false, IcuIsrHwId=FTM_3_CH_4
        IcuHwInterruptConfigList_29: IcuIsrEnable=false, IcuIsrHwId=FTM_3_CH_5
        IcuHwInterruptConfigList_3: IcuIsrEnable=false, IcuIsrHwId=FTM_0_CH_3
        IcuHwInterruptConfigList_30: IcuIsrEnable=false, IcuIsrHwId=FTM_3_CH_6
        IcuHwInterruptConfigList_31: IcuIsrEnable=false, IcuIsrHwId=FTM_3_CH_7
        IcuHwInterruptConfigList_32: IcuIsrEnable=false, IcuIsrHwId=PORT_0_CH_0
        IcuHwInterruptConfigList_33: IcuIsrEnable=false, IcuIsrHwId=PORT_0_CH_1
        IcuHwInterruptConfigList_34: IcuIsrEnable=false, IcuIsrHwId=PORT_0_CH_2
        IcuHwInterruptConfigList_35: IcuIsrEnable=false, IcuIsrHwId=PORT_0_CH_3
        IcuHwInterruptConfigList_36: IcuIsrEnable=false, IcuIsrHwId=PORT_0_CH_4
        IcuHwInterruptConfigList_37: IcuIsrEnable=false, IcuIsrHwId=PORT_0_CH_5
        IcuHwInterruptConfigList_38: IcuIsrEnable=false, IcuIsrHwId=PORT_0_CH_6
        IcuHwInterruptConfigList_39: IcuIsrEnable=false, IcuIsrHwId=PORT_0_CH_7
        IcuHwInterruptConfigList_4: IcuIsrEnable=false, IcuIsrHwId=FTM_0_CH_4
        IcuHwInterruptConfigList_40: IcuIsrEnable=false, IcuIsrHwId=PORT_0_CH_8
        IcuHwInterruptConfigList_41: IcuIsrEnable=false, IcuIsrHwId=PORT_0_CH_9
        IcuHwInterruptConfigList_42: IcuIsrEnable=false, IcuIsrHwId=PORT_0_CH_10
        IcuHwInterruptConfigList_43: IcuIsrEnable=false, IcuIsrHwId=PORT_0_CH_11
        IcuHwInterruptConfigList_44: IcuIsrEnable=false, IcuIsrHwId=PORT_0_CH_12
        IcuHwInterruptConfigList_45: IcuIsrEnable=false, IcuIsrHwId=PORT_0_CH_13
        IcuHwInterruptConfigList_46: IcuIsrEnable=false, IcuIsrHwId=PORT_0_CH_14
        IcuHwInterruptConfigList_47: IcuIsrEnable=false, IcuIsrHwId=PORT_0_CH_15
        IcuHwInterruptConfigList_48: IcuIsrEnable=false, IcuIsrHwId=PORT_0_CH_16
        IcuHwInterruptConfigList_49: IcuIsrEnable=false, IcuIsrHwId=PORT_0_CH_17
        IcuHwInterruptConfigList_5: IcuIsrEnable=false, IcuIsrHwId=FTM_0_CH_5
        IcuHwInterruptConfigList_50: IcuIsrEnable=false, IcuIsrHwId=PORT_1_CH_0
        IcuHwInterruptConfigList_51: IcuIsrEnable=false, IcuIsrHwId=PORT_1_CH_1
        IcuHwInterruptConfigList_52: IcuIsrEnable=false, IcuIsrHwId=PORT_1_CH_2
        IcuHwInterruptConfigList_53: IcuIsrEnable=false, IcuIsrHwId=PORT_1_CH_3
        IcuHwInterruptConfigList_54: IcuIsrEnable=false, IcuIsrHwId=PORT_1_CH_4
        IcuHwInterruptConfigList_55: IcuIsrEnable=false, IcuIsrHwId=PORT_1_CH_5
        IcuHwInterruptConfigList_56: IcuIsrEnable=false, IcuIsrHwId=PORT_1_CH_6
        IcuHwInterruptConfigList_57: IcuIsrEnable=false, IcuIsrHwId=PORT_1_CH_7
        IcuHwInterruptConfigList_58: IcuIsrEnable=false, IcuIsrHwId=PORT_1_CH_8
        IcuHwInterruptConfigList_59: IcuIsrEnable=false, IcuIsrHwId=PORT_1_CH_9
        IcuHwInterruptConfigList_6: IcuIsrEnable=false, IcuIsrHwId=FTM_0_CH_6
        IcuHwInterruptConfigList_60: IcuIsrEnable=false, IcuIsrHwId=PORT_1_CH_10
        IcuHwInterruptConfigList_61: IcuIsrEnable=false, IcuIsrHwId=PORT_1_CH_11
        IcuHwInterruptConfigList_62: IcuIsrEnable=false, IcuIsrHwId=PORT_1_CH_12
        IcuHwInterruptConfigList_63: IcuIsrEnable=false, IcuIsrHwId=PORT_1_CH_13
        IcuHwInterruptConfigList_64: IcuIsrEnable=false, IcuIsrHwId=PORT_1_CH_14
        IcuHwInterruptConfigList_65: IcuIsrEnable=false, IcuIsrHwId=PORT_1_CH_15
        IcuHwInterruptConfigList_66: IcuIsrEnable=false, IcuIsrHwId=PORT_1_CH_16
        IcuHwInterruptConfigList_67: IcuIsrEnable=false, IcuIsrHwId=PORT_1_CH_17
        IcuHwInterruptConfigList_68: IcuIsrEnable=false, IcuIsrHwId=PORT_2_CH_0
        IcuHwInterruptConfigList_69: IcuIsrEnable=true, IcuIsrHwId=PORT_2_CH_1
        IcuHwInterruptConfigList_7: IcuIsrEnable=false, IcuIsrHwId=FTM_0_CH_7
        IcuHwInterruptConfigList_70: IcuIsrEnable=false, IcuIsrHwId=PORT_2_CH_2
        IcuHwInterruptConfigList_71: IcuIsrEnable=false, IcuIsrHwId=PORT_2_CH_3
        IcuHwInterruptConfigList_72: IcuIsrEnable=false, IcuIsrHwId=PORT_2_CH_4
        IcuHwInterruptConfigList_73: IcuIsrEnable=false, IcuIsrHwId=PORT_2_CH_5
        IcuHwInterruptConfigList_74: IcuIsrEnable=false, IcuIsrHwId=PORT_2_CH_6
        IcuHwInterruptConfigList_75: IcuIsrEnable=false, IcuIsrHwId=PORT_2_CH_7
        IcuHwInterruptConfigList_76: IcuIsrEnable=false, IcuIsrHwId=PORT_2_CH_8
        IcuHwInterruptConfigList_77: IcuIsrEnable=false, IcuIsrHwId=PORT_2_CH_9
        IcuHwInterruptConfigList_78: IcuIsrEnable=false, IcuIsrHwId=PORT_2_CH_10
        IcuHwInterruptConfigList_79: IcuIsrEnable=false, IcuIsrHwId=PORT_2_CH_11
        IcuHwInterruptConfigList_8: IcuIsrEnable=false, IcuIsrHwId=FTM_1_CH_0
        IcuHwInterruptConfigList_80: IcuIsrEnable=false, IcuIsrHwId=PORT_2_CH_12
        IcuHwInterruptConfigList_81: IcuIsrEnable=false, IcuIsrHwId=PORT_2_CH_13
        IcuHwInterruptConfigList_82: IcuIsrEnable=false, IcuIsrHwId=PORT_2_CH_14
        IcuHwInterruptConfigList_83: IcuIsrEnable=false, IcuIsrHwId=PORT_2_CH_15
        IcuHwInterruptConfigList_84: IcuIsrEnable=false, IcuIsrHwId=PORT_2_CH_16
        IcuHwInterruptConfigList_85: IcuIsrEnable=false, IcuIsrHwId=PORT_2_CH_17
        IcuHwInterruptConfigList_86: IcuIsrEnable=false, IcuIsrHwId=PORT_3_CH_0
        IcuHwInterruptConfigList_87: IcuIsrEnable=false, IcuIsrHwId=PORT_3_CH_1
        IcuHwInterruptConfigList_88: IcuIsrEnable=false, IcuIsrHwId=PORT_3_CH_2
        IcuHwInterruptConfigList_89: IcuIsrEnable=false, IcuIsrHwId=PORT_3_CH_3
        IcuHwInterruptConfigList_9: IcuIsrEnable=false, IcuIsrHwId=FTM_1_CH_1
        IcuHwInterruptConfigList_90: IcuIsrEnable=false, IcuIsrHwId=PORT_3_CH_4
        IcuHwInterruptConfigList_91: IcuIsrEnable=false, IcuIsrHwId=PORT_3_CH_5
        IcuHwInterruptConfigList_92: IcuIsrEnable=false, IcuIsrHwId=PORT_3_CH_6
        IcuHwInterruptConfigList_93: IcuIsrEnable=false, IcuIsrHwId=PORT_3_CH_7
        IcuHwInterruptConfigList_94: IcuIsrEnable=false, IcuIsrHwId=PORT_3_CH_8
        IcuHwInterruptConfigList_95: IcuIsrEnable=false, IcuIsrHwId=PORT_3_CH_9
        IcuHwInterruptConfigList_96: IcuIsrEnable=false, IcuIsrHwId=PORT_3_CH_10
        IcuHwInterruptConfigList_97: IcuIsrEnable=false, IcuIsrHwId=PORT_3_CH_11
        IcuHwInterruptConfigList_98: IcuIsrEnable=false, IcuIsrHwId=PORT_3_CH_12
        IcuHwInterruptConfigList_99: IcuIsrEnable=false, IcuIsrHwId=PORT_3_CH_13
      IcuPort_C (IcuPort): IcuPortModule=PORT_2
        IcuPortChannels_CLESS_SWT (IcuPortChannels): IcuPortChannel=CH_2
        IcuPortChannels_RF (IcuPortChannels): IcuPortChannel=CH_1
    IcuGeneral: IcuDevErrorDetect=false, IcuEnableUserModeSupport=false, IcuIndex=0, IcuReportWakeupSource=true
    IcuNonAUTOSAR:
      IcuEnableDualClockMode = false
      IcuGetCaptureRegisterValueApi = false
      IcuGetInputLevelApi = false
      IcuOverflowNotificationApi = true
      IcuRegisterLockingMode = NO_REGISTER_LOCKING
    IcuOptionalApis:
      IcuDeInitApi = true
      IcuDisableWakeupApi = true
      IcuEdgeCountApi = true
      IcuEdgeDetectApi = true
      IcuEnableWakeupApi = true
      IcuGetDutyCycleValuesApi = true
      IcuGetInputStateApi = true
      IcuGetTimeElapsedApi = true
      IcuGetVersionInfoApi = true
      IcuSetModeApi = true
      IcuSignalMeasurementApi = true
      IcuTimestampApi = true
      IcuWakeupFunctionalityApi = true
