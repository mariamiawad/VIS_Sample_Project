AUTOSAR XML (schema 4-2-2)
package /Lin
  module config Lin: implementation-config-variant=VARIANT-POST-BUILD
    CommonPublishedInformation:
      ArReleaseMajorVersion = 4
      ArReleaseMinorVersion = 2
      ArReleaseRevisionVersion = 2
      ModuleId = 82
      SwMajorVersion = 1
      SwMinorVersion = 0
      SwPatchVersion = 0
      VendorId = 43
    LinGeneral: LinDevErrorDetect=true, LinIndex=0, LinTimeoutDuration=65535, LinVersionInfoApi=true
    LinGlobalConfig
      LinChannel_0 (LinChannel):
        BreakLength = BL_13
        LinChannelBaudRate = 9600
        LinChannelId = 0
        LinChannelWakeupSupport = true
        LinHwChannel = LPUART_0
        LinChannelEcuMWakeupSource = EcuMWakeupSource_0
        LinClockRef = McuClockReferencePoint_LPUART0_CLK
        LinClockRef_Alternate = McuClockReferencePoint_RUN_BUS_CLK
    NonAutosar: LinDisableDemReportErrorStatus=false, LinDisableFrameTimeout=false, LinEnableUserModeSupport=false
