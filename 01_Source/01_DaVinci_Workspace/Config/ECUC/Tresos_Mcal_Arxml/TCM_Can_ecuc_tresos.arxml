AUTOSAR XML (schema 4-2-1)
package /Can
  module config Can: implementation-config-variant=VARIANT-PRE-COMPILE
    CanConfigSet
      CanController:
        CanHwChannel = FlexCAN_A
        CanControllerActivation = true
        CanControllerBaseAddress = 0
        CanControllerIcomSupported = false
        CanControllerId = 1
        CanRxProcessing = POLLING
        CanTxProcessing = POLLING
        CanBusoffProcessing = POLLING
        CanWakeupFunctionalityAPI = false
        CanWakeupProcessing = POLLING
        CanBccSupport = false
        CanWakeupSupport = false
        CanListenOnlyMode = false
        CanLoopBackMode = false
        CanSoftwareBusOffRecovery = false
        CanAutoBusOffRecovery = false
        CanTrippleSamplingEnable = false
        CanWakeUpSourceFilter = false
        CanLowestBuffTransmitFirst = true
        CanLocalPriorityEn = false
        CanClockFromBus = true
        CanControllerRxFifoEnable = false
        CanRxFifoWarningNotification = NULL_PTR
        CanRxFifoOverflowNotification = NULL_PTR
        CanErrorControllerNotifEn = true
        CanErrorControllerNotification = NULL_PTR
        CanControllerDefaultBaudrate = CanControllerBaudrateConfig
        CanCpuClockRef = McuClockReferencePoint_FTM0
        CanControllerBaudrateConfig:
          CanControllerCheckCanStandard = true
          CanAdvancedSetting = false
          CanBusLength = 40
          CanPropDelayTranceiver = 150
          CanTxArbitrationStartDelay = 12
          CanControllerPrescaller = 100
          CanControllerBaudRateConfigID = 0
          CanControllerPrescaller_Alt = 100
          CanControllerBaudRate = 20
          CanControllerSyncSeg = 1
          CanControllerPropSeg = 5
          CanControllerSeg1 = 5
          CanControllerSeg2 = 6
          CanControllerSyncJumpWidth = 1
          CanControllerCBT:
            CanControllerCbtEnable = false
            CanControllerCbtPrescaller = 100
            CanControllerCbtBaudRate = 0
            CanControllerCbtSyncSeg = 1
            CanControllerCbtPropSeg = 1
            CanControllerCbtSeg1 = 1
            CanControllerCbtSeg2 = 1
            CanControllerSyncJumpWidthCbt = 1
        CanRxFifo: CanControllerIDAcceptanceMode=A, CanRxFifoFiltersNumber=FILTERS_NUMBER_8, CanRxFifoGlobalMaskValue=2047
      CanHardwareObject: CanHandleType=BASIC, CanIdType=STANDARD, CanMBPrio=0, CanObjectId=0, CanObjectType=RECEIVE, CanHwObjectCount=1, CanControllerRef=CanController
      CanHardwareObject_001 (CanHardwareObject): CanHandleType=BASIC, CanIdType=STANDARD, CanMBPrio=0, CanObjectId=0, CanObjectType=TRANSMIT, CanHwObjectCount=1, CanControllerRef=CanController
    CanGeneral:
      CanChangeBaudrateApi = true
      CanDevErrorDetection = true
      CanEnableUserModeSupport = false
      CanVersionInfoApi = true
      CanIndex = 0
      CanMainFunctionModePeriod = 0.001
      CanMultiplexedTransmission = true
      CanMaxMessageBuffers = 32
      CanTimeoutDuration = 0.1
      CanAllowLoopAsCycle = false
      CanNumberOfTimeOutLoop = 1
      CanCodeSizeOptimization = false
      CanExtendedIDSupport = true
      CanMBCountExtensionSupport = true
      CanApiEnableMbAbort = false
      CanAbortOnlyOneMB = true
      CanEnableDualClockMode = false
      CanSpecifiedRAMBlockSize = false
      MBDSR = CAN_8_BYTES_PAYLOAD
      CanPublicIcomSupport = false
      CanSupportTTCANRef = CanIfPrivateCfg
    CommonPublishedInformation:
      ArReleaseMajorVersion = 4
      ArReleaseMinorVersion = 2
      ArReleaseRevisionVersion = 2
      ModuleId = 80
      SwMajorVersion = 1
      SwMinorVersion = 0
      SwPatchVersion = 0
      VendorApiInfix = 
      VendorId = 43
