AUTOSAR XML (schema 4-2-2)
package /EcuM
  module config EcuM: implementation-config-variant=VARIANT-POST-BUILD
    CommonPublishedInformation:
      ArReleaseMajorVersion = 4
      ArReleaseMinorVersion = 2
      ArReleaseRevisionVersion = 2
      ModuleId = 10
      SwMajorVersion = 1
      SwMinorVersion = 0
      SwPatchVersion = 0
      VendorId = 43
    EcuMConfiguration
      EcuMCommonConfiguration: EcuMConfigConsistencyHash=1024, EcuMDefaultAppMode=(unset), EcuMOSResource=(unset)
        EcuMDefaultShutdownTarget: EcuMDefaultState=EcuMStateOff
        EcuMSleepMode_0 (EcuMSleepMode): EcuMSleepModeId=11, EcuMSleepModeSuspend=true, EcuMSleepModeMcuModeRef=McuModeSettingConf, EcuMWakeupSourceMask=EcuMWakeupSource_0
        EcuMWakeupSource_0 (EcuMWakeupSource): EcuMWakeupSourceId=11, EcuMWakeupSourcePolling=true
    EcuMGeneral: EcuMDevErrorDetect=true, EcuMIncludeDet=true, EcuMMainFunctionPeriod=100, EcuMVersionInfoApi=true
