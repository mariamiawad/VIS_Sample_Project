AUTOSAR XML (schema 4-2-2)
package /Dem
  module config Dem: implementation-config-variant=VARIANT-PRE-COMPILE, module-description=Dem_Impl
    DemGeneral:
      DemAgingCycleCounterProcessing = DEM_PROCESS_AGINGCTR_INTERN
      DemGeneralInterfaceSupport = false
      DemDataElementDefaultEndianness = LITTLE_ENDIAN
      DemAgingRequieresTestedCycle = false
      DemMaxNumberEventEntryMirror = 0
      DemPTOSupport = false
      DemTriggerMonitorInitBeforeClearOk = true
      DemExtendedDataCapture = DEM_TRIGGER_EVENT_MEMORY_STORAGE
      DemFreezeFrameCapture = DEM_TRIGGER_EVENT_MEMORY_STORAGE
      DemOperationCycleProcessing = DEM_PROCESS_OPCYC_STATE
      DemMaxNumberTimeSeriesSnapshots = 0
      DemAvailabilitySupport = DEM_NO_AVAILABILITY
      DemAvailabilityStorage = false
      DemBswErrorBufferSize = 0
      DemClearDTCBehavior = DEM_CLRRESP_VOLATILE
      DemClearDTCLimitation = DEM_ALL_SUPPORTED_DTCS
      DemDebounceCounterBasedSupport = true
      DemDebounceTimeBasedSupport = true
      DemDevErrorDetect = false
      DemDtcStatusAvailabilityMask = 255
      DemEnableConditionSupport = false
      DemEventCombinationSupport = DEM_EVCOMB_DISABLED
      DemEventDisplacementStrategy = DEM_DISPLACEMENT_LEGACY_403
      DemEventMemoryEntryStorageTrigger = DEM_STORAGE_ON_TEST_FAILED
      DemMaxNumberEventEntryOBDFreezeFrame = 0
      DemMaxNumberEventEntryPermanent = 0
      DemMaxNumberEventEntryPrimary = 1
      DemMaxNumberEventEntrySecondary = 0
      DemMaxNumberPrestoredFF = 0
      DemOBDSupport = DEM_OBD_NO_OBD_SUPPORT
      DemOccurrenceCounterProcessing = DEM_PROCESS_OCCCTR_TF
      DemOperationCycleStatusStorage = false
      DemResetConfirmedBitOnOverflow = true
      DemStatusBitHandlingTestFailedSinceLastClear = DEM_STATUS_BIT_NORMAL
      DemStatusBitStorageTestFailed = true
      DemStorageConditionSupport = false
      DemSuppressionSupport = DEM_NO_SUPPRESSION
      DemTaskTime = 0.005
      DemTriggerDcmReports = false
      DemTriggerDltReports = false
      DemTriggerFiMReports = false
      DemTriggerMonitorInitForEnableConditions = false
      DemTypeOfDTCSupported = DEM_DTC_TRANSLATION_ISO14229_1
      DemTypeOfFreezeFrameRecordNumeration = DEM_FF_RECNUM_CALCULATED
      DemVersionInfoApi = false
      DemBswApiVersion = DEM_BSW_API_4_XX_XX
      DemBswApiVersionNvM = DEM_BSW_API_4_XX_XX
      DemBswApiVersionFiM = DEM_BSW_API_4_XX_XX
      DemAgingAfterHealing = DEM_AGING_WHILE_HEALING
      DemAgingBehavior = DEM_AGING_TYPE_1
      DemAgingCounterBehavior = DEM_AGING_COUNT_ALWAYS
      DemAgingCounterReporting = DEM_AGING_NORMAL_REPORTING
      DemAgingRetainEnvironmentalData = false
      DemCompiledPostbuildCrc = 2024452440
      DemCompiledPostbuildCrcMode = DEM_POSTBUILD_CRC_AUTOMATIC
      DemEventDisplacementFallbackStrategy = DEM_FALLBACK_DISCARD_NEW_EVENT
      DemGeneralDiagnosticInfoSupport = true
      DemJ1939Support = false
      DemNvSynchronizeSupport = false
      DemPendingDtcProcessing = DEM_PROCESS_PDTC_STOREDONLY
      DemResetDebounceBehavior = DEM_RESET_DEBOUNCE_ON_DISABLE_ENABLE_CONDITIONS
      DemResetTestFailedOnOperationCycleStart = false
      DemRetryStorageSupport = false
      DemSafeBswChecks = false
      DemUseMemcopyMacros = false
      DemUseRte = true
      DemUserControlledWirBehavior = DEM_DISABLED_DURING_CONTROLDTCSETTING
      DemUserDefinedCompareAndSwap = false
      DemWarningIndicatorRequestedProcessing = DEM_PROCESS_WIR_STOREDONLY
      DemDcmSupport = true
      DemUseNvm = true
      DemEventMemorySet
      DemOperationCycle: DemOperationCycleAutomaticEnd=false, DemOperationCycleAutostart=false, DemOperationCycleType=DEM_OPCYC_OTHER
      DemPostbuild: DemEventAvailableDefaultSupport=true, DemMaxSizeFreezeFrame=0, DemMaxNumberDtr=0
      3 x DemNvRamBlockId:
        DemNvRamBlockI_Admin: DemNvRamBlockIdType=DEM_NVBLOCK_ADMIN, DemNvRamBlockIdRef=NvMDem_block_Admin
        DemNvRamBlockId_Status: DemNvRamBlockIdType=DEM_NVBLOCK_STATUS, DemNvRamBlockIdRef=NvMDem_block_Status
        DemNvRamBlockId_Primary: DemNvRamBlockIdType=DEM_NVBLOCK_PRIMARY, DemNvRamBlockIdIndex=0, DemNvRamBlockIdRef=NvMDem_block_primary
      DemClient: DemClientId=0
      DemDataClass_ABSOLUTE_TIME (DemDataClass): DemDataElementDataSize=4, DemDataElementStoreNonVolatile=true, DemDataElementUsePort=USE_DATA_CLIENT_SERVER_PORT
      DemDidClass_ABSOLUTE_TIME (DemDidClass): DemDidIdentifier=5889, DemDidDataClassRef=DemDataClass_ABSOLUTE_TIME
      DemDataClass_KILOMETER (DemDataClass): DemDataElementDataSize=3, DemDataElementStoreNonVolatile=true, DemDataElementUsePort=USE_DATA_CLIENT_SERVER_PORT
      DemDidClass_KILOMETER (DemDidClass): DemDidIdentifier=5888, DemDidDataClassRef=DemDataClass_KILOMETER
      DemDataClass_OVERFLOW_BYTE (DemDataClass): DemDataElementDataSize=1, DemDataElementStoreNonVolatile=true, DemDataElementUsePort=USE_DATA_CLIENT_SERVER_PORT
      DemDidClass_OVERFLOW_BYTE (DemDidClass): DemDidIdentifier=1, DemDidDataClassRef=DemDataClass_OVERFLOW_BYTE
      DemDataClass_OCCURRENCE_COUNTER (DemDataClass): DemDataElementDataSize=1, DemDataElementStoreNonVolatile=true, DemDataElementUsePort=USE_DATA_CLIENT_SERVER_PORT
      DemDidClass_OCCURRENCE_COUNTER (DemDidClass): DemDidIdentifier=2, DemDidDataClassRef=DemDataClass_OCCURRENCE_COUNTER
      DemDataClass_AGING_COUNTER (DemDataClass): DemDataElementDataSize=1, DemDataElementStoreNonVolatile=true, DemDataElementUsePort=USE_DATA_CLIENT_SERVER_PORT
      DemDidClass_AGING_COUNTER (DemDidClass): DemDidIdentifier=3, DemDidDataClassRef=DemDataClass_AGING_COUNTER
      DemFreezeFrameClass: DemDidClassRef=DemDidClass_ABSOLUTE_TIME, DemDidClassRef=DemDidClass_KILOMETER
      DemExtendedDataClass: DemExtendedDataRecordClassRef=DemExtendedDataRecordClass
      DemExtendedDataRecordClass:
        DemExtendedDataRecordNumber = 1
        DemExtendedDataRecordUpdate = DEM_UPDATE_RECORD_YES
        DemDataClassRef = DemDataClass_AGING_COUNTER
        DemDataClassRef = DemDataClass_OCCURRENCE_COUNTER
        DemDataClassRef = DemDataClass_OVERFLOW_BYTE
    DemConfigSet
      DemEventParameter:
        DemEventTimeSeries = DEM_TIMESERIES_SNAPSHOT_NONE
        DemEventAvailable = true
        DemEventId = 1
        DemEventKind = DEM_EVENT_KIND_SWC
        DemEventAvailableInVariant = true
        DemEventLatchTestFailed = false
        DemEventClass:
          DemAgingAllowed = false
          DemConsiderPtoStatus = false
          DemEventDestination = DEM_DTC_ORIGIN_PRIMARY_MEMORY
          DemEventPriority = 2
          DemFFPrestorageSupported = false
          DemOperationCycleRef = DemOperationCycle
          DemDebounceAlgorithmClass
            DemDebounceCounterBased:
              DemDebounceBehavior = DEM_DEBOUNCE_FREEZE
              DemDebounceCounterDecrementStepSize = 1
              DemDebounceCounterFailedThreshold = 127
              DemDebounceCounterIncrementStepSize = 1
              DemDebounceCounterJumpDown = true
              DemDebounceCounterJumpDownValue = 0
              DemDebounceCounterJumpUp = true
              DemDebounceCounterJumpUpValue = 0
              DemDebounceCounterPassedThreshold = -128
              DemDebounceCounterStorage = false
              DemDebounceContinuous = false
      DemEventParameter_MCAL (DemEventParameter):
        DemEventTimeSeries = DEM_TIMESERIES_SNAPSHOT_NONE
        DemEventAvailable = true
        DemEventId = 2
        DemEventKind = DEM_EVENT_KIND_SWC
        DemEventAvailableInVariant = true
        DemEventLatchTestFailed = false
        DemEventClass:
          DemAgingAllowed = false
          DemConsiderPtoStatus = false
          DemEventDestination = DEM_DTC_ORIGIN_PRIMARY_MEMORY
          DemEventPriority = 2
          DemFFPrestorageSupported = false
          DemOperationCycleRef = DemOperationCycle
          DemDebounceAlgorithmClass
            DemDebounceCounterBased:
              DemDebounceBehavior = DEM_DEBOUNCE_FREEZE
              DemDebounceCounterDecrementStepSize = 1
              DemDebounceCounterFailedThreshold = 127
              DemDebounceCounterIncrementStepSize = 1
              DemDebounceCounterJumpDown = true
              DemDebounceCounterJumpDownValue = 0
              DemDebounceCounterJumpUp = true
              DemDebounceCounterJumpUpValue = 0
              DemDebounceCounterPassedThreshold = -128
              DemDebounceCounterStorage = false
              DemDebounceContinuous = false
      NVM_E_WRITE_FAILED (DemDTCClass): DemImmediateNvStorage=false, DemUdsDTC=491525
      NVM_E_READ_FAILED (DemDTCClass): DemImmediateNvStorage=false, DemUdsDTC=491527
      DemEventParameter_NVM_E_WRITE_FAILED (DemEventParameter):
        DemEventTimeSeries = DEM_TIMESERIES_SNAPSHOT_NONE
        DemEventAvailable = true
        DemEventId = 3
        DemEventKind = DEM_EVENT_KIND_BSW
        DemEventAvailableInVariant = true
        DemEventLatchTestFailed = false
        DemDTCClassRef = NVM_E_WRITE_FAILED
        DemEventClass:
          DemAgingAllowed = false
          DemConsiderPtoStatus = false
          DemEventDestination = DEM_DTC_ORIGIN_PRIMARY_MEMORY
          DemEventPriority = 2
          DemFFPrestorageSupported = false
          DemOperationCycleRef = DemOperationCycle
          DemAgingCycleRef = DemOperationCycle
          DemDebounceAlgorithmClass
            DemDebounceTimeBase: DemDebounceBehavior=DEM_DEBOUNCE_FREEZE, DemDebounceTimeFailedThreshold=0.005, DemDebounceTimePassedThreshold=0.01, DemDebounceContinuous=false
