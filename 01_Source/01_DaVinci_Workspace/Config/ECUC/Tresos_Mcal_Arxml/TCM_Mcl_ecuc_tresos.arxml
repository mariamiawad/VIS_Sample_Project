AUTOSAR XML (schema 4-2-2)
package /Mcl
  module config Mcl: implementation-config-variant=VARIANT-POST-BUILD, module-description=BswImplementation_0
    CommonPublishedInformation:
      ArReleaseMajorVersion = 4
      ArReleaseMinorVersion = 2
      ArReleaseRevisionVersion = 2
      ModuleId = 255
      SwMajorVersion = 1
      SwMinorVersion = 0
      SwPatchVersion = 0
      VendorId = 43
    MclConfigSet
      DMAChannel_0 (DMAChannel):
        DMAChannelPriority = 0
        DPA = false
        DmaHwChannel = eDMA_0
        DmaSource{0..9} = NOT_USED
        ECP = false
        EMI = false
        MclDMAChannelEnable = false
        MclDMAChannelId = 0
        MclDMAChannelTriggerEnable = false
        MclDmaTransferCompletionNotif = NULL_PTR
      DmaInstance:
        DmaHwInstance = eDMA_Instance0
        MclEDMA_CLM = false
        MclEDMA_CX = false
        MclEDMA_ECX = false
        MclEDMA_EDBG = false
        MclEDMA_ERCA = false
        MclEDMA_HALT = false
        MclEDMA_HOE = false
      TriggerMux:
        TrgMuxAdc0Input{0..3} = INPUT_DISABLED
        TrgMuxAdc0LockEn = false
        TrgMuxAdc1Input{0..3} = INPUT_DISABLED
        TrgMuxAdc1LockEn = false
        TrgMuxCmp0Input0 = INPUT_DISABLED
        TrgMuxCmp0LockEn = false
        TrgMuxDmaMux0Input{0..3} = INPUT_DISABLED
        TrgMuxDmaMux0LockEn = false
        TrgMuxFlexIoInput{0..3} = INPUT_DISABLED
        TrgMuxFlexIoLockEn = false
        TrgMuxFtm0Input{0..3} = INPUT_DISABLED
        TrgMuxFtm0LockEn = false
        TrgMuxFtm1Input{0..3} = INPUT_DISABLED
        TrgMuxFtm1LockEn = false
        TrgMuxFtm2Input{0..3} = INPUT_DISABLED
        TrgMuxFtm2LockEn = false
        TrgMuxFtm3Input{0..3} = INPUT_DISABLED
        TrgMuxFtm3LockEn = false
        TrgMuxFtm4Input0 = INPUT_DISABLED
        TrgMuxFtm4LockEn = false
        TrgMuxFtm5Input0 = INPUT_DISABLED
        TrgMuxFtm5LockEn = false
        TrgMuxFtm6Input0 = INPUT_DISABLED
        TrgMuxFtm6LockEn = false
        TrgMuxFtm7Input0 = INPUT_DISABLED
        TrgMuxFtm7LockEn = false
        TrgMuxLpi2c0Input0 = INPUT_DISABLED
        TrgMuxLpi2c0LockEn = false
        TrgMuxLpi2c1Input0 = INPUT_DISABLED
        TrgMuxLpi2c1LockEn = false
        TrgMuxLpitInput{0..3} = INPUT_DISABLED
        TrgMuxLpitLockEn = false
        TrgMuxLpspi0Input0 = INPUT_DISABLED
        TrgMuxLpspi0LockEn = false
        TrgMuxLpspi1Input0 = INPUT_DISABLED
        TrgMuxLpspi1LockEn = false
        TrgMuxLptmr0Input0 = INPUT_DISABLED
        TrgMuxLptmr0LockEn = false
        TrgMuxLpuart0Input0 = INPUT_DISABLED
        TrgMuxLpuart0LockEn = false
        TrgMuxLpuart1Input0 = INPUT_DISABLED
        TrgMuxLpuart1LockEn = false
        TrgMuxPdb0Input0 = INPUT_DISABLED
        TrgMuxPdb0LockEn = false
        TrgMuxPdb1Input0 = INPUT_DISABLED
        TrgMuxPdb1LockEn = false
        TrgMuxXOut0Input{0..3} = INPUT_DISABLED
        TrgMuxXOut0LockEn = false
        TrgMuxXOut1Input{0..3} = INPUT_DISABLED
        TrgMuxXOut1LockEn = false
      DMAChannel_1 (DMAChannel):
        DMAChannelPriority = 0
        DPA = false
        DmaHwChannel = eDMA_1
        DmaSource{0..9} = NOT_USED
        ECP = false
        EMI = false
        MclDMAChannelEnable = false
        MclDMAChannelId = 1
        MclDMAChannelTriggerEnable = false
        MclDmaTransferCompletionNotif = NULL_PTR
      DMAChannel_2 (DMAChannel):
        DMAChannelPriority = 0
        DPA = false
        DmaHwChannel = eDMA_2
        DmaSource{0..9} = NOT_USED
        ECP = false
        EMI = false
        MclDMAChannelEnable = false
        MclDMAChannelId = 2
        MclDMAChannelTriggerEnable = false
        MclDmaTransferCompletionNotif = NULL_PTR
    MclGeneral:
      EnableDMA = true
      MclDevErrorDetect = false
      MclDisableDemReportErrorStatus = false
      MclDmaNotificationSupported = true
      MclEnableTrgMux = false
      MclEnableUserModeSupport = false
      MclErrorChecking = true
      MclErrorNotificationDma0 = NULL_PTR
      Mcl_DeInitApi = false
      Mcl_DmaGetChannelErrorStatusApi = false
      Mcl_DmaGetGlobalErrorStatusApi = false
      Mcl_VersionInfoApi = true
      16 x MclIsrAvailable, all with MclIsrEnabled=false:
        MclIsrAvailable_0: MclIsrName=eDMA_0
        MclIsrAvailable_1: MclIsrName=eDMA_1
        MclIsrAvailable_{10..15}: MclIsrName=eDMA_{10..15}
        MclIsrAvailable_{2..9}: MclIsrName=eDMA_{2..9}
      MclLmem: MclLmemCacheTimeout=2147483647, MclLmemEnableCacheApi=false, MclLmemEnableWriteBuffer=false, MclSynchronizeCache=false
