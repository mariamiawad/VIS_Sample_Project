AUTOSAR XML (schema 4-2-1)
package /ActiveEcuC
  module config Dio: implementation-config-variant=VARIANT-PRE-COMPILE, module-description=BswImplementation_0
    CommonPublishedInformation:
      ArReleaseMajorVersion = 4
      ArReleaseMinorVersion = 2
      ArReleaseRevisionVersion = 2
      ModuleId = 120
      SwMajorVersion = 1
      SwMinorVersion = 0
      SwPatchVersion = 0
      VendorId = 43
    DioConfig_0 (DioConfig)
      5 x DioPort:
        DioPort_0: DioPortId=2
          3 x DioChannel:
            DioChannel_0: DioChannelId=6
            Dio_DbgLed: DioChannelId=0
            Dio_Key1: DioChannelId=12
          DioChannelGroup_0 (DioChannelGroup): DioChannelGroupIdentification=DioChannelGroup, DioPortBitNumber=1, DioPortMask=1, DioPortOffset=0
        DioPort_1: DioPortId=3
          3 x DioChannel:
            DioChannel_RF_P_ON: DioChannelId=4
            Dio_Led2: DioChannelId=15
            Dio_Led3: DioChannelId=16
        DioPort_A: DioPortId=0
          14 x DioChannel:
            CMD_ALIM_E_TOR_REV_A: DioChannelId=11
            CMD_ALIM_E_TOR_REV_B: DioChannelId=12
            CMD_ALIM_E_TOR_REV_C: DioChannelId=13
            CMD_ALIM_E_TOR_REV_D: DioChannelId=14
            CMD_ALIM_E_TOR_REV_E: DioChannelId=15
            CMD_ALIM_E_TOR_REV_F: DioChannelId=16
            DMX_E1L: DioChannelId=0
            DMX_E1W: DioChannelId=6
            DMX_E2L: DioChannelId=1
            DMX_E2W: DioChannelId=7
            DMX_E3L: DioChannelId=2
            DMX_E3W: DioChannelId=8
            DMX_E4L: DioChannelId=3
            DMX_E4W: DioChannelId=9
        DioPort_B: DioPortId=1
          3 x DioChannel:
            TRSP_CLK: DioChannelId=17
            TRSP_ICUtoDIOin: DioChannelId=10
            TRSP_PWMtoDIOout: DioChannelId=15
        DioPort_E: DioPortId=4
          DioChannel_Trncv (DioChannel): DioChannelId=9
    DioGeneral:
      DioDevErrorDetect = false
      DioEnableUserModeSupport = false
      DioFlipChannelApi = true
      DioMaskedWritePortApi = false
      DioReadZeroForUndefinedPortPins = false
      DioReversePortBits = false
      DioVersionInfoApi = false
