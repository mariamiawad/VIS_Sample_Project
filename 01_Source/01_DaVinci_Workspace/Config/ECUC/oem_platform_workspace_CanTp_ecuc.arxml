AUTOSAR XML (schema 4-2-1)
package /ActiveEcuC
  module config CanTp: implementation-config-variant=VARIANT-PRE-COMPILE, module-description=CanTp_Impl
    CanTpGeneral:
      CanTpChangeParameterApi = false
      CanTpDevErrorDetect = false
      CanTpPaddingByte = 0
      CanTpReadParameterApi = false
      CanTpVersionInfoApi = false
      CanTpPaddingActive = true
      CanTpHavePaddingByte = false
      CanTpNumRxChannels = 8
      CanTpNumTxChannels = 1
      CanTpEnableSplitMainFunction = false
      CanTpSupportStandardAddressing = true
      CanTpSupportExtendedAddressing = true
      CanTpSupportMixed11Addressing = true
      CanTpOnlyNotifyInformedAppl = true
      CanTpRc = false
      CanTpTc = false
      CanTpSafeBswChecks = false
      CanTpEnableConstantBS = false
      CanTpEnableTransmitQueue = false
      CanTpUseOnlyFirstFc = true
      CanTpEnableSynchronousTransmit = true
      CanTpSupportMixed29Addressing = false
      CanTpSupportNormalFixedAddressing = false
    CanTpConfig: CanTpMainFunctionPeriod=0.005
      Diag_Phy_Channel (CanTpChannel): CanTpChannelMode=CANTP_MODE_HALF_DUPLEX
        CanTpRxNSdu:
          CanTpNbr = 0.025
          CanTpRxAddressingFormat = CANTP_STANDARD
          CanTpRxNSduId = 0
          CanTpRxPaddingActivation = CANTP_ON
          CanTpRxTaType = CANTP_PHYSICAL
          CanTpBs = 0
          CanTpRxDl = 1
          CanTpNar = 0.025
          CanTpNcr = 0.015
          CanTpRxWftMax = 0
          CanTpSTmin = 0
          CanTpRxNSduRef = DiagReq_Phy_Tp2Dcm
          DiagReq_PhyNpdu_Can2Tp_1796R (CanTpRxNPdu): CanTpRxNPduId=0, CanTpRxNPduRef=DiagReq_Phy_Can2Tp_1796R
          TXDiagValeoNpdu_1860T (CanTpTxFcNPdu): CanTpTxFcNPduConfirmationPduId=0, CanTpTxFcNPduRef=TXDiagValeo_Tp2CanResp_D_1860T
        TXDiagValeo_Dcm2TpResp (CanTpTxNSdu):
          CanTpNas = 0.025
          CanTpNcs = 0.025
          CanTpTc = false
          CanTpTxAddressingFormat = CANTP_STANDARD
          CanTpTxNSduId = 0
          CanTpTxPaddingActivation = CANTP_ON
          CanTpTxTaType = CANTP_PHYSICAL
          CanTpNbs = 0.075
          CanTpTxDl = 1
          CanTpTxNSduRef = TXDiagValeo_Dcm2TpResp
          TXDiagValeo_Tp2CanRespNpdu_D_1860T (CanTpTxNPdu): CanTpTxNPduConfirmationPduId=0, CanTpTxNPduRef=TXDiagValeo_Tp2CanResp_D_1860T
          DiagReq_PhyNpduFcN_Can2Tp_1796R (CanTpRxFcNPdu): CanTpRxFcNPduId=0, CanTpRxFcNPduRef=DiagReq_Phy_Can2Tp_1796R
      DiagReq_Func_Channel (CanTpChannel): CanTpChannelMode=CANTP_MODE_HALF_DUPLEX
        DiagReq_Func_Tp2DcmIpdu (CanTpRxNSdu):
          CanTpNbr = 0.025
          CanTpRxAddressingFormat = CANTP_STANDARD
          CanTpRxNSduId = 1
          CanTpRxPaddingActivation = CANTP_ON
          CanTpRxTaType = CANTP_FUNCTIONAL
          CanTpBs = 0
          CanTpRxDl = 1
          CanTpNar = 0.1
          CanTpNcr = 1
          CanTpRxNSduRef = DiagReq_Func_Tp2Dcm
          DiagReq_Func_Can2TpNpdu_2047R (CanTpRxNPdu): CanTpRxNPduId=1, CanTpRxNPduRef=DiagReqFUNC_Can2Tp_1797R
