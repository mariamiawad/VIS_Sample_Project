AUTOSAR XML (schema 4-2-1)
package /ActiveEcuC
  module config BswM: implementation-config-variant=VARIANT-PRE-COMPILE, module-description=BswM_Impl
    BswMGeneral:
      BswMCanSMEnabled = true
      BswMComMEnabled = true
      BswMDcmEnabled = true
      BswMDevErrorDetect = true
      BswMEcuMEnabled = true
      BswMEthIfEnabled = false
      BswMEthSMEnabled = false
      BswMFrSMEnabled = false
      BswMGenericRequestEnabled = true
      BswMJ1939DcmEnabled = false
      BswMJ1939NmEnabled = false
      BswMLinSMEnabled = false
      BswMLinTPEnabled = false
      BswMNmEnabled = false
      BswMNvMEnabled = true
      BswMPduREnabled = false
      BswMRuleControlEnabled = false
      BswMSdEnabled = false
      BswMVersionInfoApi = false
      BswMWdgMEnabled = false
      BswMModeCheck = true
      BswMMainFunctionPeriod = 0.01
      BswMSchMEnabled = true
      BswMActionListQueueSearchAlgorithm = LINEAR_SEARCH
      BswMSafeBswChecks = false
      BswMCommonData
      BswMGeneration:
        BswMOutOfBoundsWriteSanitizer = false
        BswMOutOfBoundsReadSanitizer = false
        BswMReduceConstantData2Define = true
        BswMBoolDataInArrayOfStructStrategy = BITMASKING
        BswMInterfacesForDeactivatedData = false
      BswMUserIncludeFiles: BswMUserIncludeFile=BswM_Callout_Stubs.h
    BswMConfig
      BswMArbitration
        NvMWriteAllFinished_LE (BswMLogicalExpression): BswMArgumentRef=NvM_WriteAll_MC
        NvM_WriteAll_MC (BswMModeCondition): BswMConditionType=BSWM_EQUALS_NOT, BswMConditionMode=NvM_WriteAll_RP
          BswMConditionValue
            BswMConditionValue (BswMBswMode): BswMBswRequestedMode=NVM_REQ_PENDING
        NvM_WriteAll_RP (BswMModeRequestPort): BswMRequestProcessing=BSWM_IMMEDIATE, BswMArbitrateOnInit=false
          BswMModeRequestSource
            BswMModeRequestSource (BswMNvMJobModeIndication): BswMNvmService=NvmWriteAll
          BswMModeInitValue
            BswMBswModeInitValue: BswMBswModeInitValueMode=NVM_REQ_OK
        NvMWriteAllFinished (BswMRule):
          BswMNestedExecutionOnly = false
          BswMRuleInitState = BSWM_FALSE
          BswMRuleId = 4
          BswMRuleExpressionRef = NvMWriteAllFinished_LE
          BswMRuleTrueActionList = Godown_AL
        CanSM_Ch1_BusOFFModeCondition (BswMModeCondition): BswMConditionType=BSWM_EQUALS, BswMConditionMode=CanSMIndication_Ch1_CanFD3_RP
          BswMConditionValue
            BswMBswMode: BswMBswRequestedMode=CANSM_BSWM_BUS_OFF
        CanSMIndication_Ch1_CanFD3_RP (BswMModeRequestPort): BswMArbitrateOnInit=false, BswMRequestProcessing=BSWM_IMMEDIATE
          BswMModeRequestSource
            BswMCanSMIndication: BswMCanSMChannelRef=CAN00_f26020e5
          BswMModeInitValue
            BswMBswModeInitValue: BswMBswModeInitValueMode=CANSM_BSWM_NO_COMMUNICATION
        CanSM_Ch1_BusOffRule (BswMRule):
          BswMNestedExecutionOnly = false
          BswMRuleId = 0
          BswMRuleInitState = BSWM_UNDEFINED
          BswMRuleExpressionRef = CanSM_Ch1_OffLogicalExpression
          BswMRuleTrueActionList = CanSM_Ch1_OffActionList
        CanSM_Ch1_OffLogicalExpression (BswMLogicalExpression): BswMArgumentRef=CanSM_Ch1_BusOFFModeCondition
        CanSM_Ch1_NoComModeCondition (BswMModeCondition): BswMConditionType=BSWM_EQUALS, BswMConditionMode=CanSMIndication_Ch1_CanFD3_RP
          BswMConditionValue
            BswMBswMode: BswMBswRequestedMode=CANSM_BSWM_NO_COMMUNICATION
        CanSM_Ch1_NoComLogicalExpression (BswMLogicalExpression): BswMArgumentRef=CanSM_Ch1_NoComModeCondition
        CanSM_Ch1_NoComRule (BswMRule):
          BswMNestedExecutionOnly = false
          BswMRuleId = 2
          BswMRuleInitState = BSWM_UNDEFINED
          BswMRuleExpressionRef = CanSM_Ch1_NoComLogicalExpression
          BswMRuleTrueActionList = CanSM_Ch1_NoComActionList
        CanSM_Ch1_FullComRule (BswMRule):
          BswMNestedExecutionOnly = false
          BswMRuleId = 1
          BswMRuleInitState = BSWM_FALSE
          BswMRuleExpressionRef = CanSM_Ch1_FullComLogicalExpression
          BswMRuleTrueActionList = CanSM_Ch1_FullComActionList
        CanSM_Ch1_FullComModeCondition (BswMModeCondition): BswMConditionType=BSWM_EQUALS, BswMConditionMode=CanSMIndication_Ch1_CanFD3_RP
          BswMConditionValue
            BswMBswMode: BswMBswRequestedMode=CANSM_BSWM_FULL_COMMUNICATION
        CanSM_Ch1_FullComLogicalExpression (BswMLogicalExpression): BswMArgumentRef=CanSM_Ch1_FullComModeCondition
        Generic_CompleteInit_RP (BswMModeRequestPort): BswMArbitrateOnInit=false, BswMRequestProcessing=BSWM_IMMEDIATE
          BswMModeRequestSource
            BswMGenericRequest: BswMModeRequesterId=0, BswMRequestedModeMax=1
          BswMModeInitValue
            BswMBswModeInitValue: BswMBswModeInitValueMode=0
        Generic_Completeinit_MC (BswMModeCondition): BswMConditionType=BSWM_EQUALS, BswMConditionMode=Generic_CompleteInit_RP
          BswMConditionValue
            BswMBswMode: BswMBswRequestedMode=1
        Generic_CompleteInit_LE (BswMLogicalExpression): BswMArgumentRef=Generic_Completeinit_MC
        Generic_completeInit_Rule (BswMRule):
          BswMNestedExecutionOnly = false
          BswMRuleId = 3
          BswMRuleInitState = BSWM_FALSE
          BswMRuleExpressionRef = Generic_CompleteInit_LE
          BswMRuleTrueActionList = Generic_completeinit_AL
        Dcm_DiagSessionControl_RP (BswMModeRequestPort): BswMArbitrateOnInit=false, BswMRequestProcessing=BSWM_IMMEDIATE
          BswMModeRequestSource
            BswMSwcModeNotification: BswMSwcModeNotificationModeDeclarationGroupPrototypeRef=DcmDiagnosticSessionControl
          BswMModeInitValue
            BswMSwcModeInitValue: BswMSwcModeInitValueRef=DEFAULT_SESSION
      BswMModeControl
        Godown_Act (BswMAction)
          BswMAvailableActions
            BswMAvailableActions (BswMUserCallout): BswMUserCalloutFunction=BswM_GoDownByEcuM(), BswMCreateCallout=true, BswMUserCode=EcuM_GoDown(0);, BswMUserIncludeFile=BswM_Callout_Stubs.h
        Godown_AL (BswMActionList): BswMActionListExecution=BSWM_CONDITION
          Godown_Act (BswMActionListItem): BswMAbortOnFail=false, BswMActionListItemIndex=0, BswMActionListItemRef=BswMModeControl/Godown_Act
        CanSM_Ch1_OffAction (BswMAction)
          CanSMOffAvailableActions (BswMAvailableActions)
            BswMUserCallout: BswMUserCalloutFunction=PSA_FC_Ch1_BusOffHandling(), BswMCreateCallout=false, BswMUserIncludeFile=PSA_BusOff.h
        CanSM_Ch1_OffActionList (BswMActionList): BswMActionListExecution=BSWM_TRIGGER
          CanSM_Ch1_OffAction (BswMActionListItem): BswMAbortOnFail=false, BswMActionListItemIndex=0, BswMActionListItemRef=BswMModeControl/CanSM_Ch1_OffAction
          Com_Ch1_DisablePDUGroups (BswMActionListItem): BswMAbortOnFail=false, BswMActionListItemIndex=1, BswMActionListItemRef=BswMModeControl/Com_Ch1_DisablePDUGroups
        CanSM_Ch1_NoComAction (BswMAction)
          CanSMNoComAvailableActions (BswMAvailableActions)
            BswMUserCallout: BswMUserCalloutFunction=PSA_FC_Ch1_NoComHandling(), BswMCreateCallout=false, BswMUserIncludeFile=PSA_BusOff.h
        CanSM_Ch1_NoComActionList (BswMActionList): BswMActionListExecution=BSWM_TRIGGER
          CanSM_Ch1_NoComAction (BswMActionListItem): BswMAbortOnFail=false, BswMActionListItemIndex=1, BswMActionListItemRef=BswMModeControl/CanSM_Ch1_NoComAction
          Com_Ch1_DisablePDUGroups (BswMActionListItem): BswMAbortOnFail=false, BswMActionListItemIndex=0, BswMActionListItemRef=BswMModeControl/Com_Ch1_DisablePDUGroups
        Com_Ch1_DisablePDUGroups (BswMAction)
          BswMAvailableActions
            BswMPduGroupSwitch: BswMPduGroupSwitchReinit=false, BswMDisabledPduGroupRef=SCU_oCAN00_Rx_fcef2243, BswMDisabledPduGroupRef=SCU_oCAN00_Tx_fcef2243
        Com_Ch1_EnablePDUGroups (BswMAction)
          BswMAvailableActions
            BswMPduGroupSwitch: BswMPduGroupSwitchReinit=true, BswMEnabledPduGroupRef=SCU_oCAN00_Rx_fcef2243, BswMEnabledPduGroupRef=SCU_oCAN00_Tx_fcef2243
        CanSM_Ch1_FullComActionList (BswMActionList): BswMActionListExecution=BSWM_TRIGGER
          Com_Ch1_EnablePDUGroups (BswMActionListItem): BswMAbortOnFail=false, BswMActionListItemIndex=1, BswMActionListItemRef=BswMModeControl/Com_Ch1_EnablePDUGroups
          CanSM_Ch1_FullComAction (BswMActionListItem): BswMAbortOnFail=false, BswMActionListItemIndex=0, BswMActionListItemRef=BswMModeControl/CanSM_Ch1_FullComAction
        Generic_CallCompleteInit (BswMAction)
          BswMAvailableActions
            BswMUserCallout:
              BswMUserCalloutFunction = BswM_UC_CompleteInit()
              BswMCreateCallout = false
              BswMUserCode = NvM_RequestResultType NvM_ReturnResult; Can_InitMemory(); Can_Init( Can_Config_Ptr ); CanIf_InitMemory(); CanIf_Init( CanIf_Config_Ptr ); CanSM_InitMemory(); CanSM_Init( CanSM_Config_Ptr ); PduR_InitMemory(); PduR_Init( PduR_Config_Ptr ); CanXcp_InitMemory(); CanXcp_Init( NULL_PTR ); Xcp_InitMemory(); Xcp_Init(); Com_InitMemory(); Com_Init( Com_Config_Ptr ); NvM_ReadAll(); NvM_GetErrorStatus(NVM_BLOCK_MULTI, &NvM_ReturnResult); while (NvM_ReturnResult == NVM_REQ_PENDING) { NvM_MainFunction(); Fee_30_SmallSector_MainFunction(); Fls_MainFunction(); // SBC_TriggerWD(); NvM_GetErrorStatus(NVM_BLOCK_MULTI, &NvM_ReturnResult); } Dem_Init( Dem_Config_Ptr ); (void)Dem_SetOperationCycleState(DemConf_DemOperationCycle_DemOperationCycle_PWR,DEM_CYCLE_STATE_START); CanTp_Init(CanTp_Config_Ptr); Dcm_Init(NULL_PTR); ComM_InitMemory(); ComM_Init(); /*Enable communication on Channel 1 CanFD3 */ ComM_CommunicationAllowed(ComMConf_ComMChannel_CAN00_f26020e5, TRUE); ComM_RequestComMode(ComMConf_ComMUser_USR_CHNL_f276589c, COMM_FULL_COMMUNICATION); /*Enable communication on Channel 2 Can Perception */ ComM_CommunicationAllowed(ComMConf_ComMChannel_CAN01_f26020e5, TRUE); ComM_RequestComMode(ComMConf_ComMUser_USR_CHNL_8571680a, COMM_FULL_COMMUNICATION); Rte_Start();
              BswMUserIncludeFile = BswM_CompleteInit.h
        Generic_completeinit_AL (BswMActionList): BswMActionListExecution=BSWM_TRIGGER
          Generic_CallCompleteInit (BswMActionListItem): BswMAbortOnFail=false, BswMActionListItemIndex=0, BswMActionListItemRef=BswMModeControl/Generic_CallCompleteInit
        CanSM_Ch1_FullComAction (BswMAction)
          CanSMNoComAvailableActions (BswMAvailableActions)
            BswMUserCallout: BswMUserCalloutFunction=PSA_FC_Ch1_FullComHandling(), BswMCreateCallout=false, BswMUserIncludeFile=PSA_BusOff.h
