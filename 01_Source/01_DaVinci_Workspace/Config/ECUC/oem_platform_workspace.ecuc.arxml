AUTOSAR XML (schema 4-2-1)
package /ActiveEcuC
  ecuc value collection ActiveEcuC: ecu-extract=SYSTEM
    ecuc-values:
      VTTMcu
      VTTEcuC
      CanSM
      ComM
      Dcm
      CanTp
      Com
      EcuC
      Dem
      VTTFls
      VTTCntrl
      Det
      Crc
      MemIf
      vSet
      Fls
      Fee
      NvM
      EcuM
      Rte
      Mcu
      Can
      VTTOs
      VTTCan
      BswM
      PduR
      CanIf
      Port
      Dio
      VTTDio
      VTTPort
      Os
