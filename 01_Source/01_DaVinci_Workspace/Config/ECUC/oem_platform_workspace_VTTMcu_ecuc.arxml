AUTOSAR XML (schema 4-2-1)
package /ActiveEcuC
  module config VTTMcu: implementation-config-variant=VARIANT-PRE-COMPILE, module-description=VTTMcu_Impl
    McuPublishedInformation
      15 x McuResetReasonConf, all with McuResetReason=5:
        MCU_EXTERNAL_PIN_RESET
        MCU_NO_RESET_REASON
        MCU_STOP_ACKNOWLEDGE_ERROR_RESET
        MCU_CORE_LOCKUP_RESET
        MCU_SOFTWARE_RESET
        MCU_LOSS_OF_LOCK_RESET
        MCU_POWER_ON_RESET
        MCU_RESET_UNDEFINED
        MCU_MDM_AP_SYSTEM_RESET
        MCU_LOSS_OF_CLOCK_RESET
        MCU_WATCHDOG_RESET
        MCU_LOW_OR_HIGH_VOLTAGE_DETECT_RESET
        MCU_JTAG_RESET
        MCU_MULTIPLE_RESET_REASON
        McuResetReasonConf
    McuGeneralConfiguration:
      McuDevErrorDetect = false
      McuGetRamStateApi = false
      McuInitClock = true
      McuNoPll = false
      McuPerformResetApi = true
      McuVersionInfoApi = false
      McuSafeBswChecks = false
    McuModuleConfiguration: McuRamSectors=1, McuNumberOfMcuModes=1, McuClockSrcFailureNotification=DISABLED
      McuModeSettingConf_0 (McuModeSettingConf): McuMode=0, McuVttMode=VTTMCU_MODE_NORMAL
      McuRamSectorSettingConf_0 (McuRamSectorSettingConf): McuRamSectionBaseAddress=536854528, McuRamDefaultValue=0, McuRamSectionSize=1024
      McuClockSettingConfig_0 (McuClockSettingConfig): McuClockSettingId=0
        18 x McuClockReferencePoint:
          McuClockReferencePoint_SIRC_CLK: McuClockReferencePointFrequency=8000000
          McuClockReferencePoint_SIRCDIV2_CLK: McuClockReferencePointFrequency=4000000
          McuClockReferencePoint_FTM0: McuClockReferencePointFrequency=40000000
          McuClockReferencePoint_LPSPI_1: McuClockReferencePointFrequency=20000000
          McuClockReferencePoint_SIRC: McuClockReferencePointFrequency=8000000
          McuClockReferencePoint_LPIT0_CLK: McuClockReferencePointFrequency=4000000
          McuClockReferencePoint_SOSCDIV1_CLK: McuClockReferencePointFrequency=8000000
          McuClockReferencePoint_FTM3: McuClockReferencePointFrequency=40000000
          McuClockReferencePoint_LPSPI_0: McuClockReferencePointFrequency=4000000
          McuClockReferencePoint_RUN_BUS_CLK: McuClockReferencePointFrequency=40000000
          McuClockReferencePoint_SOSCDIV2_CLK: McuClockReferencePointFrequency=4000000
          McuClockReferencePoint_FTM2: McuClockReferencePointFrequency=8000000
          McuClockReferencePoint_SYS_CLK: McuClockReferencePointFrequency=80000000
          McuClockReferencePoint_LPUART0_CLK: McuClockReferencePointFrequency=4000000
          McuClockReferencePoint_LPUART2_CLK: McuClockReferencePointFrequency=4000000
          McuClockReferencePoint_WDG_CLK: McuClockReferencePointFrequency=128000
          McuClockReferencePoint_SPLLDIV2_CLK: McuClockReferencePointFrequency=20000000
          McuClockReferencePoint_PLL_DIV2: McuClockReferencePointFrequency=20000000
      McuClockSettingConfig: McuClockSettingId=0
        McuClockReferencePoint: McuClockReferencePointFrequency=48000000
