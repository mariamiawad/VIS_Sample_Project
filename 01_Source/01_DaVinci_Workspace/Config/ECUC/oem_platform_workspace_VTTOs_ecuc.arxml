AUTOSAR XML (schema 4-2-1)
package /ActiveEcuC
  module config VTTOs: implementation-config-variant=VARIANT-PRE-COMPILE, module-description=Os_Impl
    OsOS:
      OsStackMonitoring = true
      OsStackUsageMeasurement = false
      OsStatus = STANDARD
      OsUseGetServiceId = false
      OsUseParameterAccess = false
      OsUseResScheduler = false
      OsForcibleTermination = false
      OsGenerateCalloutStubs = true
      OsGenerateMemMap = COMPLETE
      OsGenerateMemMapForNearAddressing = false
      OsGenerateMemMapForThreads = false
      OsServiceProtection = false
      OsUseXSignalAsyncApiCalls = false
      OsFpuUsage = NONE
      OsScalabilityClass = SC1
      OsNumberOfCores = 1
      OsMasterCore = OsCore0
      OsHardwareInitCore = OsCore0
      OsSystemTimer = SystemTimer
      OsHooks: OsErrorHook=true, OsPostTaskHook=false, OsPreTaskHook=false, OsShutdownHook=false, OsStartupHook=false, OsPanicHook=true, OsProtectionHook=false
      OsStackSummary
        12 x OsStack, all with OsStackCore=OsCore0:
          OsCore0_Kernel: OsStackSize=1024, OsStackType=CORE_KERNEL_STACK, OsStackUser=OsCore0
          OsCore0_Init: OsStackSize=1024, OsStackType=CORE_INIT_STACK, OsStackUser=OsCore0
          OsCore0_Error: OsStackSize=1024, OsStackType=CORE_ERROR_STACK, OsStackUser=OsCore0
          OsCore0_Isr_Core: OsStackSize=1024, OsStackType=ISR_SHARED_CORE_STACK, OsStackUser=CounterIsr_SystemTimer, OsStackUser=CanIsrErr_0, OsStackUser=CanIsrRx_0, OsStackUser=CanIsrTx_0
          OsCore0_Task_Prio0: OsStackSize=512, OsStackType=TASK_SHARED_PRIORITY_STACK, OsStackUser=Background_Task
          OsCore0_Task_Prio200: OsStackSize=3000, OsStackType=TASK_SHARED_PRIORITY_STACK, OsStackUser=Init_Task
          OsCore0_Task_Prio4294967295: OsStackSize=1024, OsStackType=TASK_SHARED_PRIORITY_STACK, OsStackUser=AutoStart_Task
          Task_10ms: OsStackSize=2048, OsStackType=TASK_EXTENDED_STACK, OsStackUser=VTTOs/Task_10ms
          Task_20ms: OsStackSize=2048, OsStackType=TASK_EXTENDED_STACK, OsStackUser=VTTOs/Task_20ms
          Task_5ms: OsStackSize=1024, OsStackType=TASK_EXTENDED_STACK, OsStackUser=VTTOs/Task_5ms
          OsCore0_Task_Prio110: OsStackSize=1024, OsStackType=TASK_SHARED_PRIORITY_STACK, OsStackUser=Task_1ms
          OsCore0_Task_Prio120: OsStackSize=512, OsStackType=TASK_SHARED_PRIORITY_STACK, OsStackUser=Task_500usec
      OsDebug: OsAssertions=false
    OsAppMode
    OsPublishedInformation: OsKernelVersion=7, OsPlatformName=Arm
      3 x OsDerivativeInformation, all with OsMpuEndAddressAccessible=true, OsExceptionVectorTableAlignment=0:
        OsDerivativeInformation: OsMpuAlignment=0, OsStackAlignment=0, OsInterruptVectorTableAlignment=0, OsHardwareManuals=Hardware Manual
          OsPhysicalCore:
            OsPhysicalCoreId = 0
            OsPhysicalCoreExceptionSources = 0
            OsPhysicalCoreIsAutostart = false
            OsPhysicalCoreMasterStartAllowed = false
            OsPhysicalCorePrivelegedHwAccess = false
          OsHardwareTimer: OsHardwareTimerId=0, OsHardwareTimerUnit=FRT, OsHardwareTimerSize=32, OsHardwareTimerBaseAddress=0
            OsHardwareTimerChannel: OsHardwareTimerChannelId=0, OsHardwareTimerChannelIntSource=0, OsHardwareTimerChannelOffset=0
        S32K14x: OsMpuAlignment=32, OsStackAlignment=32, OsInterruptVectorTableAlignment=128, OsHardwareManuals=NXP/Freescale - S32K14x Series Reference Manual - Supports S32K142, S32K144, S32K146, and S32K148 Document Number: S32K14XRM - Rev. 3, 03/2017
          OsHardwareTimer: OsHardwareTimerId=0, OsHardwareTimerUnit=FRT, OsHardwareTimerSize=32, OsHardwareTimerBaseAddress=0
            OsHardwareTimerChannel: OsHardwareTimerChannelId=0, OsHardwareTimerChannelIntSource=0, OsHardwareTimerChannelOffset=0
          SysTick (OsHardwareTimer): OsHardwareTimerId=0, OsHardwareTimerUnit=PIT, OsHardwareTimerSize=24, OsHardwareTimerBaseAddress=3758153744, OsHardwareTimerType=SysTick
            OsHardwareTimerChannel: OsHardwareTimerChannelId=0, OsHardwareTimerChannelIntSource=0, OsHardwareTimerChannelOffset=0
            SysTick_Ch0 (OsHardwareTimerChannel): OsHardwareTimerChannelId=0, OsHardwareTimerChannelIntSource=15, OsHardwareTimerChannelOffset=0
          SystemMPU0 (OsSystemMpu): OsSystemMpuId=0, OsSystemMpuMaxRegions=8, OsSystemMpuBaseAddress=1073795072, OsSystemMpuType=SYSTEM_MPU_NXP
          OsMemoryRegionDefaults_AppT (OsMemoryRegionDefaults): OsMemoryRegionDefType=APPLICATION_TRUSTED, OsMemoryRegionDefBusMasters=Core, OsMemoryRegionDefAccessRights=SUPERVISOR_RWX
          OsMemoryRegionDefaults_AppNT (OsMemoryRegionDefaults):
            OsMemoryRegionDefType = APPLICATION_NONTRUSTED
            OsMemoryRegionDefBusMasters = Core
            OsMemoryRegionDefAccessRights = USER_R
            OsMemoryRegionDefAccessRights = USER_W
          Core0 (OsPhysicalCore):
            OsPhysicalCoreId = 0
            OsPhysicalCoreExceptionSources = 8
            OsPhysicalCoreIsAutostart = true
            OsPhysicalCoreMasterStartAllowed = false
            OsPhysicalCorePrivelegedHwAccess = true
            OsPhysicalCoreDefaultEntrySymbol = _start
            OsPhysicalCoreType = Cortex-M
            OsPhysicalCoreStackProtectionUnit = SystemMPU0
          OsMemoryRegionSpecifics
            7 x OsMemoryRegionAccess:
              OsMemoryRegionAccess: OsMemoryRegionAccessRights=NONE, OsMemoryRegionAccessType=SUPERVISOR
              USER_X: OsMemoryRegionAccessRights=X, OsMemoryRegionAccessType=USER
              USER_R: OsMemoryRegionAccessRights=R, OsMemoryRegionAccessType=USER
              USER_W: OsMemoryRegionAccessRights=W, OsMemoryRegionAccessType=USER
              SUPERVISOR_RX: OsMemoryRegionAccessRights=RX, OsMemoryRegionAccessType=SUPERVISOR
              SUPERVISOR_RW: OsMemoryRegionAccessRights=RW, OsMemoryRegionAccessType=SUPERVISOR
              SUPERVISOR_RWX: OsMemoryRegionAccessRights=RWX, OsMemoryRegionAccessType=SUPERVISOR
            PID_ENABLE (OsMemoryRegionFlag)
            4 x OsMemoryRegionBusMaster:
              Debugger: OsMemoryRegionBusMasterId=1
              ENET: OsMemoryRegionBusMasterId=3
              Core: OsMemoryRegionBusMasterId=0
              DMA: OsMemoryRegionBusMasterId=2
          INTC (OsSystemIntCtrl):
            OsSystemIntCtrlMaxSources = 240
            OsSystemIntCtrlMaxPrios = 224
            OsSystemIntCtrlPrioOrder = ASC
            OsSystemIntCtrlBaseAddress = 3758153728
            OsSystemIntCtrlType = NVIC
        VTT: OsMpuAlignment=32, OsStackAlignment=32, OsInterruptVectorTableAlignment=0, OsHardwareManuals=N/A
          OsPhysicalCore:
            OsPhysicalCoreId = 0
            OsPhysicalCoreExceptionSources = 0
            OsPhysicalCoreIsAutostart = false
            OsPhysicalCoreMasterStartAllowed = false
            OsPhysicalCorePrivelegedHwAccess = false
          OsHardwareTimer: OsHardwareTimerId=0, OsHardwareTimerUnit=FRT, OsHardwareTimerSize=32, OsHardwareTimerBaseAddress=0
            OsHardwareTimerChannel: OsHardwareTimerChannelId=0, OsHardwareTimerChannelIntSource=0, OsHardwareTimerChannelOffset=0
          OsSystemIntCtrl: OsSystemIntCtrlMaxSources=10000, OsSystemIntCtrlMaxPrios=200, OsSystemIntCtrlPrioOrder=ASC, OsSystemIntCtrlBaseAddress=0
    OsCore0 (OsCore):
      OsCoreIsAutostart = true
      OsCoreIsAutosar = true
      OsCoreEntrySymbol = _start1
      OsCorePhysicalCoreRef = Core0
      OsCoreIdleTask = AutoStart_Task
      OsCoreEcucCoreRef = EcucCoreDefinition
      OsCoreSystemApplication = SystemApplication_OsCore0
      OsCoreStacks:
        OsCoreKernelStackSize = 1024
        OsCoreStartupStackSize = 1024
        OsCoreShutdownStackSize = 1024
        OsCoreErrorStackSize = 1024
        OsCoreProtectionStackSize = 1024
        OsCoreInitStackSize = 1024
    6 x OsTask, all with OsTaskActivation=1, OsTaskStackSharing=false, OsTaskUsesFpu=false, OsTaskAccessingApplication=SystemApplication_OsCore0:
      Init_Task: OsTaskPriority=200, OsTaskSchedule=NON, OsTaskStackSize=3000, OsTaskType=BASIC
        OsTaskAutostart: OsTaskAppModeRef=OS_APPMODE_ANY, OsTaskAppModeRef=OSDEFAULTAPPMODE
      Background_Task: OsTaskPriority=0, OsTaskSchedule=FULL, OsTaskStackSize=512, OsTaskType=AUTO, OsTaskResourceRef=OsResource
      Task_5ms: OsTaskPriority=100, OsTaskSchedule=FULL, OsTaskStackSize=1024, OsTaskType=AUTO, OsTaskEventRef=Rte_Ev_Cyclic2_Task_5ms_0_5ms, OsTaskEventRef=Rte_Ev_Cyclic2_Task_5ms_0_10ms
      Task_20ms: OsTaskPriority=80, OsTaskSchedule=FULL, OsTaskStackSize=2048, OsTaskType=EXTENDED, OsTaskEventRef=Rte_Ev_Cyclic2_Task_20ms_0_20ms
      AutoStart_Task: OsTaskPriority=4294967295, OsTaskSchedule=FULL, OsTaskStackSize=1024, OsTaskType=AUTO
        OsTaskAutostart: OsTaskAppModeRef=OS_APPMODE_ANY
      Task_10ms: OsTaskPriority=90, OsTaskSchedule=FULL, OsTaskStackSize=2048, OsTaskType=AUTO, OsTaskEventRef=Rte_Ev_Cyclic2_Task_10ms_0_10ms, OsTaskEventRef=Rte_Ev_Cyclic2_Task_10ms_0_5ms, OsTaskEventRef=Rte_Ev_Run_BswM_BswM_Notification_Dcm_DiagSessionControl_RP
    OsResource: OsResourceProperty=STANDARD, OsResourceAccessingApplication=SystemApplication_OsCore0
    6 x OsEvent:
      Rte_Ev_Cyclic2_Task_10ms_0_10ms
      Rte_Ev_Cyclic2_Task_10ms_0_5ms
      Rte_Ev_Run_BswM_BswM_Notification_Dcm_DiagSessionControl_RP
      Rte_Ev_Cyclic2_Task_20ms_0_20ms
      Rte_Ev_Cyclic2_Task_5ms_0_10ms
      Rte_Ev_Cyclic2_Task_5ms_0_5ms
    SystemApplication_OsCore0 (OsApplication):
      OsTrusted = true
      OsTrustedApplicationDelayTimingViolationCall = false
      OsTrustedApplicationWithProtection = false
      OsApplicationIsPrivileged = true
      OsAppUseTrustedFunctionStubs = false
      OsApplicationCoreRef = EcucCoreDefinition
      OsAppCounterRef = SystemTimer
      OsAppAlarmRef = Rte_Al_TE2_Task_10ms_0_5ms
      OsAppAlarmRef = Rte_Al_TE2_Task_5ms_0_10ms
      OsAppAlarmRef = Rte_Al_TE2_Task_10ms_0_10ms
      OsAppAlarmRef = Rte_Al_TE2_Task_20ms_0_20ms
      OsAppAlarmRef = Rte_Al_TE2_Task_5ms_0_5ms
      OsAppTaskRef = Init_Task
      OsAppTaskRef = AutoStart_Task
      OsAppTaskRef = Background_Task
      OsAppTaskRef = Task_500usec
      OsAppTaskRef = Task_1ms
      OsAppTaskRef = VTTOs/Task_5ms
      OsAppIsrRef = CounterIsr_SystemTimer
      OsAppIsrRef = CanIsrErr_0
      OsAppIsrRef = CanIsrRx_0
      OsAppIsrRef = CanIsrTx_0
      OsAppTaskRef = VTTOs/Task_10ms
      OsAppTaskRef = VTTOs/Task_20ms
      OsApplicationHooks: OsAppErrorHook=false, OsAppShutdownHook=false, OsAppStartupHook=false
    SystemTimer (OsCounter):
      OsCounterMaxAllowedValue = 2147483647
      OsCounterMinCycle = 1
      OsCounterTicksPerBase = 1
      OsCounterType = HARDWARE
      OsSecondsPerTick = 0.000125
      OsCounterAccessingApplication = SystemApplication_OsCore0
      OsDriver: OsDriverHighResolution=false, OsDriverHardwareTimerChannelRef=SysTick_Ch0, OsDriverIsrRef=CounterIsr_SystemTimer
    5 x OsAlarm, all with OsAlarmCounterRef=SystemTimer, OsAlarmAccessingApplication=SystemApplication_OsCore0:
      Rte_Al_TE2_Task_10ms_0_10ms
        OsAlarmAction
          OsAlarmSetEvent: OsAlarmSetEventRef=Rte_Ev_Cyclic2_Task_10ms_0_10ms, OsAlarmSetEventTaskRef=VTTOs/Task_10ms
      Rte_Al_TE2_Task_5ms_0_10ms
        OsAlarmAction
          OsAlarmSetEvent: OsAlarmSetEventRef=Rte_Ev_Cyclic2_Task_5ms_0_10ms, OsAlarmSetEventTaskRef=VTTOs/Task_5ms
      Rte_Al_TE2_Task_20ms_0_20ms
        OsAlarmAction
          OsAlarmSetEvent: OsAlarmSetEventRef=Rte_Ev_Cyclic2_Task_20ms_0_20ms, OsAlarmSetEventTaskRef=VTTOs/Task_20ms
      Rte_Al_TE2_Task_5ms_0_5ms
        OsAlarmAction
          OsAlarmSetEvent: OsAlarmSetEventRef=Rte_Ev_Cyclic2_Task_5ms_0_5ms, OsAlarmSetEventTaskRef=VTTOs/Task_5ms
      Rte_Al_TE2_Task_10ms_0_5ms
        OsAlarmAction
          OsAlarmSetEvent: OsAlarmSetEventRef=Rte_Ev_Cyclic2_Task_10ms_0_5ms, OsAlarmSetEventTaskRef=VTTOs/Task_10ms
    OSDEFAULTAPPMODE (OsAppMode)
    OS_APPMODE_ANY (OsAppMode)
    4 x OsIsr, all with OsIsrInterruptPriority=1, OsIsrInitialEnableInterruptSource=false, OsIsrCategory=CATEGORY_2, OsIsrInterruptType=EXTERNAL, OsIsrStackSize=1024, OsIsrEnableNesting=false, OsIsrUsesFpu=false:
      CounterIsr_SystemTimer: OsIsrInterruptSource=0, OsIsrSpecialFunctionName=Os_TimerPitIsr
      CanIsrErr_0: OsIsrInterruptSource=1  # /ActiveEcuC/VTTCan PLAIN_TEXT Can BusOff event (common for all controllers)
      CanIsrTx_0: OsIsrInterruptSource=2  # /ActiveEcuC/VTTCan PLAIN_TEXT Can TX messages event (common for all controllers)
      CanIsrRx_0: OsIsrInterruptSource=3  # /ActiveEcuC/VTTCan PLAIN_TEXT Can RX messages event (common for all controllers)
    Task_1ms (OsTask):
      OsTaskActivation = 1
      OsTaskPriority = 110
      OsTaskSchedule = FULL
      OsTaskStackSharing = false
      OsTaskStackSize = 1024
      OsTaskType = AUTO
      OsTaskUsesFpu = false
      OsTaskAccessingApplication = SystemApplication_OsCore0
    Task_500usec (OsTask):
      OsTaskActivation = 1
      OsTaskPriority = 120
      OsTaskSchedule = FULL
      OsTaskStackSharing = false
      OsTaskStackSize = 512
      OsTaskType = AUTO
      OsTaskUsesFpu = false
      OsTaskAccessingApplication = SystemApplication_OsCore0
